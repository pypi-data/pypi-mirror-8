/* Generated by Cython 0.20.2 on Sat Oct  4 14:29:45 2014 */

#define PY_SSIZE_T_CLEAN
#ifndef CYTHON_USE_PYLONG_INTERNALS
#ifdef PYLONG_BITS_IN_DIGIT
#define CYTHON_USE_PYLONG_INTERNALS 0
#else
#include "pyconfig.h"
#ifdef PYLONG_BITS_IN_DIGIT
#define CYTHON_USE_PYLONG_INTERNALS 1
#else
#define CYTHON_USE_PYLONG_INTERNALS 0
#endif
#endif
#endif
#include "Python.h"
#ifndef Py_PYTHON_H
    #error Python headers needed to compile C extensions, please install development version of Python.
#elif PY_VERSION_HEX < 0x02040000
    #error Cython requires Python 2.4+.
#else
#define CYTHON_ABI "0_20_2"
#include <stddef.h> /* For offsetof */
#ifndef offsetof
#define offsetof(type, member) ( (size_t) & ((type*)0) -> member )
#endif
#if !defined(WIN32) && !defined(MS_WINDOWS)
  #ifndef __stdcall
    #define __stdcall
  #endif
  #ifndef __cdecl
    #define __cdecl
  #endif
  #ifndef __fastcall
    #define __fastcall
  #endif
#endif
#ifndef DL_IMPORT
  #define DL_IMPORT(t) t
#endif
#ifndef DL_EXPORT
  #define DL_EXPORT(t) t
#endif
#ifndef PY_LONG_LONG
  #define PY_LONG_LONG LONG_LONG
#endif
#ifndef Py_HUGE_VAL
  #define Py_HUGE_VAL HUGE_VAL
#endif
#ifdef PYPY_VERSION
#define CYTHON_COMPILING_IN_PYPY 1
#define CYTHON_COMPILING_IN_CPYTHON 0
#else
#define CYTHON_COMPILING_IN_PYPY 0
#define CYTHON_COMPILING_IN_CPYTHON 1
#endif
#if CYTHON_COMPILING_IN_PYPY && PY_VERSION_HEX < 0x02070600
#define Py_OptimizeFlag 0
#endif
#if PY_VERSION_HEX < 0x02050000
  typedef int Py_ssize_t;
  #define PY_SSIZE_T_MAX INT_MAX
  #define PY_SSIZE_T_MIN INT_MIN
  #define PY_FORMAT_SIZE_T ""
  #define CYTHON_FORMAT_SSIZE_T ""
  #define PyInt_FromSsize_t(z) PyInt_FromLong(z)
  #define PyInt_AsSsize_t(o)   __Pyx_PyInt_As_int(o)
  #define PyNumber_Index(o)    ((PyNumber_Check(o) && !PyFloat_Check(o)) ? PyNumber_Int(o) : \
                                (PyErr_Format(PyExc_TypeError, \
                                              "expected index value, got %.200s", Py_TYPE(o)->tp_name), \
                                 (PyObject*)0))
  #define __Pyx_PyIndex_Check(o) (PyNumber_Check(o) && !PyFloat_Check(o) && \
                                  !PyComplex_Check(o))
  #define PyIndex_Check __Pyx_PyIndex_Check
  #define PyErr_WarnEx(category, message, stacklevel) PyErr_Warn(category, message)
  #define __PYX_BUILD_PY_SSIZE_T "i"
#else
  #define __PYX_BUILD_PY_SSIZE_T "n"
  #define CYTHON_FORMAT_SSIZE_T "z"
  #define __Pyx_PyIndex_Check PyIndex_Check
#endif
#if PY_VERSION_HEX < 0x02060000
  #define Py_REFCNT(ob) (((PyObject*)(ob))->ob_refcnt)
  #define Py_TYPE(ob)   (((PyObject*)(ob))->ob_type)
  #define Py_SIZE(ob)   (((PyVarObject*)(ob))->ob_size)
  #define PyVarObject_HEAD_INIT(type, size) \
          PyObject_HEAD_INIT(type) size,
  #define PyType_Modified(t)
  typedef struct {
     void *buf;
     PyObject *obj;
     Py_ssize_t len;
     Py_ssize_t itemsize;
     int readonly;
     int ndim;
     char *format;
     Py_ssize_t *shape;
     Py_ssize_t *strides;
     Py_ssize_t *suboffsets;
     void *internal;
  } Py_buffer;
  #define PyBUF_SIMPLE 0
  #define PyBUF_WRITABLE 0x0001
  #define PyBUF_FORMAT 0x0004
  #define PyBUF_ND 0x0008
  #define PyBUF_STRIDES (0x0010 | PyBUF_ND)
  #define PyBUF_C_CONTIGUOUS (0x0020 | PyBUF_STRIDES)
  #define PyBUF_F_CONTIGUOUS (0x0040 | PyBUF_STRIDES)
  #define PyBUF_ANY_CONTIGUOUS (0x0080 | PyBUF_STRIDES)
  #define PyBUF_INDIRECT (0x0100 | PyBUF_STRIDES)
  #define PyBUF_RECORDS (PyBUF_STRIDES | PyBUF_FORMAT | PyBUF_WRITABLE)
  #define PyBUF_FULL (PyBUF_INDIRECT | PyBUF_FORMAT | PyBUF_WRITABLE)
  typedef int (*getbufferproc)(PyObject *, Py_buffer *, int);
  typedef void (*releasebufferproc)(PyObject *, Py_buffer *);
#endif
#if PY_MAJOR_VERSION < 3
  #define __Pyx_BUILTIN_MODULE_NAME "__builtin__"
  #define __Pyx_PyCode_New(a, k, l, s, f, code, c, n, v, fv, cell, fn, name, fline, lnos) \
          PyCode_New(a+k, l, s, f, code, c, n, v, fv, cell, fn, name, fline, lnos)
  #define __Pyx_DefaultClassType PyClass_Type
#else
  #define __Pyx_BUILTIN_MODULE_NAME "builtins"
  #define __Pyx_PyCode_New(a, k, l, s, f, code, c, n, v, fv, cell, fn, name, fline, lnos) \
          PyCode_New(a, k, l, s, f, code, c, n, v, fv, cell, fn, name, fline, lnos)
  #define __Pyx_DefaultClassType PyType_Type
#endif
#if PY_VERSION_HEX < 0x02060000
  #define PyUnicode_FromString(s) PyUnicode_Decode(s, strlen(s), "UTF-8", "strict")
#endif
#if PY_MAJOR_VERSION >= 3
  #define Py_TPFLAGS_CHECKTYPES 0
  #define Py_TPFLAGS_HAVE_INDEX 0
#endif
#if (PY_VERSION_HEX < 0x02060000) || (PY_MAJOR_VERSION >= 3)
  #define Py_TPFLAGS_HAVE_NEWBUFFER 0
#endif
#if PY_VERSION_HEX < 0x02060000
  #define Py_TPFLAGS_HAVE_VERSION_TAG 0
#endif
#if PY_VERSION_HEX < 0x02060000 && !defined(Py_TPFLAGS_IS_ABSTRACT)
  #define Py_TPFLAGS_IS_ABSTRACT 0
#endif
#if PY_VERSION_HEX < 0x030400a1 && !defined(Py_TPFLAGS_HAVE_FINALIZE)
  #define Py_TPFLAGS_HAVE_FINALIZE 0
#endif
#if PY_VERSION_HEX > 0x03030000 && defined(PyUnicode_KIND)
  #define CYTHON_PEP393_ENABLED 1
  #define __Pyx_PyUnicode_READY(op)       (likely(PyUnicode_IS_READY(op)) ? \
                                              0 : _PyUnicode_Ready((PyObject *)(op)))
  #define __Pyx_PyUnicode_GET_LENGTH(u)   PyUnicode_GET_LENGTH(u)
  #define __Pyx_PyUnicode_READ_CHAR(u, i) PyUnicode_READ_CHAR(u, i)
  #define __Pyx_PyUnicode_KIND(u)         PyUnicode_KIND(u)
  #define __Pyx_PyUnicode_DATA(u)         PyUnicode_DATA(u)
  #define __Pyx_PyUnicode_READ(k, d, i)   PyUnicode_READ(k, d, i)
#else
  #define CYTHON_PEP393_ENABLED 0
  #define __Pyx_PyUnicode_READY(op)       (0)
  #define __Pyx_PyUnicode_GET_LENGTH(u)   PyUnicode_GET_SIZE(u)
  #define __Pyx_PyUnicode_READ_CHAR(u, i) ((Py_UCS4)(PyUnicode_AS_UNICODE(u)[i]))
  #define __Pyx_PyUnicode_KIND(u)         (sizeof(Py_UNICODE))
  #define __Pyx_PyUnicode_DATA(u)         ((void*)PyUnicode_AS_UNICODE(u))
  #define __Pyx_PyUnicode_READ(k, d, i)   ((void)(k), (Py_UCS4)(((Py_UNICODE*)d)[i]))
#endif
#if CYTHON_COMPILING_IN_PYPY
  #define __Pyx_PyUnicode_Concat(a, b)      PyNumber_Add(a, b)
  #define __Pyx_PyUnicode_ConcatSafe(a, b)  PyNumber_Add(a, b)
#else
  #define __Pyx_PyUnicode_Concat(a, b)      PyUnicode_Concat(a, b)
  #define __Pyx_PyUnicode_ConcatSafe(a, b)  ((unlikely((a) == Py_None) || unlikely((b) == Py_None)) ? \
      PyNumber_Add(a, b) : __Pyx_PyUnicode_Concat(a, b))
#endif
#define __Pyx_PyString_FormatSafe(a, b)  ((unlikely((a) == Py_None)) ? PyNumber_Remainder(a, b) : __Pyx_PyString_Format(a, b))
#define __Pyx_PyUnicode_FormatSafe(a, b)  ((unlikely((a) == Py_None)) ? PyNumber_Remainder(a, b) : PyUnicode_Format(a, b))
#if PY_MAJOR_VERSION >= 3
  #define __Pyx_PyString_Format(a, b)  PyUnicode_Format(a, b)
#else
  #define __Pyx_PyString_Format(a, b)  PyString_Format(a, b)
#endif
#if PY_MAJOR_VERSION >= 3
  #define PyBaseString_Type            PyUnicode_Type
  #define PyStringObject               PyUnicodeObject
  #define PyString_Type                PyUnicode_Type
  #define PyString_Check               PyUnicode_Check
  #define PyString_CheckExact          PyUnicode_CheckExact
#endif
#if PY_VERSION_HEX < 0x02060000
  #define PyBytesObject                PyStringObject
  #define PyBytes_Type                 PyString_Type
  #define PyBytes_Check                PyString_Check
  #define PyBytes_CheckExact           PyString_CheckExact
  #define PyBytes_FromString           PyString_FromString
  #define PyBytes_FromStringAndSize    PyString_FromStringAndSize
  #define PyBytes_FromFormat           PyString_FromFormat
  #define PyBytes_DecodeEscape         PyString_DecodeEscape
  #define PyBytes_AsString             PyString_AsString
  #define PyBytes_AsStringAndSize      PyString_AsStringAndSize
  #define PyBytes_Size                 PyString_Size
  #define PyBytes_AS_STRING            PyString_AS_STRING
  #define PyBytes_GET_SIZE             PyString_GET_SIZE
  #define PyBytes_Repr                 PyString_Repr
  #define PyBytes_Concat               PyString_Concat
  #define PyBytes_ConcatAndDel         PyString_ConcatAndDel
#endif
#if PY_MAJOR_VERSION >= 3
  #define __Pyx_PyBaseString_Check(obj) PyUnicode_Check(obj)
  #define __Pyx_PyBaseString_CheckExact(obj) PyUnicode_CheckExact(obj)
#else
  #define __Pyx_PyBaseString_Check(obj) (PyString_CheckExact(obj) || PyUnicode_CheckExact(obj) || \
                                         PyString_Check(obj) || PyUnicode_Check(obj))
  #define __Pyx_PyBaseString_CheckExact(obj) (PyString_CheckExact(obj) || PyUnicode_CheckExact(obj))
#endif
#if PY_VERSION_HEX < 0x02060000
  #define PySet_Check(obj)             PyObject_TypeCheck(obj, &PySet_Type)
  #define PyFrozenSet_Check(obj)       PyObject_TypeCheck(obj, &PyFrozenSet_Type)
#endif
#ifndef PySet_CheckExact
  #define PySet_CheckExact(obj)        (Py_TYPE(obj) == &PySet_Type)
#endif
#define __Pyx_TypeCheck(obj, type) PyObject_TypeCheck(obj, (PyTypeObject *)type)
#if PY_MAJOR_VERSION >= 3
  #define PyIntObject                  PyLongObject
  #define PyInt_Type                   PyLong_Type
  #define PyInt_Check(op)              PyLong_Check(op)
  #define PyInt_CheckExact(op)         PyLong_CheckExact(op)
  #define PyInt_FromString             PyLong_FromString
  #define PyInt_FromUnicode            PyLong_FromUnicode
  #define PyInt_FromLong               PyLong_FromLong
  #define PyInt_FromSize_t             PyLong_FromSize_t
  #define PyInt_FromSsize_t            PyLong_FromSsize_t
  #define PyInt_AsLong                 PyLong_AsLong
  #define PyInt_AS_LONG                PyLong_AS_LONG
  #define PyInt_AsSsize_t              PyLong_AsSsize_t
  #define PyInt_AsUnsignedLongMask     PyLong_AsUnsignedLongMask
  #define PyInt_AsUnsignedLongLongMask PyLong_AsUnsignedLongLongMask
  #define PyNumber_Int                 PyNumber_Long
#endif
#if PY_MAJOR_VERSION >= 3
  #define PyBoolObject                 PyLongObject
#endif
#if PY_VERSION_HEX < 0x030200A4
  typedef long Py_hash_t;
  #define __Pyx_PyInt_FromHash_t PyInt_FromLong
  #define __Pyx_PyInt_AsHash_t   PyInt_AsLong
#else
  #define __Pyx_PyInt_FromHash_t PyInt_FromSsize_t
  #define __Pyx_PyInt_AsHash_t   PyInt_AsSsize_t
#endif
#if (PY_MAJOR_VERSION < 3) || (PY_VERSION_HEX >= 0x03010300)
  #define __Pyx_PySequence_GetSlice(obj, a, b) PySequence_GetSlice(obj, a, b)
  #define __Pyx_PySequence_SetSlice(obj, a, b, value) PySequence_SetSlice(obj, a, b, value)
  #define __Pyx_PySequence_DelSlice(obj, a, b) PySequence_DelSlice(obj, a, b)
#else
  #define __Pyx_PySequence_GetSlice(obj, a, b) (unlikely(!(obj)) ? \
        (PyErr_SetString(PyExc_SystemError, "null argument to internal routine"), (PyObject*)0) : \
        (likely((obj)->ob_type->tp_as_mapping) ? (PySequence_GetSlice(obj, a, b)) : \
            (PyErr_Format(PyExc_TypeError, "'%.200s' object is unsliceable", (obj)->ob_type->tp_name), (PyObject*)0)))
  #define __Pyx_PySequence_SetSlice(obj, a, b, value) (unlikely(!(obj)) ? \
        (PyErr_SetString(PyExc_SystemError, "null argument to internal routine"), -1) : \
        (likely((obj)->ob_type->tp_as_mapping) ? (PySequence_SetSlice(obj, a, b, value)) : \
            (PyErr_Format(PyExc_TypeError, "'%.200s' object doesn't support slice assignment", (obj)->ob_type->tp_name), -1)))
  #define __Pyx_PySequence_DelSlice(obj, a, b) (unlikely(!(obj)) ? \
        (PyErr_SetString(PyExc_SystemError, "null argument to internal routine"), -1) : \
        (likely((obj)->ob_type->tp_as_mapping) ? (PySequence_DelSlice(obj, a, b)) : \
            (PyErr_Format(PyExc_TypeError, "'%.200s' object doesn't support slice deletion", (obj)->ob_type->tp_name), -1)))
#endif
#if PY_MAJOR_VERSION >= 3
  #define PyMethod_New(func, self, klass) ((self) ? PyMethod_New(func, self) : PyInstanceMethod_New(func))
#endif
#if PY_VERSION_HEX < 0x02050000
  #define __Pyx_GetAttrString(o,n)   PyObject_GetAttrString((o),((char *)(n)))
  #define __Pyx_SetAttrString(o,n,a) PyObject_SetAttrString((o),((char *)(n)),(a))
  #define __Pyx_DelAttrString(o,n)   PyObject_DelAttrString((o),((char *)(n)))
#else
  #define __Pyx_GetAttrString(o,n)   PyObject_GetAttrString((o),(n))
  #define __Pyx_SetAttrString(o,n,a) PyObject_SetAttrString((o),(n),(a))
  #define __Pyx_DelAttrString(o,n)   PyObject_DelAttrString((o),(n))
#endif
#if PY_VERSION_HEX < 0x02050000
  #define __Pyx_NAMESTR(n) ((char *)(n))
  #define __Pyx_DOCSTR(n)  ((char *)(n))
#else
  #define __Pyx_NAMESTR(n) (n)
  #define __Pyx_DOCSTR(n)  (n)
#endif
#ifndef CYTHON_INLINE
  #if defined(__GNUC__)
    #define CYTHON_INLINE __inline__
  #elif defined(_MSC_VER)
    #define CYTHON_INLINE __inline
  #elif defined (__STDC_VERSION__) && __STDC_VERSION__ >= 199901L
    #define CYTHON_INLINE inline
  #else
    #define CYTHON_INLINE
  #endif
#endif
#ifndef CYTHON_RESTRICT
  #if defined(__GNUC__)
    #define CYTHON_RESTRICT __restrict__
  #elif defined(_MSC_VER) && _MSC_VER >= 1400
    #define CYTHON_RESTRICT __restrict
  #elif defined (__STDC_VERSION__) && __STDC_VERSION__ >= 199901L
    #define CYTHON_RESTRICT restrict
  #else
    #define CYTHON_RESTRICT
  #endif
#endif
#ifdef NAN
#define __PYX_NAN() ((float) NAN)
#else
static CYTHON_INLINE float __PYX_NAN() {
  /* Initialize NaN. The sign is irrelevant, an exponent with all bits 1 and
   a nonzero mantissa means NaN. If the first bit in the mantissa is 1, it is
   a quiet NaN. */
  float value;
  memset(&value, 0xFF, sizeof(value));
  return value;
}
#endif
#ifdef __cplusplus
template<typename T>
void __Pyx_call_destructor(T* x) {
    x->~T();
}
#endif


#if PY_MAJOR_VERSION >= 3
  #define __Pyx_PyNumber_Divide(x,y)         PyNumber_TrueDivide(x,y)
  #define __Pyx_PyNumber_InPlaceDivide(x,y)  PyNumber_InPlaceTrueDivide(x,y)
#else
  #define __Pyx_PyNumber_Divide(x,y)         PyNumber_Divide(x,y)
  #define __Pyx_PyNumber_InPlaceDivide(x,y)  PyNumber_InPlaceDivide(x,y)
#endif

#ifndef __PYX_EXTERN_C
  #ifdef __cplusplus
    #define __PYX_EXTERN_C extern "C"
  #else
    #define __PYX_EXTERN_C extern
  #endif
#endif

#if defined(WIN32) || defined(MS_WINDOWS)
#define _USE_MATH_DEFINES
#endif
#include <math.h>
#define __PYX_HAVE__av__audio__stream
#define __PYX_HAVE_API__av__audio__stream
#include "pyav/config.h"
#include "stdint.h"
#include "libavutil/mathematics.h"
#include "libavutil/rational.h"
#include "libavutil/avutil.pyav.h"
#include "libavutil/pixdesc.h"
#include "libavutil/audioconvert.h"
#include "libavutil/audio_fifo.h"
#include "stdarg.h"
#include "stdio.h"
#include "libavutil/log.h"
#include "libavutil/channel_layout.h"
#include "libavutil/dict.h"
#include "libavutil/samplefmt.h"
#include "libavcodec/avcodec.pyav.h"
#include "libavdevice/avdevice.h"
#include "libavformat/avformat.pyav.h"
#include "libswresample/swresample.pyav.h"
#include "libswscale/swscale.h"
#ifdef _OPENMP
#include <omp.h>
#endif /* _OPENMP */

#ifdef PYREX_WITHOUT_ASSERTIONS
#define CYTHON_WITHOUT_ASSERTIONS
#endif

#ifndef CYTHON_UNUSED
# if defined(__GNUC__)
#   if !(defined(__cplusplus)) || (__GNUC__ > 3 || (__GNUC__ == 3 && __GNUC_MINOR__ >= 4))
#     define CYTHON_UNUSED __attribute__ ((__unused__))
#   else
#     define CYTHON_UNUSED
#   endif
# elif defined(__ICC) || (defined(__INTEL_COMPILER) && !defined(_MSC_VER))
#   define CYTHON_UNUSED __attribute__ ((__unused__))
# else
#   define CYTHON_UNUSED
# endif
#endif
typedef struct {PyObject **p; char *s; const Py_ssize_t n; const char* encoding;
                const char is_unicode; const char is_str; const char intern; } __Pyx_StringTabEntry; /*proto*/

#define __PYX_DEFAULT_STRING_ENCODING_IS_ASCII 1
#define __PYX_DEFAULT_STRING_ENCODING_IS_DEFAULT 0
#define __PYX_DEFAULT_STRING_ENCODING "ascii"
#define __Pyx_PyObject_FromString __Pyx_PyStr_FromString
#define __Pyx_PyObject_FromStringAndSize __Pyx_PyStr_FromStringAndSize
#define __Pyx_fits_Py_ssize_t(v, type, is_signed)  (    \
    (sizeof(type) < sizeof(Py_ssize_t))  ||             \
    (sizeof(type) > sizeof(Py_ssize_t) &&               \
          likely(v < (type)PY_SSIZE_T_MAX ||            \
                 v == (type)PY_SSIZE_T_MAX)  &&         \
          (!is_signed || likely(v > (type)PY_SSIZE_T_MIN ||       \
                                v == (type)PY_SSIZE_T_MIN)))  ||  \
    (sizeof(type) == sizeof(Py_ssize_t) &&              \
          (is_signed || likely(v < (type)PY_SSIZE_T_MAX ||        \
                               v == (type)PY_SSIZE_T_MAX)))  )
static CYTHON_INLINE char* __Pyx_PyObject_AsString(PyObject*);
static CYTHON_INLINE char* __Pyx_PyObject_AsStringAndSize(PyObject*, Py_ssize_t* length);
#define __Pyx_PyByteArray_FromString(s) PyByteArray_FromStringAndSize((const char*)s, strlen((const char*)s))
#define __Pyx_PyByteArray_FromStringAndSize(s, l) PyByteArray_FromStringAndSize((const char*)s, l)
#define __Pyx_PyBytes_FromString        PyBytes_FromString
#define __Pyx_PyBytes_FromStringAndSize PyBytes_FromStringAndSize
static CYTHON_INLINE PyObject* __Pyx_PyUnicode_FromString(const char*);
#if PY_MAJOR_VERSION < 3
    #define __Pyx_PyStr_FromString        __Pyx_PyBytes_FromString
    #define __Pyx_PyStr_FromStringAndSize __Pyx_PyBytes_FromStringAndSize
#else
    #define __Pyx_PyStr_FromString        __Pyx_PyUnicode_FromString
    #define __Pyx_PyStr_FromStringAndSize __Pyx_PyUnicode_FromStringAndSize
#endif
#define __Pyx_PyObject_AsSString(s)    ((signed char*) __Pyx_PyObject_AsString(s))
#define __Pyx_PyObject_AsUString(s)    ((unsigned char*) __Pyx_PyObject_AsString(s))
#define __Pyx_PyObject_FromUString(s)  __Pyx_PyObject_FromString((const char*)s)
#define __Pyx_PyBytes_FromUString(s)   __Pyx_PyBytes_FromString((const char*)s)
#define __Pyx_PyByteArray_FromUString(s)   __Pyx_PyByteArray_FromString((const char*)s)
#define __Pyx_PyStr_FromUString(s)     __Pyx_PyStr_FromString((const char*)s)
#define __Pyx_PyUnicode_FromUString(s) __Pyx_PyUnicode_FromString((const char*)s)
#if PY_MAJOR_VERSION < 3
static CYTHON_INLINE size_t __Pyx_Py_UNICODE_strlen(const Py_UNICODE *u)
{
    const Py_UNICODE *u_end = u;
    while (*u_end++) ;
    return (size_t)(u_end - u - 1);
}
#else
#define __Pyx_Py_UNICODE_strlen Py_UNICODE_strlen
#endif
#define __Pyx_PyUnicode_FromUnicode(u)       PyUnicode_FromUnicode(u, __Pyx_Py_UNICODE_strlen(u))
#define __Pyx_PyUnicode_FromUnicodeAndLength PyUnicode_FromUnicode
#define __Pyx_PyUnicode_AsUnicode            PyUnicode_AsUnicode
#define __Pyx_Owned_Py_None(b) (Py_INCREF(Py_None), Py_None)
#define __Pyx_PyBool_FromLong(b) ((b) ? (Py_INCREF(Py_True), Py_True) : (Py_INCREF(Py_False), Py_False))
static CYTHON_INLINE int __Pyx_PyObject_IsTrue(PyObject*);
static CYTHON_INLINE PyObject* __Pyx_PyNumber_Int(PyObject* x);
static CYTHON_INLINE Py_ssize_t __Pyx_PyIndex_AsSsize_t(PyObject*);
static CYTHON_INLINE PyObject * __Pyx_PyInt_FromSize_t(size_t);
#if CYTHON_COMPILING_IN_CPYTHON
#define __pyx_PyFloat_AsDouble(x) (PyFloat_CheckExact(x) ? PyFloat_AS_DOUBLE(x) : PyFloat_AsDouble(x))
#else
#define __pyx_PyFloat_AsDouble(x) PyFloat_AsDouble(x)
#endif
#define __pyx_PyFloat_AsFloat(x) ((float) __pyx_PyFloat_AsDouble(x))
#if PY_MAJOR_VERSION < 3 && __PYX_DEFAULT_STRING_ENCODING_IS_ASCII
static int __Pyx_sys_getdefaultencoding_not_ascii;
static int __Pyx_init_sys_getdefaultencoding_params(void) {
    PyObject* sys;
    PyObject* default_encoding = NULL;
    PyObject* ascii_chars_u = NULL;
    PyObject* ascii_chars_b = NULL;
    const char* default_encoding_c;
    sys = PyImport_ImportModule("sys");
    if (!sys) goto bad;
    default_encoding = PyObject_CallMethod(sys, (char*) (const char*) "getdefaultencoding", NULL);
    Py_DECREF(sys);
    if (!default_encoding) goto bad;
    default_encoding_c = PyBytes_AsString(default_encoding);
    if (!default_encoding_c) goto bad;
    if (strcmp(default_encoding_c, "ascii") == 0) {
        __Pyx_sys_getdefaultencoding_not_ascii = 0;
    } else {
        char ascii_chars[128];
        int c;
        for (c = 0; c < 128; c++) {
            ascii_chars[c] = c;
        }
        __Pyx_sys_getdefaultencoding_not_ascii = 1;
        ascii_chars_u = PyUnicode_DecodeASCII(ascii_chars, 128, NULL);
        if (!ascii_chars_u) goto bad;
        ascii_chars_b = PyUnicode_AsEncodedString(ascii_chars_u, default_encoding_c, NULL);
        if (!ascii_chars_b || !PyBytes_Check(ascii_chars_b) || memcmp(ascii_chars, PyBytes_AS_STRING(ascii_chars_b), 128) != 0) {
            PyErr_Format(
                PyExc_ValueError,
                "This module compiled with c_string_encoding=ascii, but default encoding '%.200s' is not a superset of ascii.",
                default_encoding_c);
            goto bad;
        }
        Py_DECREF(ascii_chars_u);
        Py_DECREF(ascii_chars_b);
    }
    Py_DECREF(default_encoding);
    return 0;
bad:
    Py_XDECREF(default_encoding);
    Py_XDECREF(ascii_chars_u);
    Py_XDECREF(ascii_chars_b);
    return -1;
}
#endif
#if __PYX_DEFAULT_STRING_ENCODING_IS_DEFAULT && PY_MAJOR_VERSION >= 3
#define __Pyx_PyUnicode_FromStringAndSize(c_str, size) PyUnicode_DecodeUTF8(c_str, size, NULL)
#else
#define __Pyx_PyUnicode_FromStringAndSize(c_str, size) PyUnicode_Decode(c_str, size, __PYX_DEFAULT_STRING_ENCODING, NULL)
#if __PYX_DEFAULT_STRING_ENCODING_IS_DEFAULT
static char* __PYX_DEFAULT_STRING_ENCODING;
static int __Pyx_init_sys_getdefaultencoding_params(void) {
    PyObject* sys;
    PyObject* default_encoding = NULL;
    char* default_encoding_c;
    sys = PyImport_ImportModule("sys");
    if (!sys) goto bad;
    default_encoding = PyObject_CallMethod(sys, (char*) (const char*) "getdefaultencoding", NULL);
    Py_DECREF(sys);
    if (!default_encoding) goto bad;
    default_encoding_c = PyBytes_AsString(default_encoding);
    if (!default_encoding_c) goto bad;
    __PYX_DEFAULT_STRING_ENCODING = (char*) malloc(strlen(default_encoding_c));
    if (!__PYX_DEFAULT_STRING_ENCODING) goto bad;
    strcpy(__PYX_DEFAULT_STRING_ENCODING, default_encoding_c);
    Py_DECREF(default_encoding);
    return 0;
bad:
    Py_XDECREF(default_encoding);
    return -1;
}
#endif
#endif


/* Test for GCC > 2.95 */
#if defined(__GNUC__)     && (__GNUC__ > 2 || (__GNUC__ == 2 && (__GNUC_MINOR__ > 95)))
  #define likely(x)   __builtin_expect(!!(x), 1)
  #define unlikely(x) __builtin_expect(!!(x), 0)
#else /* !__GNUC__ or GCC < 2.95 */
  #define likely(x)   (x)
  #define unlikely(x) (x)
#endif /* __GNUC__ */

static PyObject *__pyx_m;
static PyObject *__pyx_d;
static PyObject *__pyx_b;
static PyObject *__pyx_empty_tuple;
static PyObject *__pyx_empty_bytes;
static int __pyx_lineno;
static int __pyx_clineno = 0;
static const char * __pyx_cfilenm= __FILE__;
static const char *__pyx_filename;


static const char *__pyx_f[] = {
  "stream.pyx",
  "layout.pxd",
  "format.pxd",
  "format.pxd",
  "container.pxd",
  "packet.pxd",
  "frame.pxd",
  "frame.pxd",
  "fifo.pxd",
  "resampler.pxd",
  "utils.pxd",
};

/*--- Type declarations ---*/
struct __pyx_obj_2av_5audio_6layout_AudioLayout;
struct __pyx_obj_2av_5audio_6layout_AudioChannel;
struct __pyx_obj_2av_5audio_6format_AudioFormat;
struct __pyx_obj_2av_6format_ContainerFormat;
struct __pyx_obj_2av_9container_ContainerProxy;
struct __pyx_obj_2av_9container_Container;
struct __pyx_obj_2av_9container_InputContainer;
struct __pyx_obj_2av_9container_OutputContainer;
struct __pyx_obj_2av_6stream_Stream;
struct __pyx_obj_2av_6packet_Packet;
struct __pyx_obj_2av_5frame_Frame;
struct __pyx_obj_2av_5audio_5frame_AudioFrame;
struct __pyx_obj_2av_5audio_4fifo_AudioFifo;
struct __pyx_obj_2av_5audio_9resampler_AudioResampler;
struct __pyx_obj_2av_5utils_ByteSource;
struct __pyx_obj_2av_5audio_6stream_AudioStream;
struct __pyx_opt_args_2av_9container_15OutputContainer_add_stream;

/* "av/container.pxd":38
 *     cdef bint _done
 * 
 *     cpdef add_stream(self, codec_name=*, object rate=*, Stream template=*)             # <<<<<<<<<<<<<<
 *     cpdef start_encoding(self)
 */
struct __pyx_opt_args_2av_9container_15OutputContainer_add_stream {
  int __pyx_n;
  PyObject *codec_name;
  PyObject *rate;
  struct __pyx_obj_2av_6stream_Stream *template;
};
struct __pyx_opt_args_2av_5frame_5Frame__init_planes;

/* "av/frame.pxd":14
 * 
 *     cdef readonly tuple planes
 *     cdef _init_planes(self, cls=?)             # <<<<<<<<<<<<<<
 * 
 *     cdef _copy_attributes_from(self, Frame source)
 */
struct __pyx_opt_args_2av_5frame_5Frame__init_planes {
  int __pyx_n;
  PyObject *cls;
};
struct __pyx_opt_args_2av_5audio_4fifo_9AudioFifo_read;

/* "av/audio/fifo.pxd":22
 * 
 *     cpdef write(self, AudioFrame frame)
 *     cpdef read(self, unsigned int nb_samples=*, bint partial=*)             # <<<<<<<<<<<<<<
 * 
 */
struct __pyx_opt_args_2av_5audio_4fifo_9AudioFifo_read {
  int __pyx_n;
  unsigned int nb_samples;
  int partial;
};
struct __pyx_opt_args_2av_5utils_err_check;
struct __pyx_opt_args_2av_5utils_dict_to_avdict;
struct __pyx_opt_args_2av_5utils_bytesource;

/* "av/utils.pxd":8
 * 
 * 
 * cdef int err_check(int res, str filename=*) except -1             # <<<<<<<<<<<<<<
 * 
 * 
 */
struct __pyx_opt_args_2av_5utils_err_check {
  int __pyx_n;
  PyObject *filename;
};

/* "av/utils.pxd":12
 * 
 * cdef dict avdict_to_dict(lib.AVDictionary *input)
 * cdef dict_to_avdict(lib.AVDictionary **dst, dict src, bint clear=*)             # <<<<<<<<<<<<<<
 * 
 * 
 */
struct __pyx_opt_args_2av_5utils_dict_to_avdict {
  int __pyx_n;
  int clear;
};

/* "av/utils.pxd":32
 *     cdef size_t length
 * 
 * cdef ByteSource bytesource(object, bint allow_none=*)             # <<<<<<<<<<<<<<
 * 
 * 
 */
struct __pyx_opt_args_2av_5utils_bytesource {
  int __pyx_n;
  int allow_none;
};

/* "av/audio/layout.pxd":4
 * 
 * 
 * cdef class AudioLayout(object):             # <<<<<<<<<<<<<<
 * 
 *     # The layout for FFMpeg; this is essentially a bitmask of channels.
 */
struct __pyx_obj_2av_5audio_6layout_AudioLayout {
  PyObject_HEAD
  struct __pyx_vtabstruct_2av_5audio_6layout_AudioLayout *__pyx_vtab;
  uint64_t layout;
  int nb_channels;
  PyObject *channels;
};


/* "av/audio/layout.pxd":15
 * 
 * 
 * cdef class AudioChannel(object):             # <<<<<<<<<<<<<<
 * 
 *     # The channel for FFmpeg.
 */
struct __pyx_obj_2av_5audio_6layout_AudioChannel {
  PyObject_HEAD
  uint64_t channel;
};


/* "av/audio/format.pxd":4
 * 
 * 
 * cdef class AudioFormat(object):             # <<<<<<<<<<<<<<
 * 
 *     cdef lib.AVSampleFormat sample_fmt
 */
struct __pyx_obj_2av_5audio_6format_AudioFormat {
  PyObject_HEAD
  struct __pyx_vtabstruct_2av_5audio_6format_AudioFormat *__pyx_vtab;
  enum AVSampleFormat sample_fmt;
};

struct __pyx_obj_2av_6format_ContainerFormat {
  PyObject_HEAD
  PyObject *name;
  struct AVInputFormat *in_;
  struct AVOutputFormat *out;
};


/* "av/container.pxd":9
 * # need this intermediate proxy object so that there aren't any reference cycles
 * # and the pointer can be freed when everything that depends upon it is deleted.
 * cdef class ContainerProxy(object):             # <<<<<<<<<<<<<<
 *     cdef lib.AVFormatContext *ptr
 * 
 */
struct __pyx_obj_2av_9container_ContainerProxy {
  PyObject_HEAD
  struct AVFormatContext *ptr;
};


/* "av/container.pxd":13
 * 
 * 
 * cdef class Container(object):             # <<<<<<<<<<<<<<
 * 
 *     cdef readonly str name
 */
struct __pyx_obj_2av_9container_Container {
  PyObject_HEAD
  struct __pyx_vtabstruct_2av_9container_Container *__pyx_vtab;
  PyObject *name;
  struct __pyx_obj_2av_6format_ContainerFormat *format;
  AVDictionary *options;
  struct __pyx_obj_2av_9container_ContainerProxy *proxy;
  PyObject *__weakref__;
  PyObject *streams;
  PyObject *metadata;
};


/* "av/container.pxd":29
 * 
 * 
 * cdef class InputContainer(Container):             # <<<<<<<<<<<<<<
 *     pass
 * 
 */
struct __pyx_obj_2av_9container_InputContainer {
  struct __pyx_obj_2av_9container_Container __pyx_base;
};


/* "av/container.pxd":33
 * 
 * 
 * cdef class OutputContainer(Container):             # <<<<<<<<<<<<<<
 * 
 *     cdef bint _started
 */
struct __pyx_obj_2av_9container_OutputContainer {
  struct __pyx_obj_2av_9container_Container __pyx_base;
  int _started;
  int _done;
};


/* "av/stream.pxd":7
 * from libc.stdint cimport int64_t
 * 
 * cdef class Stream(object):             # <<<<<<<<<<<<<<
 * 
 *     # Stream attributes.
 */
struct __pyx_obj_2av_6stream_Stream {
  PyObject_HEAD
  struct __pyx_vtabstruct_2av_6stream_Stream *__pyx_vtab;
  struct __pyx_obj_2av_9container_ContainerProxy *_container;
  PyObject *_weak_container;
  struct AVStream *_stream;
  PyObject *metadata;
  struct AVCodecContext *_codec_context;
  struct AVCodec *_codec;
  AVDictionary *_codec_options;
};


/* "av/packet.pxd":6
 * 
 * 
 * cdef class Packet(object):             # <<<<<<<<<<<<<<
 * 
 *     cdef Stream stream
 */
struct __pyx_obj_2av_6packet_Packet {
  PyObject_HEAD
  struct __pyx_obj_2av_6stream_Stream *stream;
  struct AVPacket __pyx_struct;
};


/* "av/frame.pxd":5
 * from av.packet cimport Packet
 * 
 * cdef class Frame(object):             # <<<<<<<<<<<<<<
 * 
 *     cdef lib.AVFrame *ptr
 */
struct __pyx_obj_2av_5frame_Frame {
  PyObject_HEAD
  struct __pyx_vtabstruct_2av_5frame_Frame *__pyx_vtab;
  struct AVFrame *ptr;
  AVRational time_base;
  int index;
  PyObject *planes;
};


/* "av/audio/frame.pxd":10
 * 
 * 
 * cdef class AudioFrame(Frame):             # <<<<<<<<<<<<<<
 * 
 *     # For raw storage of the frame's data; don't ever touch this.
 */
struct __pyx_obj_2av_5audio_5frame_AudioFrame {
  struct __pyx_obj_2av_5frame_Frame __pyx_base;
  uint8_t *_buffer;
  size_t _buffer_size;
  int align;
  int nb_channels;
  int nb_planes;
  struct __pyx_obj_2av_5audio_6layout_AudioLayout *layout;
  struct __pyx_obj_2av_5audio_6format_AudioFormat *format;
};

struct __pyx_obj_2av_5audio_4fifo_AudioFifo {
  PyObject_HEAD
  struct __pyx_vtabstruct_2av_5audio_4fifo_AudioFifo *__pyx_vtab;
  struct AVAudioFifo *ptr;
  struct __pyx_obj_2av_5audio_6format_AudioFormat *format;
  struct __pyx_obj_2av_5audio_6layout_AudioLayout *layout;
  int64_t last_pts;
  int64_t pts_offset;
  AVRational time_base;
};


/* "av/audio/resampler.pxd":8
 * 
 * 
 * cdef class AudioResampler(object):             # <<<<<<<<<<<<<<
 * 
 *     cdef lib.SwrContext *ptr
 */
struct __pyx_obj_2av_5audio_9resampler_AudioResampler {
  PyObject_HEAD
  struct __pyx_vtabstruct_2av_5audio_9resampler_AudioResampler *__pyx_vtab;
  struct SwrContext *ptr;
  struct __pyx_obj_2av_5audio_6format_AudioFormat *src_format;
  struct __pyx_obj_2av_5audio_6layout_AudioLayout *src_layout;
  unsigned int src_rate;
  struct __pyx_obj_2av_5audio_6format_AudioFormat *format;
  struct __pyx_obj_2av_5audio_6layout_AudioLayout *layout;
  unsigned int rate;
};


/* "av/utils.pxd":22
 * 
 * 
 * cdef class ByteSource(object):             # <<<<<<<<<<<<<<
 * 
 *     cdef object owner
 */
struct __pyx_obj_2av_5utils_ByteSource {
  PyObject_HEAD
  PyObject *owner;
  int has_view;
  Py_buffer view;
  unsigned char *ptr;
  size_t length;
};


/* "av/audio/stream.pxd":11
 * 
 * 
 * cdef class AudioStream(Stream):             # <<<<<<<<<<<<<<
 * 
 *     cdef readonly AudioLayout layout
 */
struct __pyx_obj_2av_5audio_6stream_AudioStream {
  struct __pyx_obj_2av_6stream_Stream __pyx_base;
  struct __pyx_obj_2av_5audio_6layout_AudioLayout *layout;
  struct __pyx_obj_2av_5audio_6format_AudioFormat *format;
  struct __pyx_obj_2av_5audio_5frame_AudioFrame *next_frame;
  struct __pyx_obj_2av_5audio_9resampler_AudioResampler *resampler;
  struct __pyx_obj_2av_5audio_4fifo_AudioFifo *fifo;
};



/* "av/audio/layout.pxd":4
 * 
 * 
 * cdef class AudioLayout(object):             # <<<<<<<<<<<<<<
 * 
 *     # The layout for FFMpeg; this is essentially a bitmask of channels.
 */

struct __pyx_vtabstruct_2av_5audio_6layout_AudioLayout {
  PyObject *(*_init)(struct __pyx_obj_2av_5audio_6layout_AudioLayout *, uint64_t);
};
static struct __pyx_vtabstruct_2av_5audio_6layout_AudioLayout *__pyx_vtabptr_2av_5audio_6layout_AudioLayout;


struct __pyx_vtabstruct_2av_5audio_6format_AudioFormat {
  PyObject *(*_init)(struct __pyx_obj_2av_5audio_6format_AudioFormat *, enum AVSampleFormat);
};
static struct __pyx_vtabstruct_2av_5audio_6format_AudioFormat *__pyx_vtabptr_2av_5audio_6format_AudioFormat;


/* "av/container.pxd":13
 * 
 * 
 * cdef class Container(object):             # <<<<<<<<<<<<<<
 * 
 *     cdef readonly str name
 */

struct __pyx_vtabstruct_2av_9container_Container {
  PyObject *(*_seek)(struct __pyx_obj_2av_9container_Container *, int, int64_t, PyObject *, int, int);
  PyObject *(*_flush_buffers)(struct __pyx_obj_2av_9container_Container *);
};
static struct __pyx_vtabstruct_2av_9container_Container *__pyx_vtabptr_2av_9container_Container;


/* "av/container.pxd":29
 * 
 * 
 * cdef class InputContainer(Container):             # <<<<<<<<<<<<<<
 *     pass
 * 
 */

struct __pyx_vtabstruct_2av_9container_InputContainer {
  struct __pyx_vtabstruct_2av_9container_Container __pyx_base;
};
static struct __pyx_vtabstruct_2av_9container_InputContainer *__pyx_vtabptr_2av_9container_InputContainer;


/* "av/container.pxd":33
 * 
 * 
 * cdef class OutputContainer(Container):             # <<<<<<<<<<<<<<
 * 
 *     cdef bint _started
 */

struct __pyx_vtabstruct_2av_9container_OutputContainer {
  struct __pyx_vtabstruct_2av_9container_Container __pyx_base;
  PyObject *(*add_stream)(struct __pyx_obj_2av_9container_OutputContainer *, int __pyx_skip_dispatch, struct __pyx_opt_args_2av_9container_15OutputContainer_add_stream *__pyx_optional_args);
  PyObject *(*start_encoding)(struct __pyx_obj_2av_9container_OutputContainer *, int __pyx_skip_dispatch);
};
static struct __pyx_vtabstruct_2av_9container_OutputContainer *__pyx_vtabptr_2av_9container_OutputContainer;


/* "av/stream.pxd":7
 * from libc.stdint cimport int64_t
 * 
 * cdef class Stream(object):             # <<<<<<<<<<<<<<
 * 
 *     # Stream attributes.
 */

struct __pyx_vtabstruct_2av_6stream_Stream {
  PyObject *(*_init)(struct __pyx_obj_2av_6stream_Stream *, struct __pyx_obj_2av_9container_Container *, struct AVStream *);
  PyObject *(*_setup_frame)(struct __pyx_obj_2av_6stream_Stream *, struct __pyx_obj_2av_5frame_Frame *);
  PyObject *(*_decode_one)(struct __pyx_obj_2av_6stream_Stream *, struct AVPacket *, int *);
  PyObject *(*decode)(struct __pyx_obj_2av_6stream_Stream *, struct __pyx_obj_2av_6packet_Packet *, int __pyx_skip_dispatch);
};
static struct __pyx_vtabstruct_2av_6stream_Stream *__pyx_vtabptr_2av_6stream_Stream;


/* "av/frame.pxd":5
 * from av.packet cimport Packet
 * 
 * cdef class Frame(object):             # <<<<<<<<<<<<<<
 * 
 *     cdef lib.AVFrame *ptr
 */

struct __pyx_vtabstruct_2av_5frame_Frame {
  PyObject *(*_init_planes)(struct __pyx_obj_2av_5frame_Frame *, struct __pyx_opt_args_2av_5frame_5Frame__init_planes *__pyx_optional_args);
  PyObject *(*_copy_attributes_from)(struct __pyx_obj_2av_5frame_Frame *, struct __pyx_obj_2av_5frame_Frame *);
};
static struct __pyx_vtabstruct_2av_5frame_Frame *__pyx_vtabptr_2av_5frame_Frame;


/* "av/audio/frame.pxd":10
 * 
 * 
 * cdef class AudioFrame(Frame):             # <<<<<<<<<<<<<<
 * 
 *     # For raw storage of the frame's data; don't ever touch this.
 */

struct __pyx_vtabstruct_2av_5audio_5frame_AudioFrame {
  struct __pyx_vtabstruct_2av_5frame_Frame __pyx_base;
  PyObject *(*_init)(struct __pyx_obj_2av_5audio_5frame_AudioFrame *, enum AVSampleFormat, uint64_t, unsigned int, int);
  PyObject *(*_recalc_linesize)(struct __pyx_obj_2av_5audio_5frame_AudioFrame *);
  PyObject *(*_init_properties)(struct __pyx_obj_2av_5audio_5frame_AudioFrame *);
};
static struct __pyx_vtabstruct_2av_5audio_5frame_AudioFrame *__pyx_vtabptr_2av_5audio_5frame_AudioFrame;


struct __pyx_vtabstruct_2av_5audio_4fifo_AudioFifo {
  PyObject *(*write)(struct __pyx_obj_2av_5audio_4fifo_AudioFifo *, struct __pyx_obj_2av_5audio_5frame_AudioFrame *, int __pyx_skip_dispatch);
  PyObject *(*read)(struct __pyx_obj_2av_5audio_4fifo_AudioFifo *, int __pyx_skip_dispatch, struct __pyx_opt_args_2av_5audio_4fifo_9AudioFifo_read *__pyx_optional_args);
};
static struct __pyx_vtabstruct_2av_5audio_4fifo_AudioFifo *__pyx_vtabptr_2av_5audio_4fifo_AudioFifo;


/* "av/audio/resampler.pxd":8
 * 
 * 
 * cdef class AudioResampler(object):             # <<<<<<<<<<<<<<
 * 
 *     cdef lib.SwrContext *ptr
 */

struct __pyx_vtabstruct_2av_5audio_9resampler_AudioResampler {
  PyObject *(*resample)(struct __pyx_obj_2av_5audio_9resampler_AudioResampler *, struct __pyx_obj_2av_5audio_5frame_AudioFrame *, int __pyx_skip_dispatch);
};
static struct __pyx_vtabstruct_2av_5audio_9resampler_AudioResampler *__pyx_vtabptr_2av_5audio_9resampler_AudioResampler;


/* "av/audio/stream.pyx":10
 * 
 * 
 * cdef class AudioStream(Stream):             # <<<<<<<<<<<<<<
 * 
 *     cdef _init(self, Container container, lib.AVStream *stream):
 */

struct __pyx_vtabstruct_2av_5audio_6stream_AudioStream {
  struct __pyx_vtabstruct_2av_6stream_Stream __pyx_base;
  PyObject *(*encode)(struct __pyx_obj_2av_5audio_6stream_AudioStream *, struct __pyx_obj_2av_5audio_5frame_AudioFrame *, int __pyx_skip_dispatch);
};
static struct __pyx_vtabstruct_2av_5audio_6stream_AudioStream *__pyx_vtabptr_2av_5audio_6stream_AudioStream;
#ifndef CYTHON_REFNANNY
  #define CYTHON_REFNANNY 0
#endif
#if CYTHON_REFNANNY
  typedef struct {
    void (*INCREF)(void*, PyObject*, int);
    void (*DECREF)(void*, PyObject*, int);
    void (*GOTREF)(void*, PyObject*, int);
    void (*GIVEREF)(void*, PyObject*, int);
    void* (*SetupContext)(const char*, int, const char*);
    void (*FinishContext)(void**);
  } __Pyx_RefNannyAPIStruct;
  static __Pyx_RefNannyAPIStruct *__Pyx_RefNanny = NULL;
  static __Pyx_RefNannyAPIStruct *__Pyx_RefNannyImportAPI(const char *modname); /*proto*/
  #define __Pyx_RefNannyDeclarations void *__pyx_refnanny = NULL;
#ifdef WITH_THREAD
  #define __Pyx_RefNannySetupContext(name, acquire_gil) \
          if (acquire_gil) { \
              PyGILState_STATE __pyx_gilstate_save = PyGILState_Ensure(); \
              __pyx_refnanny = __Pyx_RefNanny->SetupContext((name), __LINE__, __FILE__); \
              PyGILState_Release(__pyx_gilstate_save); \
          } else { \
              __pyx_refnanny = __Pyx_RefNanny->SetupContext((name), __LINE__, __FILE__); \
          }
#else
  #define __Pyx_RefNannySetupContext(name, acquire_gil) \
          __pyx_refnanny = __Pyx_RefNanny->SetupContext((name), __LINE__, __FILE__)
#endif
  #define __Pyx_RefNannyFinishContext() \
          __Pyx_RefNanny->FinishContext(&__pyx_refnanny)
  #define __Pyx_INCREF(r)  __Pyx_RefNanny->INCREF(__pyx_refnanny, (PyObject *)(r), __LINE__)
  #define __Pyx_DECREF(r)  __Pyx_RefNanny->DECREF(__pyx_refnanny, (PyObject *)(r), __LINE__)
  #define __Pyx_GOTREF(r)  __Pyx_RefNanny->GOTREF(__pyx_refnanny, (PyObject *)(r), __LINE__)
  #define __Pyx_GIVEREF(r) __Pyx_RefNanny->GIVEREF(__pyx_refnanny, (PyObject *)(r), __LINE__)
  #define __Pyx_XINCREF(r)  do { if((r) != NULL) {__Pyx_INCREF(r); }} while(0)
  #define __Pyx_XDECREF(r)  do { if((r) != NULL) {__Pyx_DECREF(r); }} while(0)
  #define __Pyx_XGOTREF(r)  do { if((r) != NULL) {__Pyx_GOTREF(r); }} while(0)
  #define __Pyx_XGIVEREF(r) do { if((r) != NULL) {__Pyx_GIVEREF(r);}} while(0)
#else
  #define __Pyx_RefNannyDeclarations
  #define __Pyx_RefNannySetupContext(name, acquire_gil)
  #define __Pyx_RefNannyFinishContext()
  #define __Pyx_INCREF(r) Py_INCREF(r)
  #define __Pyx_DECREF(r) Py_DECREF(r)
  #define __Pyx_GOTREF(r)
  #define __Pyx_GIVEREF(r)
  #define __Pyx_XINCREF(r) Py_XINCREF(r)
  #define __Pyx_XDECREF(r) Py_XDECREF(r)
  #define __Pyx_XGOTREF(r)
  #define __Pyx_XGIVEREF(r)
#endif /* CYTHON_REFNANNY */
#define __Pyx_XDECREF_SET(r, v) do {                            \
        PyObject *tmp = (PyObject *) r;                         \
        r = v; __Pyx_XDECREF(tmp);                              \
    } while (0)
#define __Pyx_DECREF_SET(r, v) do {                             \
        PyObject *tmp = (PyObject *) r;                         \
        r = v; __Pyx_DECREF(tmp);                               \
    } while (0)
#define __Pyx_CLEAR(r)    do { PyObject* tmp = ((PyObject*)(r)); r = NULL; __Pyx_DECREF(tmp);} while(0)
#define __Pyx_XCLEAR(r)   do { if((r) != NULL) {PyObject* tmp = ((PyObject*)(r)); r = NULL; __Pyx_DECREF(tmp);}} while(0)

#if CYTHON_COMPILING_IN_CPYTHON
static CYTHON_INLINE PyObject* __Pyx_PyObject_GetAttrStr(PyObject* obj, PyObject* attr_name) {
    PyTypeObject* tp = Py_TYPE(obj);
    if (likely(tp->tp_getattro))
        return tp->tp_getattro(obj, attr_name);
#if PY_MAJOR_VERSION < 3
    if (likely(tp->tp_getattr))
        return tp->tp_getattr(obj, PyString_AS_STRING(attr_name));
#endif
    return PyObject_GetAttr(obj, attr_name);
}
#else
#define __Pyx_PyObject_GetAttrStr(o,n) PyObject_GetAttr(o,n)
#endif

static PyObject *__Pyx_GetBuiltinName(PyObject *name); /*proto*/

#if CYTHON_COMPILING_IN_CPYTHON
static CYTHON_INLINE PyObject* __Pyx_PyObject_Call(PyObject *func, PyObject *arg, PyObject *kw); /*proto*/
#else
#define __Pyx_PyObject_Call(func, arg, kw) PyObject_Call(func, arg, kw)
#endif

static CYTHON_INLINE int __Pyx_TypeTest(PyObject *obj, PyTypeObject *type); /*proto*/

static CYTHON_INLINE int __Pyx_ArgTypeTest(PyObject *obj, PyTypeObject *type, int none_allowed,
    const char *name, int exact); /*proto*/

static void __Pyx_call_next_tp_dealloc(PyObject* obj, destructor current_tp_dealloc);

static int __Pyx_call_next_tp_traverse(PyObject* obj, visitproc v, void *a, traverseproc current_tp_traverse);

static void __Pyx_call_next_tp_clear(PyObject* obj, inquiry current_tp_dealloc);

static void* __Pyx_GetVtable(PyObject *dict); /*proto*/

static int __Pyx_SetVtable(PyObject *dict, void *vtable); /*proto*/

static CYTHON_INLINE int __Pyx_PyInt_As_int(PyObject *);

static CYTHON_INLINE PyObject* __Pyx_PyInt_From_int(int value);

static CYTHON_INLINE PyObject* __Pyx_PyInt_From_unsigned_int(unsigned int value);

static CYTHON_INLINE PyObject* __Pyx_PyInt_From_long(long value);

static CYTHON_INLINE long __Pyx_PyInt_As_long(PyObject *);

static int __Pyx_check_binary_version(void);

#if !defined(__Pyx_PyIdentifier_FromString)
#if PY_MAJOR_VERSION < 3
  #define __Pyx_PyIdentifier_FromString(s) PyString_FromString(s)
#else
  #define __Pyx_PyIdentifier_FromString(s) PyUnicode_FromString(s)
#endif
#endif

static PyObject *__Pyx_ImportModule(const char *name); /*proto*/

static PyTypeObject *__Pyx_ImportType(const char *module_name, const char *class_name, size_t size, int strict);  /*proto*/

static int __Pyx_ImportFunction(PyObject *module, const char *funcname, void (**f)(void), const char *sig); /*proto*/

typedef struct {
    int code_line;
    PyCodeObject* code_object;
} __Pyx_CodeObjectCacheEntry;
struct __Pyx_CodeObjectCache {
    int count;
    int max_count;
    __Pyx_CodeObjectCacheEntry* entries;
};
static struct __Pyx_CodeObjectCache __pyx_code_cache = {0,0,NULL};
static int __pyx_bisect_code_objects(__Pyx_CodeObjectCacheEntry* entries, int count, int code_line);
static PyCodeObject *__pyx_find_code_object(int code_line);
static void __pyx_insert_code_object(int code_line, PyCodeObject* code_object);

static void __Pyx_AddTraceback(const char *funcname, int c_line,
                               int py_line, const char *filename); /*proto*/

static int __Pyx_InitStrings(__Pyx_StringTabEntry *t); /*proto*/


/* Module declarations from 'libc.stdint' */

/* Module declarations from 'libav' */

/* Module declarations from 'av.audio.layout' */
static PyTypeObject *__pyx_ptype_2av_5audio_6layout_AudioLayout = 0;
static PyTypeObject *__pyx_ptype_2av_5audio_6layout_AudioChannel = 0;
static struct __pyx_obj_2av_5audio_6layout_AudioLayout *(*__pyx_f_2av_5audio_6layout_get_audio_layout)(int, uint64_t); /*proto*/

/* Module declarations from 'av.audio.format' */
static PyTypeObject *__pyx_ptype_2av_5audio_6format_AudioFormat = 0;
static struct __pyx_obj_2av_5audio_6format_AudioFormat *(*__pyx_f_2av_5audio_6format_get_audio_format)(enum AVSampleFormat); /*proto*/

/* Module declarations from 'av.format' */
static PyTypeObject *__pyx_ptype_2av_6format_ContainerFormat = 0;

/* Module declarations from 'av.container' */
static PyTypeObject *__pyx_ptype_2av_9container_ContainerProxy = 0;
static PyTypeObject *__pyx_ptype_2av_9container_Container = 0;
static PyTypeObject *__pyx_ptype_2av_9container_InputContainer = 0;
static PyTypeObject *__pyx_ptype_2av_9container_OutputContainer = 0;

/* Module declarations from 'av.stream' */
static PyTypeObject *__pyx_ptype_2av_6stream_Stream = 0;

/* Module declarations from 'av.packet' */
static PyTypeObject *__pyx_ptype_2av_6packet_Packet = 0;

/* Module declarations from 'av.frame' */
static PyTypeObject *__pyx_ptype_2av_5frame_Frame = 0;

/* Module declarations from 'av.audio.frame' */
static PyTypeObject *__pyx_ptype_2av_5audio_5frame_AudioFrame = 0;
static struct __pyx_obj_2av_5audio_5frame_AudioFrame *(*__pyx_f_2av_5audio_5frame_alloc_audio_frame)(void); /*proto*/

/* Module declarations from 'av.audio.fifo' */
static PyTypeObject *__pyx_ptype_2av_5audio_4fifo_AudioFifo = 0;

/* Module declarations from 'av.audio.resampler' */
static PyTypeObject *__pyx_ptype_2av_5audio_9resampler_AudioResampler = 0;

/* Module declarations from 'cpython.buffer' */

/* Module declarations from 'av.utils' */
static PyTypeObject *__pyx_ptype_2av_5utils_ByteSource = 0;
static int (*__pyx_f_2av_5utils_err_check)(int, struct __pyx_opt_args_2av_5utils_err_check *__pyx_optional_args); /*proto*/

/* Module declarations from 'av.audio.stream' */
static PyTypeObject *__pyx_ptype_2av_5audio_6stream_AudioStream = 0;
#define __Pyx_MODULE_NAME "av.audio.stream"
int __pyx_module_is_main_av__audio__stream = 0;

/* Implementation of 'av.audio.stream' */
static PyObject *__pyx_builtin_id;
static PyObject *__pyx_pf_2av_5audio_6stream_11AudioStream___repr__(struct __pyx_obj_2av_5audio_6stream_AudioStream *__pyx_v_self); /* proto */
static PyObject *__pyx_pf_2av_5audio_6stream_11AudioStream_10frame_size___get__(struct __pyx_obj_2av_5audio_6stream_AudioStream *__pyx_v_self); /* proto */
static PyObject *__pyx_pf_2av_5audio_6stream_11AudioStream_4rate___get__(struct __pyx_obj_2av_5audio_6stream_AudioStream *__pyx_v_self); /* proto */
static int __pyx_pf_2av_5audio_6stream_11AudioStream_4rate_2__set__(struct __pyx_obj_2av_5audio_6stream_AudioStream *__pyx_v_self, int __pyx_v_value); /* proto */
static PyObject *__pyx_pf_2av_5audio_6stream_11AudioStream_8channels___get__(struct __pyx_obj_2av_5audio_6stream_AudioStream *__pyx_v_self); /* proto */
static PyObject *__pyx_pf_2av_5audio_6stream_11AudioStream_2encode(struct __pyx_obj_2av_5audio_6stream_AudioStream *__pyx_v_self, struct __pyx_obj_2av_5audio_5frame_AudioFrame *__pyx_v_input_frame); /* proto */
static PyObject *__pyx_pf_2av_5audio_6stream_11AudioStream_6layout___get__(struct __pyx_obj_2av_5audio_6stream_AudioStream *__pyx_v_self); /* proto */
static PyObject *__pyx_pf_2av_5audio_6stream_11AudioStream_6format___get__(struct __pyx_obj_2av_5audio_6stream_AudioStream *__pyx_v_self); /* proto */
static PyObject *__pyx_tp_new_2av_5audio_6stream_AudioStream(PyTypeObject *t, PyObject *a, PyObject *k); /*proto*/
static char __pyx_k_id[] = "id";
static char __pyx_k_main[] = "__main__";
static char __pyx_k_name[] = "__name__";
static char __pyx_k_rate[] = "rate";
static char __pyx_k_test[] = "__test__";
static char __pyx_k_class[] = "__class__";
static char __pyx_k_index[] = "index";
static char __pyx_k_encode[] = "encode";
static char __pyx_k_name_2[] = "name";
static char __pyx_k_pyx_vtable[] = "__pyx_vtable__";
static char __pyx_k_start_encoding[] = "start_encoding";
static char __pyx_k_samples_per_second[] = "samples per second ";
static char __pyx_k_av_s_d_s_at_dHz_s_s_at_0x_x[] = "<av.%s #%d %s at %dHz, %s, %s at 0x%x>";
static char __pyx_k_Number_of_samples_per_channel_in[] = "Number of samples per channel in an audio frame.";
static PyObject *__pyx_kp_s_av_s_d_s_at_dHz_s_s_at_0x_x;
static PyObject *__pyx_n_s_class;
static PyObject *__pyx_n_s_encode;
static PyObject *__pyx_n_s_id;
static PyObject *__pyx_n_s_index;
static PyObject *__pyx_n_s_main;
static PyObject *__pyx_n_s_name;
static PyObject *__pyx_n_s_name_2;
static PyObject *__pyx_n_s_pyx_vtable;
static PyObject *__pyx_n_s_rate;
static PyObject *__pyx_n_s_start_encoding;
static PyObject *__pyx_n_s_test;

/* "av/audio/stream.pyx":12
 * cdef class AudioStream(Stream):
 * 
 *     cdef _init(self, Container container, lib.AVStream *stream):             # <<<<<<<<<<<<<<
 *         Stream._init(self, container, stream)
 * 
 */

static PyObject *__pyx_f_2av_5audio_6stream_11AudioStream__init(struct __pyx_obj_2av_5audio_6stream_AudioStream *__pyx_v_self, struct __pyx_obj_2av_9container_Container *__pyx_v_container, struct AVStream *__pyx_v_stream) {
  PyObject *__pyx_r = NULL;
  __Pyx_RefNannyDeclarations
  PyObject *__pyx_t_1 = NULL;
  int __pyx_t_2;
  uint64_t __pyx_t_3;
  int __pyx_lineno = 0;
  const char *__pyx_filename = NULL;
  int __pyx_clineno = 0;
  __Pyx_RefNannySetupContext("_init", 0);

  /* "av/audio/stream.pyx":13
 * 
 *     cdef _init(self, Container container, lib.AVStream *stream):
 *         Stream._init(self, container, stream)             # <<<<<<<<<<<<<<
 * 
 *         # Sometimes there isn't a layout set, but there are a number of
 */
  __pyx_t_1 = __pyx_vtabptr_2av_6stream_Stream->_init(((struct __pyx_obj_2av_6stream_Stream *)__pyx_v_self), __pyx_v_container, __pyx_v_stream); if (unlikely(!__pyx_t_1)) {__pyx_filename = __pyx_f[0]; __pyx_lineno = 13; __pyx_clineno = __LINE__; goto __pyx_L1_error;}
  __Pyx_GOTREF(__pyx_t_1);
  __Pyx_DECREF(__pyx_t_1); __pyx_t_1 = 0;

  /* "av/audio/stream.pyx":17
 *         # Sometimes there isn't a layout set, but there are a number of
 *         # channels. Assume it is the default layout.
 *         self.layout = get_audio_layout(self._codec_context.channels, self._codec_context.channel_layout)             # <<<<<<<<<<<<<<
 *         if not self._codec_context.channel_layout:
 *             self._codec_context.channel_layout = self.layout.layout
 */
  __pyx_t_1 = ((PyObject *)__pyx_f_2av_5audio_6layout_get_audio_layout(__pyx_v_self->__pyx_base._codec_context->channels, __pyx_v_self->__pyx_base._codec_context->channel_layout)); if (unlikely(!__pyx_t_1)) {__pyx_filename = __pyx_f[0]; __pyx_lineno = 17; __pyx_clineno = __LINE__; goto __pyx_L1_error;}
  __Pyx_GOTREF(__pyx_t_1);
  __Pyx_GIVEREF(__pyx_t_1);
  __Pyx_GOTREF(__pyx_v_self->layout);
  __Pyx_DECREF(((PyObject *)__pyx_v_self->layout));
  __pyx_v_self->layout = ((struct __pyx_obj_2av_5audio_6layout_AudioLayout *)__pyx_t_1);
  __pyx_t_1 = 0;

  /* "av/audio/stream.pyx":18
 *         # channels. Assume it is the default layout.
 *         self.layout = get_audio_layout(self._codec_context.channels, self._codec_context.channel_layout)
 *         if not self._codec_context.channel_layout:             # <<<<<<<<<<<<<<
 *             self._codec_context.channel_layout = self.layout.layout
 * 
 */
  __pyx_t_2 = ((!(__pyx_v_self->__pyx_base._codec_context->channel_layout != 0)) != 0);
  if (__pyx_t_2) {

    /* "av/audio/stream.pyx":19
 *         self.layout = get_audio_layout(self._codec_context.channels, self._codec_context.channel_layout)
 *         if not self._codec_context.channel_layout:
 *             self._codec_context.channel_layout = self.layout.layout             # <<<<<<<<<<<<<<
 * 
 *         self.format = get_audio_format(self._codec_context.sample_fmt)
 */
    __pyx_t_3 = __pyx_v_self->layout->layout;
    __pyx_v_self->__pyx_base._codec_context->channel_layout = __pyx_t_3;
    goto __pyx_L3;
  }
  __pyx_L3:;

  /* "av/audio/stream.pyx":21
 *             self._codec_context.channel_layout = self.layout.layout
 * 
 *         self.format = get_audio_format(self._codec_context.sample_fmt)             # <<<<<<<<<<<<<<
 * 
 *     def __repr__(self):
 */
  __pyx_t_1 = ((PyObject *)__pyx_f_2av_5audio_6format_get_audio_format(__pyx_v_self->__pyx_base._codec_context->sample_fmt)); if (unlikely(!__pyx_t_1)) {__pyx_filename = __pyx_f[0]; __pyx_lineno = 21; __pyx_clineno = __LINE__; goto __pyx_L1_error;}
  __Pyx_GOTREF(__pyx_t_1);
  __Pyx_GIVEREF(__pyx_t_1);
  __Pyx_GOTREF(__pyx_v_self->format);
  __Pyx_DECREF(((PyObject *)__pyx_v_self->format));
  __pyx_v_self->format = ((struct __pyx_obj_2av_5audio_6format_AudioFormat *)__pyx_t_1);
  __pyx_t_1 = 0;

  /* "av/audio/stream.pyx":12
 * cdef class AudioStream(Stream):
 * 
 *     cdef _init(self, Container container, lib.AVStream *stream):             # <<<<<<<<<<<<<<
 *         Stream._init(self, container, stream)
 * 
 */

  /* function exit code */
  __pyx_r = Py_None; __Pyx_INCREF(Py_None);
  goto __pyx_L0;
  __pyx_L1_error:;
  __Pyx_XDECREF(__pyx_t_1);
  __Pyx_AddTraceback("av.audio.stream.AudioStream._init", __pyx_clineno, __pyx_lineno, __pyx_filename);
  __pyx_r = 0;
  __pyx_L0:;
  __Pyx_XGIVEREF(__pyx_r);
  __Pyx_RefNannyFinishContext();
  return __pyx_r;
}

/* "av/audio/stream.pyx":23
 *         self.format = get_audio_format(self._codec_context.sample_fmt)
 * 
 *     def __repr__(self):             # <<<<<<<<<<<<<<
 *         return '<av.%s #%d %s at %dHz, %s, %s at 0x%x>' % (
 *             self.__class__.__name__,
 */

/* Python wrapper */
static PyObject *__pyx_pw_2av_5audio_6stream_11AudioStream_1__repr__(PyObject *__pyx_v_self); /*proto*/
static PyObject *__pyx_pw_2av_5audio_6stream_11AudioStream_1__repr__(PyObject *__pyx_v_self) {
  PyObject *__pyx_r = 0;
  __Pyx_RefNannyDeclarations
  __Pyx_RefNannySetupContext("__repr__ (wrapper)", 0);
  __pyx_r = __pyx_pf_2av_5audio_6stream_11AudioStream___repr__(((struct __pyx_obj_2av_5audio_6stream_AudioStream *)__pyx_v_self));

  /* function exit code */
  __Pyx_RefNannyFinishContext();
  return __pyx_r;
}

static PyObject *__pyx_pf_2av_5audio_6stream_11AudioStream___repr__(struct __pyx_obj_2av_5audio_6stream_AudioStream *__pyx_v_self) {
  PyObject *__pyx_r = NULL;
  __Pyx_RefNannyDeclarations
  PyObject *__pyx_t_1 = NULL;
  PyObject *__pyx_t_2 = NULL;
  PyObject *__pyx_t_3 = NULL;
  PyObject *__pyx_t_4 = NULL;
  PyObject *__pyx_t_5 = NULL;
  PyObject *__pyx_t_6 = NULL;
  PyObject *__pyx_t_7 = NULL;
  PyObject *__pyx_t_8 = NULL;
  int __pyx_lineno = 0;
  const char *__pyx_filename = NULL;
  int __pyx_clineno = 0;
  __Pyx_RefNannySetupContext("__repr__", 0);

  /* "av/audio/stream.pyx":24
 * 
 *     def __repr__(self):
 *         return '<av.%s #%d %s at %dHz, %s, %s at 0x%x>' % (             # <<<<<<<<<<<<<<
 *             self.__class__.__name__,
 *             self.index,
 */
  __Pyx_XDECREF(__pyx_r);

  /* "av/audio/stream.pyx":25
 *     def __repr__(self):
 *         return '<av.%s #%d %s at %dHz, %s, %s at 0x%x>' % (
 *             self.__class__.__name__,             # <<<<<<<<<<<<<<
 *             self.index,
 *             self.name,
 */
  __pyx_t_1 = __Pyx_PyObject_GetAttrStr(((PyObject *)__pyx_v_self), __pyx_n_s_class); if (unlikely(!__pyx_t_1)) {__pyx_filename = __pyx_f[0]; __pyx_lineno = 25; __pyx_clineno = __LINE__; goto __pyx_L1_error;}
  __Pyx_GOTREF(__pyx_t_1);
  __pyx_t_2 = __Pyx_PyObject_GetAttrStr(__pyx_t_1, __pyx_n_s_name); if (unlikely(!__pyx_t_2)) {__pyx_filename = __pyx_f[0]; __pyx_lineno = 25; __pyx_clineno = __LINE__; goto __pyx_L1_error;}
  __Pyx_GOTREF(__pyx_t_2);
  __Pyx_DECREF(__pyx_t_1); __pyx_t_1 = 0;

  /* "av/audio/stream.pyx":26
 *         return '<av.%s #%d %s at %dHz, %s, %s at 0x%x>' % (
 *             self.__class__.__name__,
 *             self.index,             # <<<<<<<<<<<<<<
 *             self.name,
 *             self.rate,
 */
  __pyx_t_1 = __Pyx_PyObject_GetAttrStr(((PyObject *)__pyx_v_self), __pyx_n_s_index); if (unlikely(!__pyx_t_1)) {__pyx_filename = __pyx_f[0]; __pyx_lineno = 26; __pyx_clineno = __LINE__; goto __pyx_L1_error;}
  __Pyx_GOTREF(__pyx_t_1);

  /* "av/audio/stream.pyx":27
 *             self.__class__.__name__,
 *             self.index,
 *             self.name,             # <<<<<<<<<<<<<<
 *             self.rate,
 *             self.layout.name,
 */
  __pyx_t_3 = __Pyx_PyObject_GetAttrStr(((PyObject *)__pyx_v_self), __pyx_n_s_name_2); if (unlikely(!__pyx_t_3)) {__pyx_filename = __pyx_f[0]; __pyx_lineno = 27; __pyx_clineno = __LINE__; goto __pyx_L1_error;}
  __Pyx_GOTREF(__pyx_t_3);

  /* "av/audio/stream.pyx":28
 *             self.index,
 *             self.name,
 *             self.rate,             # <<<<<<<<<<<<<<
 *             self.layout.name,
 *             self.format.name,
 */
  __pyx_t_4 = __Pyx_PyObject_GetAttrStr(((PyObject *)__pyx_v_self), __pyx_n_s_rate); if (unlikely(!__pyx_t_4)) {__pyx_filename = __pyx_f[0]; __pyx_lineno = 28; __pyx_clineno = __LINE__; goto __pyx_L1_error;}
  __Pyx_GOTREF(__pyx_t_4);

  /* "av/audio/stream.pyx":29
 *             self.name,
 *             self.rate,
 *             self.layout.name,             # <<<<<<<<<<<<<<
 *             self.format.name,
 *             id(self),
 */
  __pyx_t_5 = __Pyx_PyObject_GetAttrStr(((PyObject *)__pyx_v_self->layout), __pyx_n_s_name_2); if (unlikely(!__pyx_t_5)) {__pyx_filename = __pyx_f[0]; __pyx_lineno = 29; __pyx_clineno = __LINE__; goto __pyx_L1_error;}
  __Pyx_GOTREF(__pyx_t_5);

  /* "av/audio/stream.pyx":30
 *             self.rate,
 *             self.layout.name,
 *             self.format.name,             # <<<<<<<<<<<<<<
 *             id(self),
 *         )
 */
  __pyx_t_6 = __Pyx_PyObject_GetAttrStr(((PyObject *)__pyx_v_self->format), __pyx_n_s_name_2); if (unlikely(!__pyx_t_6)) {__pyx_filename = __pyx_f[0]; __pyx_lineno = 30; __pyx_clineno = __LINE__; goto __pyx_L1_error;}
  __Pyx_GOTREF(__pyx_t_6);

  /* "av/audio/stream.pyx":31
 *             self.layout.name,
 *             self.format.name,
 *             id(self),             # <<<<<<<<<<<<<<
 *         )
 * 
 */
  __pyx_t_7 = PyTuple_New(1); if (unlikely(!__pyx_t_7)) {__pyx_filename = __pyx_f[0]; __pyx_lineno = 31; __pyx_clineno = __LINE__; goto __pyx_L1_error;}
  __Pyx_GOTREF(__pyx_t_7);
  __Pyx_INCREF(((PyObject *)__pyx_v_self));
  PyTuple_SET_ITEM(__pyx_t_7, 0, ((PyObject *)__pyx_v_self));
  __Pyx_GIVEREF(((PyObject *)__pyx_v_self));
  __pyx_t_8 = __Pyx_PyObject_Call(__pyx_builtin_id, __pyx_t_7, NULL); if (unlikely(!__pyx_t_8)) {__pyx_filename = __pyx_f[0]; __pyx_lineno = 31; __pyx_clineno = __LINE__; goto __pyx_L1_error;}
  __Pyx_GOTREF(__pyx_t_8);
  __Pyx_DECREF(__pyx_t_7); __pyx_t_7 = 0;

  /* "av/audio/stream.pyx":25
 *     def __repr__(self):
 *         return '<av.%s #%d %s at %dHz, %s, %s at 0x%x>' % (
 *             self.__class__.__name__,             # <<<<<<<<<<<<<<
 *             self.index,
 *             self.name,
 */
  __pyx_t_7 = PyTuple_New(7); if (unlikely(!__pyx_t_7)) {__pyx_filename = __pyx_f[0]; __pyx_lineno = 25; __pyx_clineno = __LINE__; goto __pyx_L1_error;}
  __Pyx_GOTREF(__pyx_t_7);
  PyTuple_SET_ITEM(__pyx_t_7, 0, __pyx_t_2);
  __Pyx_GIVEREF(__pyx_t_2);
  PyTuple_SET_ITEM(__pyx_t_7, 1, __pyx_t_1);
  __Pyx_GIVEREF(__pyx_t_1);
  PyTuple_SET_ITEM(__pyx_t_7, 2, __pyx_t_3);
  __Pyx_GIVEREF(__pyx_t_3);
  PyTuple_SET_ITEM(__pyx_t_7, 3, __pyx_t_4);
  __Pyx_GIVEREF(__pyx_t_4);
  PyTuple_SET_ITEM(__pyx_t_7, 4, __pyx_t_5);
  __Pyx_GIVEREF(__pyx_t_5);
  PyTuple_SET_ITEM(__pyx_t_7, 5, __pyx_t_6);
  __Pyx_GIVEREF(__pyx_t_6);
  PyTuple_SET_ITEM(__pyx_t_7, 6, __pyx_t_8);
  __Pyx_GIVEREF(__pyx_t_8);
  __pyx_t_2 = 0;
  __pyx_t_1 = 0;
  __pyx_t_3 = 0;
  __pyx_t_4 = 0;
  __pyx_t_5 = 0;
  __pyx_t_6 = 0;
  __pyx_t_8 = 0;

  /* "av/audio/stream.pyx":24
 * 
 *     def __repr__(self):
 *         return '<av.%s #%d %s at %dHz, %s, %s at 0x%x>' % (             # <<<<<<<<<<<<<<
 *             self.__class__.__name__,
 *             self.index,
 */
  __pyx_t_8 = __Pyx_PyString_Format(__pyx_kp_s_av_s_d_s_at_dHz_s_s_at_0x_x, __pyx_t_7); if (unlikely(!__pyx_t_8)) {__pyx_filename = __pyx_f[0]; __pyx_lineno = 24; __pyx_clineno = __LINE__; goto __pyx_L1_error;}
  __Pyx_GOTREF(__pyx_t_8);
  __Pyx_DECREF(__pyx_t_7); __pyx_t_7 = 0;
  __pyx_r = __pyx_t_8;
  __pyx_t_8 = 0;
  goto __pyx_L0;

  /* "av/audio/stream.pyx":23
 *         self.format = get_audio_format(self._codec_context.sample_fmt)
 * 
 *     def __repr__(self):             # <<<<<<<<<<<<<<
 *         return '<av.%s #%d %s at %dHz, %s, %s at 0x%x>' % (
 *             self.__class__.__name__,
 */

  /* function exit code */
  __pyx_L1_error:;
  __Pyx_XDECREF(__pyx_t_1);
  __Pyx_XDECREF(__pyx_t_2);
  __Pyx_XDECREF(__pyx_t_3);
  __Pyx_XDECREF(__pyx_t_4);
  __Pyx_XDECREF(__pyx_t_5);
  __Pyx_XDECREF(__pyx_t_6);
  __Pyx_XDECREF(__pyx_t_7);
  __Pyx_XDECREF(__pyx_t_8);
  __Pyx_AddTraceback("av.audio.stream.AudioStream.__repr__", __pyx_clineno, __pyx_lineno, __pyx_filename);
  __pyx_r = NULL;
  __pyx_L0:;
  __Pyx_XGIVEREF(__pyx_r);
  __Pyx_RefNannyFinishContext();
  return __pyx_r;
}

/* "av/audio/stream.pyx":36
 *     property frame_size:
 *         """Number of samples per channel in an audio frame."""
 *         def __get__(self): return self._codec_context.frame_size             # <<<<<<<<<<<<<<
 * 
 *     property rate:
 */

/* Python wrapper */
static PyObject *__pyx_pw_2av_5audio_6stream_11AudioStream_10frame_size_1__get__(PyObject *__pyx_v_self); /*proto*/
static PyObject *__pyx_pw_2av_5audio_6stream_11AudioStream_10frame_size_1__get__(PyObject *__pyx_v_self) {
  PyObject *__pyx_r = 0;
  __Pyx_RefNannyDeclarations
  __Pyx_RefNannySetupContext("__get__ (wrapper)", 0);
  __pyx_r = __pyx_pf_2av_5audio_6stream_11AudioStream_10frame_size___get__(((struct __pyx_obj_2av_5audio_6stream_AudioStream *)__pyx_v_self));

  /* function exit code */
  __Pyx_RefNannyFinishContext();
  return __pyx_r;
}

static PyObject *__pyx_pf_2av_5audio_6stream_11AudioStream_10frame_size___get__(struct __pyx_obj_2av_5audio_6stream_AudioStream *__pyx_v_self) {
  PyObject *__pyx_r = NULL;
  __Pyx_RefNannyDeclarations
  PyObject *__pyx_t_1 = NULL;
  int __pyx_lineno = 0;
  const char *__pyx_filename = NULL;
  int __pyx_clineno = 0;
  __Pyx_RefNannySetupContext("__get__", 0);
  __Pyx_XDECREF(__pyx_r);
  __pyx_t_1 = __Pyx_PyInt_From_int(__pyx_v_self->__pyx_base._codec_context->frame_size); if (unlikely(!__pyx_t_1)) {__pyx_filename = __pyx_f[0]; __pyx_lineno = 36; __pyx_clineno = __LINE__; goto __pyx_L1_error;}
  __Pyx_GOTREF(__pyx_t_1);
  __pyx_r = __pyx_t_1;
  __pyx_t_1 = 0;
  goto __pyx_L0;

  /* function exit code */
  __pyx_L1_error:;
  __Pyx_XDECREF(__pyx_t_1);
  __Pyx_AddTraceback("av.audio.stream.AudioStream.frame_size.__get__", __pyx_clineno, __pyx_lineno, __pyx_filename);
  __pyx_r = NULL;
  __pyx_L0:;
  __Pyx_XGIVEREF(__pyx_r);
  __Pyx_RefNannyFinishContext();
  return __pyx_r;
}

/* "av/audio/stream.pyx":40
 *     property rate:
 *         """samples per second """
 *         def __get__(self): return self._codec_context.sample_rate             # <<<<<<<<<<<<<<
 *         def __set__(self, int value): self._codec_context.sample_rate = value
 * 
 */

/* Python wrapper */
static PyObject *__pyx_pw_2av_5audio_6stream_11AudioStream_4rate_1__get__(PyObject *__pyx_v_self); /*proto*/
static PyObject *__pyx_pw_2av_5audio_6stream_11AudioStream_4rate_1__get__(PyObject *__pyx_v_self) {
  PyObject *__pyx_r = 0;
  __Pyx_RefNannyDeclarations
  __Pyx_RefNannySetupContext("__get__ (wrapper)", 0);
  __pyx_r = __pyx_pf_2av_5audio_6stream_11AudioStream_4rate___get__(((struct __pyx_obj_2av_5audio_6stream_AudioStream *)__pyx_v_self));

  /* function exit code */
  __Pyx_RefNannyFinishContext();
  return __pyx_r;
}

static PyObject *__pyx_pf_2av_5audio_6stream_11AudioStream_4rate___get__(struct __pyx_obj_2av_5audio_6stream_AudioStream *__pyx_v_self) {
  PyObject *__pyx_r = NULL;
  __Pyx_RefNannyDeclarations
  PyObject *__pyx_t_1 = NULL;
  int __pyx_lineno = 0;
  const char *__pyx_filename = NULL;
  int __pyx_clineno = 0;
  __Pyx_RefNannySetupContext("__get__", 0);
  __Pyx_XDECREF(__pyx_r);
  __pyx_t_1 = __Pyx_PyInt_From_int(__pyx_v_self->__pyx_base._codec_context->sample_rate); if (unlikely(!__pyx_t_1)) {__pyx_filename = __pyx_f[0]; __pyx_lineno = 40; __pyx_clineno = __LINE__; goto __pyx_L1_error;}
  __Pyx_GOTREF(__pyx_t_1);
  __pyx_r = __pyx_t_1;
  __pyx_t_1 = 0;
  goto __pyx_L0;

  /* function exit code */
  __pyx_L1_error:;
  __Pyx_XDECREF(__pyx_t_1);
  __Pyx_AddTraceback("av.audio.stream.AudioStream.rate.__get__", __pyx_clineno, __pyx_lineno, __pyx_filename);
  __pyx_r = NULL;
  __pyx_L0:;
  __Pyx_XGIVEREF(__pyx_r);
  __Pyx_RefNannyFinishContext();
  return __pyx_r;
}

/* "av/audio/stream.pyx":41
 *         """samples per second """
 *         def __get__(self): return self._codec_context.sample_rate
 *         def __set__(self, int value): self._codec_context.sample_rate = value             # <<<<<<<<<<<<<<
 * 
 *     property channels:
 */

/* Python wrapper */
static int __pyx_pw_2av_5audio_6stream_11AudioStream_4rate_3__set__(PyObject *__pyx_v_self, PyObject *__pyx_arg_value); /*proto*/
static int __pyx_pw_2av_5audio_6stream_11AudioStream_4rate_3__set__(PyObject *__pyx_v_self, PyObject *__pyx_arg_value) {
  int __pyx_v_value;
  int __pyx_lineno = 0;
  const char *__pyx_filename = NULL;
  int __pyx_clineno = 0;
  int __pyx_r;
  __Pyx_RefNannyDeclarations
  __Pyx_RefNannySetupContext("__set__ (wrapper)", 0);
  assert(__pyx_arg_value); {
    __pyx_v_value = __Pyx_PyInt_As_int(__pyx_arg_value); if (unlikely((__pyx_v_value == (int)-1) && PyErr_Occurred())) {__pyx_filename = __pyx_f[0]; __pyx_lineno = 41; __pyx_clineno = __LINE__; goto __pyx_L3_error;}
  }
  goto __pyx_L4_argument_unpacking_done;
  __pyx_L3_error:;
  __Pyx_AddTraceback("av.audio.stream.AudioStream.rate.__set__", __pyx_clineno, __pyx_lineno, __pyx_filename);
  __Pyx_RefNannyFinishContext();
  return -1;
  __pyx_L4_argument_unpacking_done:;
  __pyx_r = __pyx_pf_2av_5audio_6stream_11AudioStream_4rate_2__set__(((struct __pyx_obj_2av_5audio_6stream_AudioStream *)__pyx_v_self), ((int)__pyx_v_value));

  /* function exit code */
  __Pyx_RefNannyFinishContext();
  return __pyx_r;
}

static int __pyx_pf_2av_5audio_6stream_11AudioStream_4rate_2__set__(struct __pyx_obj_2av_5audio_6stream_AudioStream *__pyx_v_self, int __pyx_v_value) {
  int __pyx_r;
  __Pyx_RefNannyDeclarations
  __Pyx_RefNannySetupContext("__set__", 0);
  __pyx_v_self->__pyx_base._codec_context->sample_rate = __pyx_v_value;

  /* function exit code */
  __pyx_r = 0;
  __Pyx_RefNannyFinishContext();
  return __pyx_r;
}

/* "av/audio/stream.pyx":44
 * 
 *     property channels:
 *         def __get__(self):             # <<<<<<<<<<<<<<
 *             return self._codec_context.channels
 * 
 */

/* Python wrapper */
static PyObject *__pyx_pw_2av_5audio_6stream_11AudioStream_8channels_1__get__(PyObject *__pyx_v_self); /*proto*/
static PyObject *__pyx_pw_2av_5audio_6stream_11AudioStream_8channels_1__get__(PyObject *__pyx_v_self) {
  PyObject *__pyx_r = 0;
  __Pyx_RefNannyDeclarations
  __Pyx_RefNannySetupContext("__get__ (wrapper)", 0);
  __pyx_r = __pyx_pf_2av_5audio_6stream_11AudioStream_8channels___get__(((struct __pyx_obj_2av_5audio_6stream_AudioStream *)__pyx_v_self));

  /* function exit code */
  __Pyx_RefNannyFinishContext();
  return __pyx_r;
}

static PyObject *__pyx_pf_2av_5audio_6stream_11AudioStream_8channels___get__(struct __pyx_obj_2av_5audio_6stream_AudioStream *__pyx_v_self) {
  PyObject *__pyx_r = NULL;
  __Pyx_RefNannyDeclarations
  PyObject *__pyx_t_1 = NULL;
  int __pyx_lineno = 0;
  const char *__pyx_filename = NULL;
  int __pyx_clineno = 0;
  __Pyx_RefNannySetupContext("__get__", 0);

  /* "av/audio/stream.pyx":45
 *     property channels:
 *         def __get__(self):
 *             return self._codec_context.channels             # <<<<<<<<<<<<<<
 * 
 *     cdef _decode_one(self, lib.AVPacket *packet, int *data_consumed):
 */
  __Pyx_XDECREF(__pyx_r);
  __pyx_t_1 = __Pyx_PyInt_From_int(__pyx_v_self->__pyx_base._codec_context->channels); if (unlikely(!__pyx_t_1)) {__pyx_filename = __pyx_f[0]; __pyx_lineno = 45; __pyx_clineno = __LINE__; goto __pyx_L1_error;}
  __Pyx_GOTREF(__pyx_t_1);
  __pyx_r = __pyx_t_1;
  __pyx_t_1 = 0;
  goto __pyx_L0;

  /* "av/audio/stream.pyx":44
 * 
 *     property channels:
 *         def __get__(self):             # <<<<<<<<<<<<<<
 *             return self._codec_context.channels
 * 
 */

  /* function exit code */
  __pyx_L1_error:;
  __Pyx_XDECREF(__pyx_t_1);
  __Pyx_AddTraceback("av.audio.stream.AudioStream.channels.__get__", __pyx_clineno, __pyx_lineno, __pyx_filename);
  __pyx_r = NULL;
  __pyx_L0:;
  __Pyx_XGIVEREF(__pyx_r);
  __Pyx_RefNannyFinishContext();
  return __pyx_r;
}

/* "av/audio/stream.pyx":47
 *             return self._codec_context.channels
 * 
 *     cdef _decode_one(self, lib.AVPacket *packet, int *data_consumed):             # <<<<<<<<<<<<<<
 * 
 *         if not self.next_frame:
 */

static PyObject *__pyx_f_2av_5audio_6stream_11AudioStream__decode_one(struct __pyx_obj_2av_5audio_6stream_AudioStream *__pyx_v_self, struct AVPacket *__pyx_v_packet, int *__pyx_v_data_consumed) {
  int __pyx_v_completed_frame;
  struct __pyx_obj_2av_5audio_5frame_AudioFrame *__pyx_v_frame = 0;
  PyObject *__pyx_r = NULL;
  __Pyx_RefNannyDeclarations
  int __pyx_t_1;
  int __pyx_t_2;
  PyObject *__pyx_t_3 = NULL;
  int __pyx_t_4;
  int __pyx_lineno = 0;
  const char *__pyx_filename = NULL;
  int __pyx_clineno = 0;
  __Pyx_RefNannySetupContext("_decode_one", 0);

  /* "av/audio/stream.pyx":49
 *     cdef _decode_one(self, lib.AVPacket *packet, int *data_consumed):
 * 
 *         if not self.next_frame:             # <<<<<<<<<<<<<<
 *             self.next_frame = alloc_audio_frame()
 * 
 */
  __pyx_t_1 = __Pyx_PyObject_IsTrue(((PyObject *)__pyx_v_self->next_frame)); if (unlikely(__pyx_t_1 < 0)) {__pyx_filename = __pyx_f[0]; __pyx_lineno = 49; __pyx_clineno = __LINE__; goto __pyx_L1_error;}
  __pyx_t_2 = ((!__pyx_t_1) != 0);
  if (__pyx_t_2) {

    /* "av/audio/stream.pyx":50
 * 
 *         if not self.next_frame:
 *             self.next_frame = alloc_audio_frame()             # <<<<<<<<<<<<<<
 * 
 *         cdef int completed_frame = 0
 */
    __pyx_t_3 = ((PyObject *)__pyx_f_2av_5audio_5frame_alloc_audio_frame()); if (unlikely(!__pyx_t_3)) {__pyx_filename = __pyx_f[0]; __pyx_lineno = 50; __pyx_clineno = __LINE__; goto __pyx_L1_error;}
    __Pyx_GOTREF(__pyx_t_3);
    __Pyx_GIVEREF(__pyx_t_3);
    __Pyx_GOTREF(__pyx_v_self->next_frame);
    __Pyx_DECREF(((PyObject *)__pyx_v_self->next_frame));
    __pyx_v_self->next_frame = ((struct __pyx_obj_2av_5audio_5frame_AudioFrame *)__pyx_t_3);
    __pyx_t_3 = 0;
    goto __pyx_L3;
  }
  __pyx_L3:;

  /* "av/audio/stream.pyx":52
 *             self.next_frame = alloc_audio_frame()
 * 
 *         cdef int completed_frame = 0             # <<<<<<<<<<<<<<
 *         data_consumed[0] = err_check(lib.avcodec_decode_audio4(self._codec_context, self.next_frame.ptr, &completed_frame, packet))
 *         if not completed_frame:
 */
  __pyx_v_completed_frame = 0;

  /* "av/audio/stream.pyx":53
 * 
 *         cdef int completed_frame = 0
 *         data_consumed[0] = err_check(lib.avcodec_decode_audio4(self._codec_context, self.next_frame.ptr, &completed_frame, packet))             # <<<<<<<<<<<<<<
 *         if not completed_frame:
 *             return
 */
  __pyx_t_4 = __pyx_f_2av_5utils_err_check(avcodec_decode_audio4(__pyx_v_self->__pyx_base._codec_context, __pyx_v_self->next_frame->__pyx_base.ptr, (&__pyx_v_completed_frame), __pyx_v_packet), NULL); if (unlikely(__pyx_t_4 == -1)) {__pyx_filename = __pyx_f[0]; __pyx_lineno = 53; __pyx_clineno = __LINE__; goto __pyx_L1_error;}
  (__pyx_v_data_consumed[0]) = __pyx_t_4;

  /* "av/audio/stream.pyx":54
 *         cdef int completed_frame = 0
 *         data_consumed[0] = err_check(lib.avcodec_decode_audio4(self._codec_context, self.next_frame.ptr, &completed_frame, packet))
 *         if not completed_frame:             # <<<<<<<<<<<<<<
 *             return
 * 
 */
  __pyx_t_2 = ((!(__pyx_v_completed_frame != 0)) != 0);
  if (__pyx_t_2) {

    /* "av/audio/stream.pyx":55
 *         data_consumed[0] = err_check(lib.avcodec_decode_audio4(self._codec_context, self.next_frame.ptr, &completed_frame, packet))
 *         if not completed_frame:
 *             return             # <<<<<<<<<<<<<<
 * 
 *         cdef AudioFrame frame = self.next_frame
 */
    __Pyx_XDECREF(__pyx_r);
    __pyx_r = Py_None; __Pyx_INCREF(Py_None);
    goto __pyx_L0;
  }

  /* "av/audio/stream.pyx":57
 *             return
 * 
 *         cdef AudioFrame frame = self.next_frame             # <<<<<<<<<<<<<<
 *         self.next_frame = None
 * 
 */
  __pyx_t_3 = ((PyObject *)__pyx_v_self->next_frame);
  __Pyx_INCREF(__pyx_t_3);
  __pyx_v_frame = ((struct __pyx_obj_2av_5audio_5frame_AudioFrame *)__pyx_t_3);
  __pyx_t_3 = 0;

  /* "av/audio/stream.pyx":58
 * 
 *         cdef AudioFrame frame = self.next_frame
 *         self.next_frame = None             # <<<<<<<<<<<<<<
 * 
 *         frame._init_properties()
 */
  __Pyx_INCREF(Py_None);
  __Pyx_GIVEREF(Py_None);
  __Pyx_GOTREF(__pyx_v_self->next_frame);
  __Pyx_DECREF(((PyObject *)__pyx_v_self->next_frame));
  __pyx_v_self->next_frame = ((struct __pyx_obj_2av_5audio_5frame_AudioFrame *)Py_None);

  /* "av/audio/stream.pyx":60
 *         self.next_frame = None
 * 
 *         frame._init_properties()             # <<<<<<<<<<<<<<
 * 
 *         return frame
 */
  __pyx_t_3 = ((struct __pyx_vtabstruct_2av_5audio_5frame_AudioFrame *)__pyx_v_frame->__pyx_base.__pyx_vtab)->_init_properties(__pyx_v_frame); if (unlikely(!__pyx_t_3)) {__pyx_filename = __pyx_f[0]; __pyx_lineno = 60; __pyx_clineno = __LINE__; goto __pyx_L1_error;}
  __Pyx_GOTREF(__pyx_t_3);
  __Pyx_DECREF(__pyx_t_3); __pyx_t_3 = 0;

  /* "av/audio/stream.pyx":62
 *         frame._init_properties()
 * 
 *         return frame             # <<<<<<<<<<<<<<
 * 
 *     cpdef encode(self, AudioFrame input_frame):
 */
  __Pyx_XDECREF(__pyx_r);
  __Pyx_INCREF(((PyObject *)__pyx_v_frame));
  __pyx_r = ((PyObject *)__pyx_v_frame);
  goto __pyx_L0;

  /* "av/audio/stream.pyx":47
 *             return self._codec_context.channels
 * 
 *     cdef _decode_one(self, lib.AVPacket *packet, int *data_consumed):             # <<<<<<<<<<<<<<
 * 
 *         if not self.next_frame:
 */

  /* function exit code */
  __pyx_L1_error:;
  __Pyx_XDECREF(__pyx_t_3);
  __Pyx_AddTraceback("av.audio.stream.AudioStream._decode_one", __pyx_clineno, __pyx_lineno, __pyx_filename);
  __pyx_r = 0;
  __pyx_L0:;
  __Pyx_XDECREF((PyObject *)__pyx_v_frame);
  __Pyx_XGIVEREF(__pyx_r);
  __Pyx_RefNannyFinishContext();
  return __pyx_r;
}

/* "av/audio/stream.pyx":64
 *         return frame
 * 
 *     cpdef encode(self, AudioFrame input_frame):             # <<<<<<<<<<<<<<
 *         """Encodes a frame of audio, returns a packet if one is ready.
 *         The output packet does not necessarily contain data for the most recent frame,
 */

static PyObject *__pyx_pw_2av_5audio_6stream_11AudioStream_3encode(PyObject *__pyx_v_self, PyObject *__pyx_v_input_frame); /*proto*/
static PyObject *__pyx_f_2av_5audio_6stream_11AudioStream_encode(struct __pyx_obj_2av_5audio_6stream_AudioStream *__pyx_v_self, struct __pyx_obj_2av_5audio_5frame_AudioFrame *__pyx_v_input_frame, int __pyx_skip_dispatch) {
  struct __pyx_obj_2av_5audio_5frame_AudioFrame *__pyx_v_resampled_frame = 0;
  struct __pyx_obj_2av_5audio_5frame_AudioFrame *__pyx_v_fifo_frame = 0;
  struct __pyx_obj_2av_6packet_Packet *__pyx_v_packet = 0;
  int __pyx_v_got_packet;
  PyObject *__pyx_r = NULL;
  __Pyx_RefNannyDeclarations
  PyObject *__pyx_t_1 = NULL;
  PyObject *__pyx_t_2 = NULL;
  PyObject *__pyx_t_3 = NULL;
  int __pyx_t_4;
  int __pyx_t_5;
  struct __pyx_opt_args_2av_5audio_4fifo_9AudioFifo_read __pyx_t_6;
  struct AVFrame *__pyx_t_7;
  int __pyx_t_8;
  int __pyx_lineno = 0;
  const char *__pyx_filename = NULL;
  int __pyx_clineno = 0;
  __Pyx_RefNannySetupContext("encode", 0);
  /* Check if called by wrapper */
  if (unlikely(__pyx_skip_dispatch)) ;
  /* Check if overridden in Python */
  else if (unlikely(Py_TYPE(((PyObject *)__pyx_v_self))->tp_dictoffset != 0)) {
    __pyx_t_1 = __Pyx_PyObject_GetAttrStr(((PyObject *)__pyx_v_self), __pyx_n_s_encode); if (unlikely(!__pyx_t_1)) {__pyx_filename = __pyx_f[0]; __pyx_lineno = 64; __pyx_clineno = __LINE__; goto __pyx_L1_error;}
    __Pyx_GOTREF(__pyx_t_1);
    if (!PyCFunction_Check(__pyx_t_1) || (PyCFunction_GET_FUNCTION(__pyx_t_1) != (PyCFunction)__pyx_pw_2av_5audio_6stream_11AudioStream_3encode)) {
      __Pyx_XDECREF(__pyx_r);
      __pyx_t_2 = PyTuple_New(1); if (unlikely(!__pyx_t_2)) {__pyx_filename = __pyx_f[0]; __pyx_lineno = 64; __pyx_clineno = __LINE__; goto __pyx_L1_error;}
      __Pyx_GOTREF(__pyx_t_2);
      __Pyx_INCREF(((PyObject *)__pyx_v_input_frame));
      PyTuple_SET_ITEM(__pyx_t_2, 0, ((PyObject *)__pyx_v_input_frame));
      __Pyx_GIVEREF(((PyObject *)__pyx_v_input_frame));
      __pyx_t_3 = __Pyx_PyObject_Call(__pyx_t_1, __pyx_t_2, NULL); if (unlikely(!__pyx_t_3)) {__pyx_filename = __pyx_f[0]; __pyx_lineno = 64; __pyx_clineno = __LINE__; goto __pyx_L1_error;}
      __Pyx_GOTREF(__pyx_t_3);
      __Pyx_DECREF(__pyx_t_2); __pyx_t_2 = 0;
      __pyx_r = __pyx_t_3;
      __pyx_t_3 = 0;
      __Pyx_DECREF(__pyx_t_1); __pyx_t_1 = 0;
      goto __pyx_L0;
    }
    __Pyx_DECREF(__pyx_t_1); __pyx_t_1 = 0;
  }

  /* "av/audio/stream.pyx":72
 *         """
 * 
 *         self._weak_container().start_encoding()             # <<<<<<<<<<<<<<
 *         if not self.resampler:
 *             self.resampler = AudioResampler(
 */
  __pyx_t_1 = __Pyx_PyObject_Call(__pyx_v_self->__pyx_base._weak_container, __pyx_empty_tuple, NULL); if (unlikely(!__pyx_t_1)) {__pyx_filename = __pyx_f[0]; __pyx_lineno = 72; __pyx_clineno = __LINE__; goto __pyx_L1_error;}
  __Pyx_GOTREF(__pyx_t_1);
  __pyx_t_3 = __Pyx_PyObject_GetAttrStr(__pyx_t_1, __pyx_n_s_start_encoding); if (unlikely(!__pyx_t_3)) {__pyx_filename = __pyx_f[0]; __pyx_lineno = 72; __pyx_clineno = __LINE__; goto __pyx_L1_error;}
  __Pyx_GOTREF(__pyx_t_3);
  __Pyx_DECREF(__pyx_t_1); __pyx_t_1 = 0;
  __pyx_t_1 = __Pyx_PyObject_Call(__pyx_t_3, __pyx_empty_tuple, NULL); if (unlikely(!__pyx_t_1)) {__pyx_filename = __pyx_f[0]; __pyx_lineno = 72; __pyx_clineno = __LINE__; goto __pyx_L1_error;}
  __Pyx_GOTREF(__pyx_t_1);
  __Pyx_DECREF(__pyx_t_3); __pyx_t_3 = 0;
  __Pyx_DECREF(__pyx_t_1); __pyx_t_1 = 0;

  /* "av/audio/stream.pyx":73
 * 
 *         self._weak_container().start_encoding()
 *         if not self.resampler:             # <<<<<<<<<<<<<<
 *             self.resampler = AudioResampler(
 *                 self.format,
 */
  __pyx_t_4 = __Pyx_PyObject_IsTrue(((PyObject *)__pyx_v_self->resampler)); if (unlikely(__pyx_t_4 < 0)) {__pyx_filename = __pyx_f[0]; __pyx_lineno = 73; __pyx_clineno = __LINE__; goto __pyx_L1_error;}
  __pyx_t_5 = ((!__pyx_t_4) != 0);
  if (__pyx_t_5) {

    /* "av/audio/stream.pyx":77
 *                 self.format,
 *                 self.layout,
 *                 self._codec_context.sample_rate             # <<<<<<<<<<<<<<
 *             )
 *         if not self.fifo:
 */
    __pyx_t_1 = __Pyx_PyInt_From_int(__pyx_v_self->__pyx_base._codec_context->sample_rate); if (unlikely(!__pyx_t_1)) {__pyx_filename = __pyx_f[0]; __pyx_lineno = 77; __pyx_clineno = __LINE__; goto __pyx_L1_error;}
    __Pyx_GOTREF(__pyx_t_1);

    /* "av/audio/stream.pyx":74
 *         self._weak_container().start_encoding()
 *         if not self.resampler:
 *             self.resampler = AudioResampler(             # <<<<<<<<<<<<<<
 *                 self.format,
 *                 self.layout,
 */
    __pyx_t_3 = PyTuple_New(3); if (unlikely(!__pyx_t_3)) {__pyx_filename = __pyx_f[0]; __pyx_lineno = 74; __pyx_clineno = __LINE__; goto __pyx_L1_error;}
    __Pyx_GOTREF(__pyx_t_3);
    __Pyx_INCREF(((PyObject *)__pyx_v_self->format));
    PyTuple_SET_ITEM(__pyx_t_3, 0, ((PyObject *)__pyx_v_self->format));
    __Pyx_GIVEREF(((PyObject *)__pyx_v_self->format));
    __Pyx_INCREF(((PyObject *)__pyx_v_self->layout));
    PyTuple_SET_ITEM(__pyx_t_3, 1, ((PyObject *)__pyx_v_self->layout));
    __Pyx_GIVEREF(((PyObject *)__pyx_v_self->layout));
    PyTuple_SET_ITEM(__pyx_t_3, 2, __pyx_t_1);
    __Pyx_GIVEREF(__pyx_t_1);
    __pyx_t_1 = 0;
    __pyx_t_1 = __Pyx_PyObject_Call(((PyObject *)((PyObject*)__pyx_ptype_2av_5audio_9resampler_AudioResampler)), __pyx_t_3, NULL); if (unlikely(!__pyx_t_1)) {__pyx_filename = __pyx_f[0]; __pyx_lineno = 74; __pyx_clineno = __LINE__; goto __pyx_L1_error;}
    __Pyx_GOTREF(__pyx_t_1);
    __Pyx_DECREF(__pyx_t_3); __pyx_t_3 = 0;
    __Pyx_GIVEREF(__pyx_t_1);
    __Pyx_GOTREF(__pyx_v_self->resampler);
    __Pyx_DECREF(((PyObject *)__pyx_v_self->resampler));
    __pyx_v_self->resampler = ((struct __pyx_obj_2av_5audio_9resampler_AudioResampler *)__pyx_t_1);
    __pyx_t_1 = 0;
    goto __pyx_L3;
  }
  __pyx_L3:;

  /* "av/audio/stream.pyx":79
 *                 self._codec_context.sample_rate
 *             )
 *         if not self.fifo:             # <<<<<<<<<<<<<<
 *             self.fifo = AudioFifo()
 * 
 */
  __pyx_t_5 = __Pyx_PyObject_IsTrue(((PyObject *)__pyx_v_self->fifo)); if (unlikely(__pyx_t_5 < 0)) {__pyx_filename = __pyx_f[0]; __pyx_lineno = 79; __pyx_clineno = __LINE__; goto __pyx_L1_error;}
  __pyx_t_4 = ((!__pyx_t_5) != 0);
  if (__pyx_t_4) {

    /* "av/audio/stream.pyx":80
 *             )
 *         if not self.fifo:
 *             self.fifo = AudioFifo()             # <<<<<<<<<<<<<<
 * 
 *         # if input_frame:
 */
    __pyx_t_1 = __Pyx_PyObject_Call(((PyObject *)((PyObject*)__pyx_ptype_2av_5audio_4fifo_AudioFifo)), __pyx_empty_tuple, NULL); if (unlikely(!__pyx_t_1)) {__pyx_filename = __pyx_f[0]; __pyx_lineno = 80; __pyx_clineno = __LINE__; goto __pyx_L1_error;}
    __Pyx_GOTREF(__pyx_t_1);
    __Pyx_GIVEREF(__pyx_t_1);
    __Pyx_GOTREF(__pyx_v_self->fifo);
    __Pyx_DECREF(((PyObject *)__pyx_v_self->fifo));
    __pyx_v_self->fifo = ((struct __pyx_obj_2av_5audio_4fifo_AudioFifo *)__pyx_t_1);
    __pyx_t_1 = 0;
    goto __pyx_L4;
  }
  __pyx_L4:;

  /* "av/audio/stream.pyx":87
 *         # Resample, and re-chunk. A None frame will flush the resampler,
 *         # and then flush the fifo.
 *         cdef AudioFrame resampled_frame = self.resampler.resample(input_frame)             # <<<<<<<<<<<<<<
 *         if resampled_frame:
 *             self.fifo.write(resampled_frame)
 */
  __pyx_t_1 = ((struct __pyx_vtabstruct_2av_5audio_9resampler_AudioResampler *)__pyx_v_self->resampler->__pyx_vtab)->resample(__pyx_v_self->resampler, __pyx_v_input_frame, 0); if (unlikely(!__pyx_t_1)) {__pyx_filename = __pyx_f[0]; __pyx_lineno = 87; __pyx_clineno = __LINE__; goto __pyx_L1_error;}
  __Pyx_GOTREF(__pyx_t_1);
  if (!(likely(((__pyx_t_1) == Py_None) || likely(__Pyx_TypeTest(__pyx_t_1, __pyx_ptype_2av_5audio_5frame_AudioFrame))))) {__pyx_filename = __pyx_f[0]; __pyx_lineno = 87; __pyx_clineno = __LINE__; goto __pyx_L1_error;}
  __pyx_v_resampled_frame = ((struct __pyx_obj_2av_5audio_5frame_AudioFrame *)__pyx_t_1);
  __pyx_t_1 = 0;

  /* "av/audio/stream.pyx":88
 *         # and then flush the fifo.
 *         cdef AudioFrame resampled_frame = self.resampler.resample(input_frame)
 *         if resampled_frame:             # <<<<<<<<<<<<<<
 *             self.fifo.write(resampled_frame)
 *             # print 'resampled_frame.ptr.pts', resampled_frame.ptr.pts
 */
  __pyx_t_4 = __Pyx_PyObject_IsTrue(((PyObject *)__pyx_v_resampled_frame)); if (unlikely(__pyx_t_4 < 0)) {__pyx_filename = __pyx_f[0]; __pyx_lineno = 88; __pyx_clineno = __LINE__; goto __pyx_L1_error;}
  if (__pyx_t_4) {

    /* "av/audio/stream.pyx":89
 *         cdef AudioFrame resampled_frame = self.resampler.resample(input_frame)
 *         if resampled_frame:
 *             self.fifo.write(resampled_frame)             # <<<<<<<<<<<<<<
 *             # print 'resampled_frame.ptr.pts', resampled_frame.ptr.pts
 * 
 */
    __pyx_t_1 = ((struct __pyx_vtabstruct_2av_5audio_4fifo_AudioFifo *)__pyx_v_self->fifo->__pyx_vtab)->write(__pyx_v_self->fifo, __pyx_v_resampled_frame, 0); if (unlikely(!__pyx_t_1)) {__pyx_filename = __pyx_f[0]; __pyx_lineno = 89; __pyx_clineno = __LINE__; goto __pyx_L1_error;}
    __Pyx_GOTREF(__pyx_t_1);
    __Pyx_DECREF(__pyx_t_1); __pyx_t_1 = 0;
    goto __pyx_L5;
  }
  __pyx_L5:;

  /* "av/audio/stream.pyx":93
 * 
 *         # Pull partial frames if we were requested to flush (via a None frame).
 *         cdef AudioFrame fifo_frame = self.fifo.read(self._codec_context.frame_size, partial=input_frame is None)             # <<<<<<<<<<<<<<
 * 
 *         cdef Packet packet = Packet()
 */
  __pyx_t_4 = (((PyObject *)__pyx_v_input_frame) == Py_None);
  __pyx_t_6.__pyx_n = 2;
  __pyx_t_6.nb_samples = __pyx_v_self->__pyx_base._codec_context->frame_size;
  __pyx_t_6.partial = __pyx_t_4;
  __pyx_t_1 = ((struct __pyx_vtabstruct_2av_5audio_4fifo_AudioFifo *)__pyx_v_self->fifo->__pyx_vtab)->read(__pyx_v_self->fifo, 0, &__pyx_t_6); if (unlikely(!__pyx_t_1)) {__pyx_filename = __pyx_f[0]; __pyx_lineno = 93; __pyx_clineno = __LINE__; goto __pyx_L1_error;}
  __Pyx_GOTREF(__pyx_t_1);
  if (!(likely(((__pyx_t_1) == Py_None) || likely(__Pyx_TypeTest(__pyx_t_1, __pyx_ptype_2av_5audio_5frame_AudioFrame))))) {__pyx_filename = __pyx_f[0]; __pyx_lineno = 93; __pyx_clineno = __LINE__; goto __pyx_L1_error;}
  __pyx_v_fifo_frame = ((struct __pyx_obj_2av_5audio_5frame_AudioFrame *)__pyx_t_1);
  __pyx_t_1 = 0;

  /* "av/audio/stream.pyx":95
 *         cdef AudioFrame fifo_frame = self.fifo.read(self._codec_context.frame_size, partial=input_frame is None)
 * 
 *         cdef Packet packet = Packet()             # <<<<<<<<<<<<<<
 *         cdef int got_packet = 0
 * 
 */
  __pyx_t_1 = __Pyx_PyObject_Call(((PyObject *)((PyObject*)__pyx_ptype_2av_6packet_Packet)), __pyx_empty_tuple, NULL); if (unlikely(!__pyx_t_1)) {__pyx_filename = __pyx_f[0]; __pyx_lineno = 95; __pyx_clineno = __LINE__; goto __pyx_L1_error;}
  __Pyx_GOTREF(__pyx_t_1);
  __pyx_v_packet = ((struct __pyx_obj_2av_6packet_Packet *)__pyx_t_1);
  __pyx_t_1 = 0;

  /* "av/audio/stream.pyx":96
 * 
 *         cdef Packet packet = Packet()
 *         cdef int got_packet = 0             # <<<<<<<<<<<<<<
 * 
 *         if fifo_frame:
 */
  __pyx_v_got_packet = 0;

  /* "av/audio/stream.pyx":98
 *         cdef int got_packet = 0
 * 
 *         if fifo_frame:             # <<<<<<<<<<<<<<
 * 
 *             # If the fifo_frame has a valid pts, scale it to the codec's time_base.
 */
  __pyx_t_4 = __Pyx_PyObject_IsTrue(((PyObject *)__pyx_v_fifo_frame)); if (unlikely(__pyx_t_4 < 0)) {__pyx_filename = __pyx_f[0]; __pyx_lineno = 98; __pyx_clineno = __LINE__; goto __pyx_L1_error;}
  if (__pyx_t_4) {

    /* "av/audio/stream.pyx":102
 *             # If the fifo_frame has a valid pts, scale it to the codec's time_base.
 *             # Remember that the AudioFifo time_base is always 1/sample_rate!
 *             if fifo_frame.ptr.pts != lib.AV_NOPTS_VALUE:             # <<<<<<<<<<<<<<
 *                 fifo_frame.ptr.pts = lib.av_rescale_q(
 *                     fifo_frame.ptr.pts,
 */
    __pyx_t_4 = ((__pyx_v_fifo_frame->__pyx_base.ptr->pts != AV_NOPTS_VALUE) != 0);
    if (__pyx_t_4) {

      /* "av/audio/stream.pyx":103
 *             # Remember that the AudioFifo time_base is always 1/sample_rate!
 *             if fifo_frame.ptr.pts != lib.AV_NOPTS_VALUE:
 *                 fifo_frame.ptr.pts = lib.av_rescale_q(             # <<<<<<<<<<<<<<
 *                     fifo_frame.ptr.pts,
 *                     fifo_frame.time_base,
 */
      __pyx_v_fifo_frame->__pyx_base.ptr->pts = av_rescale_q(__pyx_v_fifo_frame->__pyx_base.ptr->pts, __pyx_v_fifo_frame->__pyx_base.time_base, __pyx_v_self->__pyx_base._codec_context->time_base);
      goto __pyx_L7;
    }
    /*else*/ {

      /* "av/audio/stream.pyx":109
 *                 )
 *             else:
 *                 fifo_frame.ptr.pts = lib.av_rescale(             # <<<<<<<<<<<<<<
 *                     self._codec_context.frame_number,
 *                     self._codec_context.sample_rate,
 */
      __pyx_v_fifo_frame->__pyx_base.ptr->pts = av_rescale(__pyx_v_self->__pyx_base._codec_context->frame_number, __pyx_v_self->__pyx_base._codec_context->sample_rate, __pyx_v_self->__pyx_base._codec_context->frame_size);
    }
    __pyx_L7:;
    goto __pyx_L6;
  }
  __pyx_L6:;

  /* "av/audio/stream.pyx":120
 *             self._codec_context,
 *             &packet.struct,
 *             fifo_frame.ptr if fifo_frame is not None else NULL,             # <<<<<<<<<<<<<<
 *             &got_packet,
 *         ))
 */
  __pyx_t_4 = (((PyObject *)__pyx_v_fifo_frame) != Py_None);
  if ((__pyx_t_4 != 0)) {
    __pyx_t_7 = __pyx_v_fifo_frame->__pyx_base.ptr;
  } else {
    __pyx_t_7 = NULL;
  }

  /* "av/audio/stream.pyx":117
 *         # print 'fifo_frame.ptr.pts', fifo_frame.ptr.pts if fifo_frame else None
 * 
 *         err_check(lib.avcodec_encode_audio2(             # <<<<<<<<<<<<<<
 *             self._codec_context,
 *             &packet.struct,
 */
  __pyx_t_8 = __pyx_f_2av_5utils_err_check(avcodec_encode_audio2(__pyx_v_self->__pyx_base._codec_context, (&__pyx_v_packet->__pyx_struct), __pyx_t_7, (&__pyx_v_got_packet)), NULL); if (unlikely(__pyx_t_8 == -1)) {__pyx_filename = __pyx_f[0]; __pyx_lineno = 117; __pyx_clineno = __LINE__; goto __pyx_L1_error;}

  /* "av/audio/stream.pyx":126
 *         # print 'packet', packet if got_packet else None
 * 
 *         if not got_packet:             # <<<<<<<<<<<<<<
 *             return
 * 
 */
  __pyx_t_4 = ((!(__pyx_v_got_packet != 0)) != 0);
  if (__pyx_t_4) {

    /* "av/audio/stream.pyx":127
 * 
 *         if not got_packet:
 *             return             # <<<<<<<<<<<<<<
 * 
 * 
 */
    __Pyx_XDECREF(__pyx_r);
    __pyx_r = Py_None; __Pyx_INCREF(Py_None);
    goto __pyx_L0;
  }

  /* "av/audio/stream.pyx":132
 *         # Rescale some times which are in the codec's time_base to the
 *         # stream's time_base.
 *         if packet.struct.pts != lib.AV_NOPTS_VALUE:             # <<<<<<<<<<<<<<
 *             packet.struct.pts = lib.av_rescale_q(
 *                 packet.struct.pts,
 */
  __pyx_t_4 = ((__pyx_v_packet->__pyx_struct.pts != AV_NOPTS_VALUE) != 0);
  if (__pyx_t_4) {

    /* "av/audio/stream.pyx":133
 *         # stream's time_base.
 *         if packet.struct.pts != lib.AV_NOPTS_VALUE:
 *             packet.struct.pts = lib.av_rescale_q(             # <<<<<<<<<<<<<<
 *                 packet.struct.pts,
 *                 self._codec_context.time_base,
 */
    __pyx_v_packet->__pyx_struct.pts = av_rescale_q(__pyx_v_packet->__pyx_struct.pts, __pyx_v_self->__pyx_base._codec_context->time_base, __pyx_v_self->__pyx_base._stream->time_base);
    goto __pyx_L9;
  }
  __pyx_L9:;

  /* "av/audio/stream.pyx":138
 *                 self._stream.time_base
 *             )
 *         if packet.struct.dts != lib.AV_NOPTS_VALUE:             # <<<<<<<<<<<<<<
 *             packet.struct.dts = lib.av_rescale_q(
 *                 packet.struct.dts,
 */
  __pyx_t_4 = ((__pyx_v_packet->__pyx_struct.dts != AV_NOPTS_VALUE) != 0);
  if (__pyx_t_4) {

    /* "av/audio/stream.pyx":139
 *             )
 *         if packet.struct.dts != lib.AV_NOPTS_VALUE:
 *             packet.struct.dts = lib.av_rescale_q(             # <<<<<<<<<<<<<<
 *                 packet.struct.dts,
 *                 self._codec_context.time_base,
 */
    __pyx_v_packet->__pyx_struct.dts = av_rescale_q(__pyx_v_packet->__pyx_struct.dts, __pyx_v_self->__pyx_base._codec_context->time_base, __pyx_v_self->__pyx_base._stream->time_base);
    goto __pyx_L10;
  }
  __pyx_L10:;

  /* "av/audio/stream.pyx":144
 *                 self._stream.time_base
 *             )
 *         if packet.struct.duration > 0:             # <<<<<<<<<<<<<<
 *             packet.struct.duration = lib.av_rescale_q(
 *                 packet.struct.duration,
 */
  __pyx_t_4 = ((__pyx_v_packet->__pyx_struct.duration > 0) != 0);
  if (__pyx_t_4) {

    /* "av/audio/stream.pyx":145
 *             )
 *         if packet.struct.duration > 0:
 *             packet.struct.duration = lib.av_rescale_q(             # <<<<<<<<<<<<<<
 *                 packet.struct.duration,
 *                 self._codec_context.time_base,
 */
    __pyx_v_packet->__pyx_struct.duration = av_rescale_q(__pyx_v_packet->__pyx_struct.duration, __pyx_v_self->__pyx_base._codec_context->time_base, __pyx_v_self->__pyx_base._stream->time_base);
    goto __pyx_L11;
  }
  __pyx_L11:;

  /* "av/audio/stream.pyx":151
 *             )
 * 
 *         if self._codec_context.coded_frame.key_frame:             # <<<<<<<<<<<<<<
 *             packet.struct.flags |= lib.AV_PKT_FLAG_KEY
 * 
 */
  __pyx_t_4 = (__pyx_v_self->__pyx_base._codec_context->coded_frame->key_frame != 0);
  if (__pyx_t_4) {

    /* "av/audio/stream.pyx":152
 * 
 *         if self._codec_context.coded_frame.key_frame:
 *             packet.struct.flags |= lib.AV_PKT_FLAG_KEY             # <<<<<<<<<<<<<<
 * 
 *         packet.struct.stream_index = self._stream.index
 */
    __pyx_v_packet->__pyx_struct.flags = (__pyx_v_packet->__pyx_struct.flags | AV_PKT_FLAG_KEY);
    goto __pyx_L12;
  }
  __pyx_L12:;

  /* "av/audio/stream.pyx":154
 *             packet.struct.flags |= lib.AV_PKT_FLAG_KEY
 * 
 *         packet.struct.stream_index = self._stream.index             # <<<<<<<<<<<<<<
 *         packet.stream = self
 * 
 */
  __pyx_t_8 = __pyx_v_self->__pyx_base._stream->index;
  __pyx_v_packet->__pyx_struct.stream_index = __pyx_t_8;

  /* "av/audio/stream.pyx":155
 * 
 *         packet.struct.stream_index = self._stream.index
 *         packet.stream = self             # <<<<<<<<<<<<<<
 * 
 *         return packet
 */
  __Pyx_INCREF(((PyObject *)__pyx_v_self));
  __Pyx_GIVEREF(((PyObject *)__pyx_v_self));
  __Pyx_GOTREF(__pyx_v_packet->stream);
  __Pyx_DECREF(((PyObject *)__pyx_v_packet->stream));
  __pyx_v_packet->stream = ((struct __pyx_obj_2av_6stream_Stream *)__pyx_v_self);

  /* "av/audio/stream.pyx":157
 *         packet.stream = self
 * 
 *         return packet             # <<<<<<<<<<<<<<
 * 
 * 
 */
  __Pyx_XDECREF(__pyx_r);
  __Pyx_INCREF(((PyObject *)__pyx_v_packet));
  __pyx_r = ((PyObject *)__pyx_v_packet);
  goto __pyx_L0;

  /* "av/audio/stream.pyx":64
 *         return frame
 * 
 *     cpdef encode(self, AudioFrame input_frame):             # <<<<<<<<<<<<<<
 *         """Encodes a frame of audio, returns a packet if one is ready.
 *         The output packet does not necessarily contain data for the most recent frame,
 */

  /* function exit code */
  __pyx_L1_error:;
  __Pyx_XDECREF(__pyx_t_1);
  __Pyx_XDECREF(__pyx_t_2);
  __Pyx_XDECREF(__pyx_t_3);
  __Pyx_AddTraceback("av.audio.stream.AudioStream.encode", __pyx_clineno, __pyx_lineno, __pyx_filename);
  __pyx_r = 0;
  __pyx_L0:;
  __Pyx_XDECREF((PyObject *)__pyx_v_resampled_frame);
  __Pyx_XDECREF((PyObject *)__pyx_v_fifo_frame);
  __Pyx_XDECREF((PyObject *)__pyx_v_packet);
  __Pyx_XGIVEREF(__pyx_r);
  __Pyx_RefNannyFinishContext();
  return __pyx_r;
}

/* Python wrapper */
static PyObject *__pyx_pw_2av_5audio_6stream_11AudioStream_3encode(PyObject *__pyx_v_self, PyObject *__pyx_v_input_frame); /*proto*/
static char __pyx_doc_2av_5audio_6stream_11AudioStream_2encode[] = "Encodes a frame of audio, returns a packet if one is ready.\n        The output packet does not necessarily contain data for the most recent frame, \n        as encoders can delay, split, and combine input frames internally as needed.\n        If called with with no args it will flush out the encoder and return the buffered\n        packets until there are none left, at which it will return None.\n        ";
static PyObject *__pyx_pw_2av_5audio_6stream_11AudioStream_3encode(PyObject *__pyx_v_self, PyObject *__pyx_v_input_frame) {
  CYTHON_UNUSED int __pyx_lineno = 0;
  CYTHON_UNUSED const char *__pyx_filename = NULL;
  CYTHON_UNUSED int __pyx_clineno = 0;
  PyObject *__pyx_r = 0;
  __Pyx_RefNannyDeclarations
  __Pyx_RefNannySetupContext("encode (wrapper)", 0);
  if (unlikely(!__Pyx_ArgTypeTest(((PyObject *)__pyx_v_input_frame), __pyx_ptype_2av_5audio_5frame_AudioFrame, 1, "input_frame", 0))) {__pyx_filename = __pyx_f[0]; __pyx_lineno = 64; __pyx_clineno = __LINE__; goto __pyx_L1_error;}
  __pyx_r = __pyx_pf_2av_5audio_6stream_11AudioStream_2encode(((struct __pyx_obj_2av_5audio_6stream_AudioStream *)__pyx_v_self), ((struct __pyx_obj_2av_5audio_5frame_AudioFrame *)__pyx_v_input_frame));

  /* function exit code */
  goto __pyx_L0;
  __pyx_L1_error:;
  __pyx_r = NULL;
  __pyx_L0:;
  __Pyx_RefNannyFinishContext();
  return __pyx_r;
}

static PyObject *__pyx_pf_2av_5audio_6stream_11AudioStream_2encode(struct __pyx_obj_2av_5audio_6stream_AudioStream *__pyx_v_self, struct __pyx_obj_2av_5audio_5frame_AudioFrame *__pyx_v_input_frame) {
  PyObject *__pyx_r = NULL;
  __Pyx_RefNannyDeclarations
  PyObject *__pyx_t_1 = NULL;
  int __pyx_lineno = 0;
  const char *__pyx_filename = NULL;
  int __pyx_clineno = 0;
  __Pyx_RefNannySetupContext("encode", 0);
  __Pyx_XDECREF(__pyx_r);
  __pyx_t_1 = ((struct __pyx_vtabstruct_2av_5audio_6stream_AudioStream *)__pyx_v_self->__pyx_base.__pyx_vtab)->encode(__pyx_v_self, __pyx_v_input_frame, 1); if (unlikely(!__pyx_t_1)) {__pyx_filename = __pyx_f[0]; __pyx_lineno = 64; __pyx_clineno = __LINE__; goto __pyx_L1_error;}
  __Pyx_GOTREF(__pyx_t_1);
  __pyx_r = __pyx_t_1;
  __pyx_t_1 = 0;
  goto __pyx_L0;

  /* function exit code */
  __pyx_L1_error:;
  __Pyx_XDECREF(__pyx_t_1);
  __Pyx_AddTraceback("av.audio.stream.AudioStream.encode", __pyx_clineno, __pyx_lineno, __pyx_filename);
  __pyx_r = NULL;
  __pyx_L0:;
  __Pyx_XGIVEREF(__pyx_r);
  __Pyx_RefNannyFinishContext();
  return __pyx_r;
}

/* "av/audio/stream.pxd":13
 * cdef class AudioStream(Stream):
 * 
 *     cdef readonly AudioLayout layout             # <<<<<<<<<<<<<<
 *     cdef readonly AudioFormat format
 * 
 */

/* Python wrapper */
static PyObject *__pyx_pw_2av_5audio_6stream_11AudioStream_6layout_1__get__(PyObject *__pyx_v_self); /*proto*/
static PyObject *__pyx_pw_2av_5audio_6stream_11AudioStream_6layout_1__get__(PyObject *__pyx_v_self) {
  PyObject *__pyx_r = 0;
  __Pyx_RefNannyDeclarations
  __Pyx_RefNannySetupContext("__get__ (wrapper)", 0);
  __pyx_r = __pyx_pf_2av_5audio_6stream_11AudioStream_6layout___get__(((struct __pyx_obj_2av_5audio_6stream_AudioStream *)__pyx_v_self));

  /* function exit code */
  __Pyx_RefNannyFinishContext();
  return __pyx_r;
}

static PyObject *__pyx_pf_2av_5audio_6stream_11AudioStream_6layout___get__(struct __pyx_obj_2av_5audio_6stream_AudioStream *__pyx_v_self) {
  PyObject *__pyx_r = NULL;
  __Pyx_RefNannyDeclarations
  __Pyx_RefNannySetupContext("__get__", 0);
  __Pyx_XDECREF(__pyx_r);
  __Pyx_INCREF(((PyObject *)__pyx_v_self->layout));
  __pyx_r = ((PyObject *)__pyx_v_self->layout);
  goto __pyx_L0;

  /* function exit code */
  __pyx_L0:;
  __Pyx_XGIVEREF(__pyx_r);
  __Pyx_RefNannyFinishContext();
  return __pyx_r;
}

/* "av/audio/stream.pxd":14
 * 
 *     cdef readonly AudioLayout layout
 *     cdef readonly AudioFormat format             # <<<<<<<<<<<<<<
 * 
 *     # Hold onto the frames that we will decode until we have a full one.
 */

/* Python wrapper */
static PyObject *__pyx_pw_2av_5audio_6stream_11AudioStream_6format_1__get__(PyObject *__pyx_v_self); /*proto*/
static PyObject *__pyx_pw_2av_5audio_6stream_11AudioStream_6format_1__get__(PyObject *__pyx_v_self) {
  PyObject *__pyx_r = 0;
  __Pyx_RefNannyDeclarations
  __Pyx_RefNannySetupContext("__get__ (wrapper)", 0);
  __pyx_r = __pyx_pf_2av_5audio_6stream_11AudioStream_6format___get__(((struct __pyx_obj_2av_5audio_6stream_AudioStream *)__pyx_v_self));

  /* function exit code */
  __Pyx_RefNannyFinishContext();
  return __pyx_r;
}

static PyObject *__pyx_pf_2av_5audio_6stream_11AudioStream_6format___get__(struct __pyx_obj_2av_5audio_6stream_AudioStream *__pyx_v_self) {
  PyObject *__pyx_r = NULL;
  __Pyx_RefNannyDeclarations
  __Pyx_RefNannySetupContext("__get__", 0);
  __Pyx_XDECREF(__pyx_r);
  __Pyx_INCREF(((PyObject *)__pyx_v_self->format));
  __pyx_r = ((PyObject *)__pyx_v_self->format);
  goto __pyx_L0;

  /* function exit code */
  __pyx_L0:;
  __Pyx_XGIVEREF(__pyx_r);
  __Pyx_RefNannyFinishContext();
  return __pyx_r;
}
static struct __pyx_vtabstruct_2av_5audio_6stream_AudioStream __pyx_vtable_2av_5audio_6stream_AudioStream;

static PyObject *__pyx_tp_new_2av_5audio_6stream_AudioStream(PyTypeObject *t, PyObject *a, PyObject *k) {
  struct __pyx_obj_2av_5audio_6stream_AudioStream *p;
  PyObject *o = __pyx_ptype_2av_6stream_Stream->tp_new(t, a, k);
  if (unlikely(!o)) return 0;
  p = ((struct __pyx_obj_2av_5audio_6stream_AudioStream *)o);
  p->__pyx_base.__pyx_vtab = (struct __pyx_vtabstruct_2av_6stream_Stream*)__pyx_vtabptr_2av_5audio_6stream_AudioStream;
  p->layout = ((struct __pyx_obj_2av_5audio_6layout_AudioLayout *)Py_None); Py_INCREF(Py_None);
  p->format = ((struct __pyx_obj_2av_5audio_6format_AudioFormat *)Py_None); Py_INCREF(Py_None);
  p->next_frame = ((struct __pyx_obj_2av_5audio_5frame_AudioFrame *)Py_None); Py_INCREF(Py_None);
  p->resampler = ((struct __pyx_obj_2av_5audio_9resampler_AudioResampler *)Py_None); Py_INCREF(Py_None);
  p->fifo = ((struct __pyx_obj_2av_5audio_4fifo_AudioFifo *)Py_None); Py_INCREF(Py_None);
  return o;
}

static void __pyx_tp_dealloc_2av_5audio_6stream_AudioStream(PyObject *o) {
  struct __pyx_obj_2av_5audio_6stream_AudioStream *p = (struct __pyx_obj_2av_5audio_6stream_AudioStream *)o;
  #if PY_VERSION_HEX >= 0x030400a1
  if (unlikely(Py_TYPE(o)->tp_finalize) && !_PyGC_FINALIZED(o)) {
    if (PyObject_CallFinalizerFromDealloc(o)) return;
  }
  #endif
  PyObject_GC_UnTrack(o);
  Py_CLEAR(p->layout);
  Py_CLEAR(p->format);
  Py_CLEAR(p->next_frame);
  Py_CLEAR(p->resampler);
  Py_CLEAR(p->fifo);
  PyObject_GC_Track(o);
  if (likely(__pyx_ptype_2av_6stream_Stream)) __pyx_ptype_2av_6stream_Stream->tp_dealloc(o); else __Pyx_call_next_tp_dealloc(o, __pyx_tp_dealloc_2av_5audio_6stream_AudioStream);
}

static int __pyx_tp_traverse_2av_5audio_6stream_AudioStream(PyObject *o, visitproc v, void *a) {
  int e;
  struct __pyx_obj_2av_5audio_6stream_AudioStream *p = (struct __pyx_obj_2av_5audio_6stream_AudioStream *)o;
  e = ((likely(__pyx_ptype_2av_6stream_Stream)) ? ((__pyx_ptype_2av_6stream_Stream->tp_traverse) ? __pyx_ptype_2av_6stream_Stream->tp_traverse(o, v, a) : 0) : __Pyx_call_next_tp_traverse(o, v, a, __pyx_tp_traverse_2av_5audio_6stream_AudioStream)); if (e) return e;
  if (p->layout) {
    e = (*v)(((PyObject*)p->layout), a); if (e) return e;
  }
  if (p->format) {
    e = (*v)(((PyObject*)p->format), a); if (e) return e;
  }
  if (p->next_frame) {
    e = (*v)(((PyObject*)p->next_frame), a); if (e) return e;
  }
  if (p->resampler) {
    e = (*v)(((PyObject*)p->resampler), a); if (e) return e;
  }
  if (p->fifo) {
    e = (*v)(((PyObject*)p->fifo), a); if (e) return e;
  }
  return 0;
}

static int __pyx_tp_clear_2av_5audio_6stream_AudioStream(PyObject *o) {
  PyObject* tmp;
  struct __pyx_obj_2av_5audio_6stream_AudioStream *p = (struct __pyx_obj_2av_5audio_6stream_AudioStream *)o;
  if (likely(__pyx_ptype_2av_6stream_Stream)) { if (__pyx_ptype_2av_6stream_Stream->tp_clear) __pyx_ptype_2av_6stream_Stream->tp_clear(o); } else __Pyx_call_next_tp_clear(o, __pyx_tp_clear_2av_5audio_6stream_AudioStream);
  tmp = ((PyObject*)p->layout);
  p->layout = ((struct __pyx_obj_2av_5audio_6layout_AudioLayout *)Py_None); Py_INCREF(Py_None);
  Py_XDECREF(tmp);
  tmp = ((PyObject*)p->format);
  p->format = ((struct __pyx_obj_2av_5audio_6format_AudioFormat *)Py_None); Py_INCREF(Py_None);
  Py_XDECREF(tmp);
  tmp = ((PyObject*)p->next_frame);
  p->next_frame = ((struct __pyx_obj_2av_5audio_5frame_AudioFrame *)Py_None); Py_INCREF(Py_None);
  Py_XDECREF(tmp);
  tmp = ((PyObject*)p->resampler);
  p->resampler = ((struct __pyx_obj_2av_5audio_9resampler_AudioResampler *)Py_None); Py_INCREF(Py_None);
  Py_XDECREF(tmp);
  tmp = ((PyObject*)p->fifo);
  p->fifo = ((struct __pyx_obj_2av_5audio_4fifo_AudioFifo *)Py_None); Py_INCREF(Py_None);
  Py_XDECREF(tmp);
  return 0;
}

static PyObject *__pyx_getprop_2av_5audio_6stream_11AudioStream_frame_size(PyObject *o, CYTHON_UNUSED void *x) {
  return __pyx_pw_2av_5audio_6stream_11AudioStream_10frame_size_1__get__(o);
}

static PyObject *__pyx_getprop_2av_5audio_6stream_11AudioStream_rate(PyObject *o, CYTHON_UNUSED void *x) {
  return __pyx_pw_2av_5audio_6stream_11AudioStream_4rate_1__get__(o);
}

static int __pyx_setprop_2av_5audio_6stream_11AudioStream_rate(PyObject *o, PyObject *v, CYTHON_UNUSED void *x) {
  if (v) {
    return __pyx_pw_2av_5audio_6stream_11AudioStream_4rate_3__set__(o, v);
  }
  else {
    PyErr_SetString(PyExc_NotImplementedError, "__del__");
    return -1;
  }
}

static PyObject *__pyx_getprop_2av_5audio_6stream_11AudioStream_channels(PyObject *o, CYTHON_UNUSED void *x) {
  return __pyx_pw_2av_5audio_6stream_11AudioStream_8channels_1__get__(o);
}

static PyObject *__pyx_getprop_2av_5audio_6stream_11AudioStream_layout(PyObject *o, CYTHON_UNUSED void *x) {
  return __pyx_pw_2av_5audio_6stream_11AudioStream_6layout_1__get__(o);
}

static PyObject *__pyx_getprop_2av_5audio_6stream_11AudioStream_format(PyObject *o, CYTHON_UNUSED void *x) {
  return __pyx_pw_2av_5audio_6stream_11AudioStream_6format_1__get__(o);
}

static PyMethodDef __pyx_methods_2av_5audio_6stream_AudioStream[] = {
  {__Pyx_NAMESTR("encode"), (PyCFunction)__pyx_pw_2av_5audio_6stream_11AudioStream_3encode, METH_O, __Pyx_DOCSTR(__pyx_doc_2av_5audio_6stream_11AudioStream_2encode)},
  {0, 0, 0, 0}
};

static struct PyGetSetDef __pyx_getsets_2av_5audio_6stream_AudioStream[] = {
  {(char *)"frame_size", __pyx_getprop_2av_5audio_6stream_11AudioStream_frame_size, 0, __Pyx_DOCSTR(__pyx_k_Number_of_samples_per_channel_in), 0},
  {(char *)"rate", __pyx_getprop_2av_5audio_6stream_11AudioStream_rate, __pyx_setprop_2av_5audio_6stream_11AudioStream_rate, __Pyx_DOCSTR(__pyx_k_samples_per_second), 0},
  {(char *)"channels", __pyx_getprop_2av_5audio_6stream_11AudioStream_channels, 0, 0, 0},
  {(char *)"layout", __pyx_getprop_2av_5audio_6stream_11AudioStream_layout, 0, 0, 0},
  {(char *)"format", __pyx_getprop_2av_5audio_6stream_11AudioStream_format, 0, 0, 0},
  {0, 0, 0, 0, 0}
};

static PyTypeObject __pyx_type_2av_5audio_6stream_AudioStream = {
  PyVarObject_HEAD_INIT(0, 0)
  __Pyx_NAMESTR("av.audio.stream.AudioStream"), /*tp_name*/
  sizeof(struct __pyx_obj_2av_5audio_6stream_AudioStream), /*tp_basicsize*/
  0, /*tp_itemsize*/
  __pyx_tp_dealloc_2av_5audio_6stream_AudioStream, /*tp_dealloc*/
  0, /*tp_print*/
  0, /*tp_getattr*/
  0, /*tp_setattr*/
  #if PY_MAJOR_VERSION < 3
  0, /*tp_compare*/
  #else
  0, /*reserved*/
  #endif
  __pyx_pw_2av_5audio_6stream_11AudioStream_1__repr__, /*tp_repr*/
  0, /*tp_as_number*/
  0, /*tp_as_sequence*/
  0, /*tp_as_mapping*/
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  0, /*tp_as_buffer*/
  Py_TPFLAGS_DEFAULT|Py_TPFLAGS_HAVE_VERSION_TAG|Py_TPFLAGS_CHECKTYPES|Py_TPFLAGS_HAVE_NEWBUFFER|Py_TPFLAGS_BASETYPE|Py_TPFLAGS_HAVE_GC, /*tp_flags*/
  0, /*tp_doc*/
  __pyx_tp_traverse_2av_5audio_6stream_AudioStream, /*tp_traverse*/
  __pyx_tp_clear_2av_5audio_6stream_AudioStream, /*tp_clear*/
  0, /*tp_richcompare*/
  0, /*tp_weaklistoffset*/
  0, /*tp_iter*/
  0, /*tp_iternext*/
  __pyx_methods_2av_5audio_6stream_AudioStream, /*tp_methods*/
  0, /*tp_members*/
  __pyx_getsets_2av_5audio_6stream_AudioStream, /*tp_getset*/
  0, /*tp_base*/
  0, /*tp_dict*/
  0, /*tp_descr_get*/
  0, /*tp_descr_set*/
  0, /*tp_dictoffset*/
  0, /*tp_init*/
  0, /*tp_alloc*/
  __pyx_tp_new_2av_5audio_6stream_AudioStream, /*tp_new*/
  0, /*tp_free*/
  0, /*tp_is_gc*/
  0, /*tp_bases*/
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  0, /*tp_del*/
  #if PY_VERSION_HEX >= 0x02060000
  0, /*tp_version_tag*/
  #endif
  #if PY_VERSION_HEX >= 0x030400a1
  0, /*tp_finalize*/
  #endif
};

static PyMethodDef __pyx_methods[] = {
  {0, 0, 0, 0}
};

#if PY_MAJOR_VERSION >= 3
static struct PyModuleDef __pyx_moduledef = {
  #if PY_VERSION_HEX < 0x03020000
    { PyObject_HEAD_INIT(NULL) NULL, 0, NULL },
  #else
    PyModuleDef_HEAD_INIT,
  #endif
    __Pyx_NAMESTR("stream"),
    0, /* m_doc */
    -1, /* m_size */
    __pyx_methods /* m_methods */,
    NULL, /* m_reload */
    NULL, /* m_traverse */
    NULL, /* m_clear */
    NULL /* m_free */
};
#endif

static __Pyx_StringTabEntry __pyx_string_tab[] = {
  {&__pyx_kp_s_av_s_d_s_at_dHz_s_s_at_0x_x, __pyx_k_av_s_d_s_at_dHz_s_s_at_0x_x, sizeof(__pyx_k_av_s_d_s_at_dHz_s_s_at_0x_x), 0, 0, 1, 0},
  {&__pyx_n_s_class, __pyx_k_class, sizeof(__pyx_k_class), 0, 0, 1, 1},
  {&__pyx_n_s_encode, __pyx_k_encode, sizeof(__pyx_k_encode), 0, 0, 1, 1},
  {&__pyx_n_s_id, __pyx_k_id, sizeof(__pyx_k_id), 0, 0, 1, 1},
  {&__pyx_n_s_index, __pyx_k_index, sizeof(__pyx_k_index), 0, 0, 1, 1},
  {&__pyx_n_s_main, __pyx_k_main, sizeof(__pyx_k_main), 0, 0, 1, 1},
  {&__pyx_n_s_name, __pyx_k_name, sizeof(__pyx_k_name), 0, 0, 1, 1},
  {&__pyx_n_s_name_2, __pyx_k_name_2, sizeof(__pyx_k_name_2), 0, 0, 1, 1},
  {&__pyx_n_s_pyx_vtable, __pyx_k_pyx_vtable, sizeof(__pyx_k_pyx_vtable), 0, 0, 1, 1},
  {&__pyx_n_s_rate, __pyx_k_rate, sizeof(__pyx_k_rate), 0, 0, 1, 1},
  {&__pyx_n_s_start_encoding, __pyx_k_start_encoding, sizeof(__pyx_k_start_encoding), 0, 0, 1, 1},
  {&__pyx_n_s_test, __pyx_k_test, sizeof(__pyx_k_test), 0, 0, 1, 1},
  {0, 0, 0, 0, 0, 0, 0}
};
static int __Pyx_InitCachedBuiltins(void) {
  __pyx_builtin_id = __Pyx_GetBuiltinName(__pyx_n_s_id); if (!__pyx_builtin_id) {__pyx_filename = __pyx_f[0]; __pyx_lineno = 31; __pyx_clineno = __LINE__; goto __pyx_L1_error;}
  return 0;
  __pyx_L1_error:;
  return -1;
}

static int __Pyx_InitCachedConstants(void) {
  __Pyx_RefNannyDeclarations
  __Pyx_RefNannySetupContext("__Pyx_InitCachedConstants", 0);
  __Pyx_RefNannyFinishContext();
  return 0;
}

static int __Pyx_InitGlobals(void) {
  if (__Pyx_InitStrings(__pyx_string_tab) < 0) {__pyx_filename = __pyx_f[0]; __pyx_lineno = 1; __pyx_clineno = __LINE__; goto __pyx_L1_error;};
  return 0;
  __pyx_L1_error:;
  return -1;
}

#if PY_MAJOR_VERSION < 3
PyMODINIT_FUNC initstream(void); /*proto*/
PyMODINIT_FUNC initstream(void)
#else
PyMODINIT_FUNC PyInit_stream(void); /*proto*/
PyMODINIT_FUNC PyInit_stream(void)
#endif
{
  PyObject *__pyx_t_1 = NULL;
  PyObject *__pyx_t_2 = NULL;
  PyObject *__pyx_t_3 = NULL;
  PyObject *__pyx_t_4 = NULL;
  PyObject *__pyx_t_5 = NULL;
  int __pyx_lineno = 0;
  const char *__pyx_filename = NULL;
  int __pyx_clineno = 0;
  __Pyx_RefNannyDeclarations
  #if CYTHON_REFNANNY
  __Pyx_RefNanny = __Pyx_RefNannyImportAPI("refnanny");
  if (!__Pyx_RefNanny) {
      PyErr_Clear();
      __Pyx_RefNanny = __Pyx_RefNannyImportAPI("Cython.Runtime.refnanny");
      if (!__Pyx_RefNanny)
          Py_FatalError("failed to import 'refnanny' module");
  }
  #endif
  __Pyx_RefNannySetupContext("PyMODINIT_FUNC PyInit_stream(void)", 0);
  if ( __Pyx_check_binary_version() < 0) {__pyx_filename = __pyx_f[0]; __pyx_lineno = 1; __pyx_clineno = __LINE__; goto __pyx_L1_error;}
  __pyx_empty_tuple = PyTuple_New(0); if (unlikely(!__pyx_empty_tuple)) {__pyx_filename = __pyx_f[0]; __pyx_lineno = 1; __pyx_clineno = __LINE__; goto __pyx_L1_error;}
  __pyx_empty_bytes = PyBytes_FromStringAndSize("", 0); if (unlikely(!__pyx_empty_bytes)) {__pyx_filename = __pyx_f[0]; __pyx_lineno = 1; __pyx_clineno = __LINE__; goto __pyx_L1_error;}
  #ifdef __Pyx_CyFunction_USED
  if (__Pyx_CyFunction_init() < 0) {__pyx_filename = __pyx_f[0]; __pyx_lineno = 1; __pyx_clineno = __LINE__; goto __pyx_L1_error;}
  #endif
  #ifdef __Pyx_FusedFunction_USED
  if (__pyx_FusedFunction_init() < 0) {__pyx_filename = __pyx_f[0]; __pyx_lineno = 1; __pyx_clineno = __LINE__; goto __pyx_L1_error;}
  #endif
  #ifdef __Pyx_Generator_USED
  if (__pyx_Generator_init() < 0) {__pyx_filename = __pyx_f[0]; __pyx_lineno = 1; __pyx_clineno = __LINE__; goto __pyx_L1_error;}
  #endif
  /*--- Library function declarations ---*/
  /*--- Threads initialization code ---*/
  #if defined(__PYX_FORCE_INIT_THREADS) && __PYX_FORCE_INIT_THREADS
  #ifdef WITH_THREAD /* Python build with threading support? */
  PyEval_InitThreads();
  #endif
  #endif
  /*--- Module creation code ---*/
  #if PY_MAJOR_VERSION < 3
  __pyx_m = Py_InitModule4(__Pyx_NAMESTR("stream"), __pyx_methods, 0, 0, PYTHON_API_VERSION); Py_XINCREF(__pyx_m);
  #else
  __pyx_m = PyModule_Create(&__pyx_moduledef);
  #endif
  if (unlikely(!__pyx_m)) {__pyx_filename = __pyx_f[0]; __pyx_lineno = 1; __pyx_clineno = __LINE__; goto __pyx_L1_error;}
  __pyx_d = PyModule_GetDict(__pyx_m); if (unlikely(!__pyx_d)) {__pyx_filename = __pyx_f[0]; __pyx_lineno = 1; __pyx_clineno = __LINE__; goto __pyx_L1_error;}
  Py_INCREF(__pyx_d);
  __pyx_b = PyImport_AddModule(__Pyx_NAMESTR(__Pyx_BUILTIN_MODULE_NAME)); if (unlikely(!__pyx_b)) {__pyx_filename = __pyx_f[0]; __pyx_lineno = 1; __pyx_clineno = __LINE__; goto __pyx_L1_error;}
  #if CYTHON_COMPILING_IN_PYPY
  Py_INCREF(__pyx_b);
  #endif
  if (__Pyx_SetAttrString(__pyx_m, "__builtins__", __pyx_b) < 0) {__pyx_filename = __pyx_f[0]; __pyx_lineno = 1; __pyx_clineno = __LINE__; goto __pyx_L1_error;};
  /*--- Initialize various global constants etc. ---*/
  if (unlikely(__Pyx_InitGlobals() < 0)) {__pyx_filename = __pyx_f[0]; __pyx_lineno = 1; __pyx_clineno = __LINE__; goto __pyx_L1_error;}
  #if PY_MAJOR_VERSION < 3 && (__PYX_DEFAULT_STRING_ENCODING_IS_ASCII || __PYX_DEFAULT_STRING_ENCODING_IS_DEFAULT)
  if (__Pyx_init_sys_getdefaultencoding_params() < 0) {__pyx_filename = __pyx_f[0]; __pyx_lineno = 1; __pyx_clineno = __LINE__; goto __pyx_L1_error;}
  #endif
  if (__pyx_module_is_main_av__audio__stream) {
    if (__Pyx_SetAttrString(__pyx_m, "__name__", __pyx_n_s_main) < 0) {__pyx_filename = __pyx_f[0]; __pyx_lineno = 1; __pyx_clineno = __LINE__; goto __pyx_L1_error;};
  }
  #if PY_MAJOR_VERSION >= 3
  {
    PyObject *modules = PyImport_GetModuleDict(); if (unlikely(!modules)) {__pyx_filename = __pyx_f[0]; __pyx_lineno = 1; __pyx_clineno = __LINE__; goto __pyx_L1_error;}
    if (!PyDict_GetItemString(modules, "av.audio.stream")) {
      if (unlikely(PyDict_SetItemString(modules, "av.audio.stream", __pyx_m) < 0)) {__pyx_filename = __pyx_f[0]; __pyx_lineno = 1; __pyx_clineno = __LINE__; goto __pyx_L1_error;}
    }
  }
  #endif
  /*--- Builtin init code ---*/
  if (unlikely(__Pyx_InitCachedBuiltins() < 0)) {__pyx_filename = __pyx_f[0]; __pyx_lineno = 1; __pyx_clineno = __LINE__; goto __pyx_L1_error;}
  /*--- Constants init code ---*/
  if (unlikely(__Pyx_InitCachedConstants() < 0)) {__pyx_filename = __pyx_f[0]; __pyx_lineno = 1; __pyx_clineno = __LINE__; goto __pyx_L1_error;}
  /*--- Global init code ---*/
  /*--- Variable export code ---*/
  /*--- Function export code ---*/
  /*--- Type init code ---*/
  __pyx_ptype_2av_6stream_Stream = __Pyx_ImportType("av.stream", "Stream", sizeof(struct __pyx_obj_2av_6stream_Stream), 1); if (unlikely(!__pyx_ptype_2av_6stream_Stream)) {__pyx_filename = __pyx_f[0]; __pyx_lineno = 1; __pyx_clineno = __LINE__; goto __pyx_L1_error;}
  __pyx_vtabptr_2av_6stream_Stream = (struct __pyx_vtabstruct_2av_6stream_Stream*)__Pyx_GetVtable(__pyx_ptype_2av_6stream_Stream->tp_dict); if (unlikely(!__pyx_vtabptr_2av_6stream_Stream)) {__pyx_filename = __pyx_f[0]; __pyx_lineno = 1; __pyx_clineno = __LINE__; goto __pyx_L1_error;}
  __pyx_vtabptr_2av_5audio_6stream_AudioStream = &__pyx_vtable_2av_5audio_6stream_AudioStream;
  __pyx_vtable_2av_5audio_6stream_AudioStream.__pyx_base = *__pyx_vtabptr_2av_6stream_Stream;
  __pyx_vtable_2av_5audio_6stream_AudioStream.__pyx_base._init = (PyObject *(*)(struct __pyx_obj_2av_6stream_Stream *, struct __pyx_obj_2av_9container_Container *, struct AVStream *))__pyx_f_2av_5audio_6stream_11AudioStream__init;
  __pyx_vtable_2av_5audio_6stream_AudioStream.__pyx_base._decode_one = (PyObject *(*)(struct __pyx_obj_2av_6stream_Stream *, struct AVPacket *, int *))__pyx_f_2av_5audio_6stream_11AudioStream__decode_one;
  __pyx_vtable_2av_5audio_6stream_AudioStream.encode = (PyObject *(*)(struct __pyx_obj_2av_5audio_6stream_AudioStream *, struct __pyx_obj_2av_5audio_5frame_AudioFrame *, int __pyx_skip_dispatch))__pyx_f_2av_5audio_6stream_11AudioStream_encode;
  __pyx_type_2av_5audio_6stream_AudioStream.tp_base = __pyx_ptype_2av_6stream_Stream;
  if (PyType_Ready(&__pyx_type_2av_5audio_6stream_AudioStream) < 0) {__pyx_filename = __pyx_f[0]; __pyx_lineno = 10; __pyx_clineno = __LINE__; goto __pyx_L1_error;}
  __pyx_type_2av_5audio_6stream_AudioStream.tp_print = 0;
  if (__Pyx_SetVtable(__pyx_type_2av_5audio_6stream_AudioStream.tp_dict, __pyx_vtabptr_2av_5audio_6stream_AudioStream) < 0) {__pyx_filename = __pyx_f[0]; __pyx_lineno = 10; __pyx_clineno = __LINE__; goto __pyx_L1_error;}
  if (__Pyx_SetAttrString(__pyx_m, "AudioStream", (PyObject *)&__pyx_type_2av_5audio_6stream_AudioStream) < 0) {__pyx_filename = __pyx_f[0]; __pyx_lineno = 10; __pyx_clineno = __LINE__; goto __pyx_L1_error;}
  __pyx_ptype_2av_5audio_6stream_AudioStream = &__pyx_type_2av_5audio_6stream_AudioStream;
  /*--- Type import code ---*/
  __pyx_ptype_2av_5audio_6layout_AudioLayout = __Pyx_ImportType("av.audio.layout", "AudioLayout", sizeof(struct __pyx_obj_2av_5audio_6layout_AudioLayout), 1); if (unlikely(!__pyx_ptype_2av_5audio_6layout_AudioLayout)) {__pyx_filename = __pyx_f[1]; __pyx_lineno = 4; __pyx_clineno = __LINE__; goto __pyx_L1_error;}
  __pyx_vtabptr_2av_5audio_6layout_AudioLayout = (struct __pyx_vtabstruct_2av_5audio_6layout_AudioLayout*)__Pyx_GetVtable(__pyx_ptype_2av_5audio_6layout_AudioLayout->tp_dict); if (unlikely(!__pyx_vtabptr_2av_5audio_6layout_AudioLayout)) {__pyx_filename = __pyx_f[1]; __pyx_lineno = 4; __pyx_clineno = __LINE__; goto __pyx_L1_error;}
  __pyx_ptype_2av_5audio_6layout_AudioChannel = __Pyx_ImportType("av.audio.layout", "AudioChannel", sizeof(struct __pyx_obj_2av_5audio_6layout_AudioChannel), 1); if (unlikely(!__pyx_ptype_2av_5audio_6layout_AudioChannel)) {__pyx_filename = __pyx_f[1]; __pyx_lineno = 15; __pyx_clineno = __LINE__; goto __pyx_L1_error;}
  __pyx_ptype_2av_5audio_6format_AudioFormat = __Pyx_ImportType("av.audio.format", "AudioFormat", sizeof(struct __pyx_obj_2av_5audio_6format_AudioFormat), 1); if (unlikely(!__pyx_ptype_2av_5audio_6format_AudioFormat)) {__pyx_filename = __pyx_f[2]; __pyx_lineno = 4; __pyx_clineno = __LINE__; goto __pyx_L1_error;}
  __pyx_vtabptr_2av_5audio_6format_AudioFormat = (struct __pyx_vtabstruct_2av_5audio_6format_AudioFormat*)__Pyx_GetVtable(__pyx_ptype_2av_5audio_6format_AudioFormat->tp_dict); if (unlikely(!__pyx_vtabptr_2av_5audio_6format_AudioFormat)) {__pyx_filename = __pyx_f[2]; __pyx_lineno = 4; __pyx_clineno = __LINE__; goto __pyx_L1_error;}
  __pyx_ptype_2av_6format_ContainerFormat = __Pyx_ImportType("av.format", "ContainerFormat", sizeof(struct __pyx_obj_2av_6format_ContainerFormat), 1); if (unlikely(!__pyx_ptype_2av_6format_ContainerFormat)) {__pyx_filename = __pyx_f[3]; __pyx_lineno = 4; __pyx_clineno = __LINE__; goto __pyx_L1_error;}
  __pyx_ptype_2av_9container_ContainerProxy = __Pyx_ImportType("av.container", "ContainerProxy", sizeof(struct __pyx_obj_2av_9container_ContainerProxy), 1); if (unlikely(!__pyx_ptype_2av_9container_ContainerProxy)) {__pyx_filename = __pyx_f[4]; __pyx_lineno = 9; __pyx_clineno = __LINE__; goto __pyx_L1_error;}
  __pyx_ptype_2av_9container_Container = __Pyx_ImportType("av.container", "Container", sizeof(struct __pyx_obj_2av_9container_Container), 1); if (unlikely(!__pyx_ptype_2av_9container_Container)) {__pyx_filename = __pyx_f[4]; __pyx_lineno = 13; __pyx_clineno = __LINE__; goto __pyx_L1_error;}
  __pyx_vtabptr_2av_9container_Container = (struct __pyx_vtabstruct_2av_9container_Container*)__Pyx_GetVtable(__pyx_ptype_2av_9container_Container->tp_dict); if (unlikely(!__pyx_vtabptr_2av_9container_Container)) {__pyx_filename = __pyx_f[4]; __pyx_lineno = 13; __pyx_clineno = __LINE__; goto __pyx_L1_error;}
  __pyx_ptype_2av_9container_InputContainer = __Pyx_ImportType("av.container", "InputContainer", sizeof(struct __pyx_obj_2av_9container_InputContainer), 1); if (unlikely(!__pyx_ptype_2av_9container_InputContainer)) {__pyx_filename = __pyx_f[4]; __pyx_lineno = 29; __pyx_clineno = __LINE__; goto __pyx_L1_error;}
  __pyx_vtabptr_2av_9container_InputContainer = (struct __pyx_vtabstruct_2av_9container_InputContainer*)__Pyx_GetVtable(__pyx_ptype_2av_9container_InputContainer->tp_dict); if (unlikely(!__pyx_vtabptr_2av_9container_InputContainer)) {__pyx_filename = __pyx_f[4]; __pyx_lineno = 29; __pyx_clineno = __LINE__; goto __pyx_L1_error;}
  __pyx_ptype_2av_9container_OutputContainer = __Pyx_ImportType("av.container", "OutputContainer", sizeof(struct __pyx_obj_2av_9container_OutputContainer), 1); if (unlikely(!__pyx_ptype_2av_9container_OutputContainer)) {__pyx_filename = __pyx_f[4]; __pyx_lineno = 33; __pyx_clineno = __LINE__; goto __pyx_L1_error;}
  __pyx_vtabptr_2av_9container_OutputContainer = (struct __pyx_vtabstruct_2av_9container_OutputContainer*)__Pyx_GetVtable(__pyx_ptype_2av_9container_OutputContainer->tp_dict); if (unlikely(!__pyx_vtabptr_2av_9container_OutputContainer)) {__pyx_filename = __pyx_f[4]; __pyx_lineno = 33; __pyx_clineno = __LINE__; goto __pyx_L1_error;}
  __pyx_ptype_2av_6packet_Packet = __Pyx_ImportType("av.packet", "Packet", sizeof(struct __pyx_obj_2av_6packet_Packet), 1); if (unlikely(!__pyx_ptype_2av_6packet_Packet)) {__pyx_filename = __pyx_f[5]; __pyx_lineno = 6; __pyx_clineno = __LINE__; goto __pyx_L1_error;}
  __pyx_ptype_2av_5frame_Frame = __Pyx_ImportType("av.frame", "Frame", sizeof(struct __pyx_obj_2av_5frame_Frame), 1); if (unlikely(!__pyx_ptype_2av_5frame_Frame)) {__pyx_filename = __pyx_f[6]; __pyx_lineno = 5; __pyx_clineno = __LINE__; goto __pyx_L1_error;}
  __pyx_vtabptr_2av_5frame_Frame = (struct __pyx_vtabstruct_2av_5frame_Frame*)__Pyx_GetVtable(__pyx_ptype_2av_5frame_Frame->tp_dict); if (unlikely(!__pyx_vtabptr_2av_5frame_Frame)) {__pyx_filename = __pyx_f[6]; __pyx_lineno = 5; __pyx_clineno = __LINE__; goto __pyx_L1_error;}
  __pyx_ptype_2av_5audio_5frame_AudioFrame = __Pyx_ImportType("av.audio.frame", "AudioFrame", sizeof(struct __pyx_obj_2av_5audio_5frame_AudioFrame), 1); if (unlikely(!__pyx_ptype_2av_5audio_5frame_AudioFrame)) {__pyx_filename = __pyx_f[7]; __pyx_lineno = 10; __pyx_clineno = __LINE__; goto __pyx_L1_error;}
  __pyx_vtabptr_2av_5audio_5frame_AudioFrame = (struct __pyx_vtabstruct_2av_5audio_5frame_AudioFrame*)__Pyx_GetVtable(__pyx_ptype_2av_5audio_5frame_AudioFrame->tp_dict); if (unlikely(!__pyx_vtabptr_2av_5audio_5frame_AudioFrame)) {__pyx_filename = __pyx_f[7]; __pyx_lineno = 10; __pyx_clineno = __LINE__; goto __pyx_L1_error;}
  __pyx_ptype_2av_5audio_4fifo_AudioFifo = __Pyx_ImportType("av.audio.fifo", "AudioFifo", sizeof(struct __pyx_obj_2av_5audio_4fifo_AudioFifo), 1); if (unlikely(!__pyx_ptype_2av_5audio_4fifo_AudioFifo)) {__pyx_filename = __pyx_f[8]; __pyx_lineno = 10; __pyx_clineno = __LINE__; goto __pyx_L1_error;}
  __pyx_vtabptr_2av_5audio_4fifo_AudioFifo = (struct __pyx_vtabstruct_2av_5audio_4fifo_AudioFifo*)__Pyx_GetVtable(__pyx_ptype_2av_5audio_4fifo_AudioFifo->tp_dict); if (unlikely(!__pyx_vtabptr_2av_5audio_4fifo_AudioFifo)) {__pyx_filename = __pyx_f[8]; __pyx_lineno = 10; __pyx_clineno = __LINE__; goto __pyx_L1_error;}
  __pyx_ptype_2av_5audio_9resampler_AudioResampler = __Pyx_ImportType("av.audio.resampler", "AudioResampler", sizeof(struct __pyx_obj_2av_5audio_9resampler_AudioResampler), 1); if (unlikely(!__pyx_ptype_2av_5audio_9resampler_AudioResampler)) {__pyx_filename = __pyx_f[9]; __pyx_lineno = 8; __pyx_clineno = __LINE__; goto __pyx_L1_error;}
  __pyx_vtabptr_2av_5audio_9resampler_AudioResampler = (struct __pyx_vtabstruct_2av_5audio_9resampler_AudioResampler*)__Pyx_GetVtable(__pyx_ptype_2av_5audio_9resampler_AudioResampler->tp_dict); if (unlikely(!__pyx_vtabptr_2av_5audio_9resampler_AudioResampler)) {__pyx_filename = __pyx_f[9]; __pyx_lineno = 8; __pyx_clineno = __LINE__; goto __pyx_L1_error;}
  __pyx_ptype_2av_5utils_ByteSource = __Pyx_ImportType("av.utils", "ByteSource", sizeof(struct __pyx_obj_2av_5utils_ByteSource), 1); if (unlikely(!__pyx_ptype_2av_5utils_ByteSource)) {__pyx_filename = __pyx_f[10]; __pyx_lineno = 22; __pyx_clineno = __LINE__; goto __pyx_L1_error;}
  /*--- Variable import code ---*/
  /*--- Function import code ---*/
  __pyx_t_1 = __Pyx_ImportModule("av.audio.layout"); if (!__pyx_t_1) {__pyx_filename = __pyx_f[0]; __pyx_lineno = 1; __pyx_clineno = __LINE__; goto __pyx_L1_error;}
  if (__Pyx_ImportFunction(__pyx_t_1, "get_audio_layout", (void (**)(void))&__pyx_f_2av_5audio_6layout_get_audio_layout, "struct __pyx_obj_2av_5audio_6layout_AudioLayout *(int, uint64_t)") < 0) {__pyx_filename = __pyx_f[0]; __pyx_lineno = 1; __pyx_clineno = __LINE__; goto __pyx_L1_error;}
  Py_DECREF(__pyx_t_1); __pyx_t_1 = 0;
  __pyx_t_2 = __Pyx_ImportModule("av.audio.format"); if (!__pyx_t_2) {__pyx_filename = __pyx_f[0]; __pyx_lineno = 1; __pyx_clineno = __LINE__; goto __pyx_L1_error;}
  if (__Pyx_ImportFunction(__pyx_t_2, "get_audio_format", (void (**)(void))&__pyx_f_2av_5audio_6format_get_audio_format, "struct __pyx_obj_2av_5audio_6format_AudioFormat *(enum AVSampleFormat)") < 0) {__pyx_filename = __pyx_f[0]; __pyx_lineno = 1; __pyx_clineno = __LINE__; goto __pyx_L1_error;}
  Py_DECREF(__pyx_t_2); __pyx_t_2 = 0;
  __pyx_t_3 = __Pyx_ImportModule("av.audio.frame"); if (!__pyx_t_3) {__pyx_filename = __pyx_f[0]; __pyx_lineno = 1; __pyx_clineno = __LINE__; goto __pyx_L1_error;}
  if (__Pyx_ImportFunction(__pyx_t_3, "alloc_audio_frame", (void (**)(void))&__pyx_f_2av_5audio_5frame_alloc_audio_frame, "struct __pyx_obj_2av_5audio_5frame_AudioFrame *(void)") < 0) {__pyx_filename = __pyx_f[0]; __pyx_lineno = 1; __pyx_clineno = __LINE__; goto __pyx_L1_error;}
  Py_DECREF(__pyx_t_3); __pyx_t_3 = 0;
  __pyx_t_4 = __Pyx_ImportModule("av.utils"); if (!__pyx_t_4) {__pyx_filename = __pyx_f[0]; __pyx_lineno = 1; __pyx_clineno = __LINE__; goto __pyx_L1_error;}
  if (__Pyx_ImportFunction(__pyx_t_4, "err_check", (void (**)(void))&__pyx_f_2av_5utils_err_check, "int (int, struct __pyx_opt_args_2av_5utils_err_check *__pyx_optional_args)") < 0) {__pyx_filename = __pyx_f[0]; __pyx_lineno = 1; __pyx_clineno = __LINE__; goto __pyx_L1_error;}
  Py_DECREF(__pyx_t_4); __pyx_t_4 = 0;
  /*--- Execution code ---*/

  /* "av/audio/stream.pyx":1
 * from av.audio.format cimport get_audio_format             # <<<<<<<<<<<<<<
 * from av.audio.frame cimport alloc_audio_frame
 * from av.audio.layout cimport get_audio_layout
 */
  __pyx_t_5 = PyDict_New(); if (unlikely(!__pyx_t_5)) {__pyx_filename = __pyx_f[0]; __pyx_lineno = 1; __pyx_clineno = __LINE__; goto __pyx_L1_error;}
  __Pyx_GOTREF(__pyx_t_5);
  if (PyDict_SetItem(__pyx_d, __pyx_n_s_test, __pyx_t_5) < 0) {__pyx_filename = __pyx_f[0]; __pyx_lineno = 1; __pyx_clineno = __LINE__; goto __pyx_L1_error;}
  __Pyx_DECREF(__pyx_t_5); __pyx_t_5 = 0;
  goto __pyx_L0;
  __pyx_L1_error:;
  __Pyx_XDECREF(__pyx_t_1);
  __Pyx_XDECREF(__pyx_t_2);
  __Pyx_XDECREF(__pyx_t_3);
  __Pyx_XDECREF(__pyx_t_4);
  __Pyx_XDECREF(__pyx_t_5);
  if (__pyx_m) {
    __Pyx_AddTraceback("init av.audio.stream", __pyx_clineno, __pyx_lineno, __pyx_filename);
    Py_DECREF(__pyx_m); __pyx_m = 0;
  } else if (!PyErr_Occurred()) {
    PyErr_SetString(PyExc_ImportError, "init av.audio.stream");
  }
  __pyx_L0:;
  __Pyx_RefNannyFinishContext();
  #if PY_MAJOR_VERSION < 3
  return;
  #else
  return __pyx_m;
  #endif
}

/* Runtime support code */
#if CYTHON_REFNANNY
static __Pyx_RefNannyAPIStruct *__Pyx_RefNannyImportAPI(const char *modname) {
    PyObject *m = NULL, *p = NULL;
    void *r = NULL;
    m = PyImport_ImportModule((char *)modname);
    if (!m) goto end;
    p = PyObject_GetAttrString(m, (char *)"RefNannyAPI");
    if (!p) goto end;
    r = PyLong_AsVoidPtr(p);
end:
    Py_XDECREF(p);
    Py_XDECREF(m);
    return (__Pyx_RefNannyAPIStruct *)r;
}
#endif /* CYTHON_REFNANNY */

static PyObject *__Pyx_GetBuiltinName(PyObject *name) {
    PyObject* result = __Pyx_PyObject_GetAttrStr(__pyx_b, name);
    if (unlikely(!result)) {
        PyErr_Format(PyExc_NameError,
#if PY_MAJOR_VERSION >= 3
            "name '%U' is not defined", name);
#else
            "name '%.200s' is not defined", PyString_AS_STRING(name));
#endif
    }
    return result;
}

#if CYTHON_COMPILING_IN_CPYTHON
static CYTHON_INLINE PyObject* __Pyx_PyObject_Call(PyObject *func, PyObject *arg, PyObject *kw) {
    PyObject *result;
    ternaryfunc call = func->ob_type->tp_call;
    if (unlikely(!call))
        return PyObject_Call(func, arg, kw);
#if PY_VERSION_HEX >= 0x02060000
    if (unlikely(Py_EnterRecursiveCall((char*)" while calling a Python object")))
        return NULL;
#endif
    result = (*call)(func, arg, kw);
#if PY_VERSION_HEX >= 0x02060000
    Py_LeaveRecursiveCall();
#endif
    if (unlikely(!result) && unlikely(!PyErr_Occurred())) {
        PyErr_SetString(
            PyExc_SystemError,
            "NULL result without error in PyObject_Call");
    }
    return result;
}
#endif

static CYTHON_INLINE int __Pyx_TypeTest(PyObject *obj, PyTypeObject *type) {
    if (unlikely(!type)) {
        PyErr_SetString(PyExc_SystemError, "Missing type object");
        return 0;
    }
    if (likely(PyObject_TypeCheck(obj, type)))
        return 1;
    PyErr_Format(PyExc_TypeError, "Cannot convert %.200s to %.200s",
                 Py_TYPE(obj)->tp_name, type->tp_name);
    return 0;
}

static void __Pyx_RaiseArgumentTypeInvalid(const char* name, PyObject *obj, PyTypeObject *type) {
    PyErr_Format(PyExc_TypeError,
        "Argument '%.200s' has incorrect type (expected %.200s, got %.200s)",
        name, type->tp_name, Py_TYPE(obj)->tp_name);
}
static CYTHON_INLINE int __Pyx_ArgTypeTest(PyObject *obj, PyTypeObject *type, int none_allowed,
    const char *name, int exact)
{
    if (unlikely(!type)) {
        PyErr_SetString(PyExc_SystemError, "Missing type object");
        return 0;
    }
    if (none_allowed && obj == Py_None) return 1;
    else if (exact) {
        if (likely(Py_TYPE(obj) == type)) return 1;
        #if PY_MAJOR_VERSION == 2
        else if ((type == &PyBaseString_Type) && likely(__Pyx_PyBaseString_CheckExact(obj))) return 1;
        #endif
    }
    else {
        if (likely(PyObject_TypeCheck(obj, type))) return 1;
    }
    __Pyx_RaiseArgumentTypeInvalid(name, obj, type);
    return 0;
}

static void __Pyx_call_next_tp_dealloc(PyObject* obj, destructor current_tp_dealloc) {
    PyTypeObject* type = Py_TYPE(obj);
    while (type && type->tp_dealloc != current_tp_dealloc)
        type = type->tp_base;
    while (type && type->tp_dealloc == current_tp_dealloc)
        type = type->tp_base;
    if (type)
        type->tp_dealloc(obj);
}

static int __Pyx_call_next_tp_traverse(PyObject* obj, visitproc v, void *a, traverseproc current_tp_traverse) {
    PyTypeObject* type = Py_TYPE(obj);
    while (type && type->tp_traverse != current_tp_traverse)
        type = type->tp_base;
    while (type && type->tp_traverse == current_tp_traverse)
        type = type->tp_base;
    if (type && type->tp_traverse)
        return type->tp_traverse(obj, v, a);
    return 0;
}

static void __Pyx_call_next_tp_clear(PyObject* obj, inquiry current_tp_clear) {
    PyTypeObject* type = Py_TYPE(obj);
    while (type && type->tp_clear != current_tp_clear)
        type = type->tp_base;
    while (type && type->tp_clear == current_tp_clear)
        type = type->tp_base;
    if (type && type->tp_clear)
        type->tp_clear(obj);
}

static void* __Pyx_GetVtable(PyObject *dict) {
    void* ptr;
    PyObject *ob = PyObject_GetItem(dict, __pyx_n_s_pyx_vtable);
    if (!ob)
        goto bad;
#if PY_VERSION_HEX >= 0x02070000 && !(PY_MAJOR_VERSION==3&&PY_MINOR_VERSION==0)
    ptr = PyCapsule_GetPointer(ob, 0);
#else
    ptr = PyCObject_AsVoidPtr(ob);
#endif
    if (!ptr && !PyErr_Occurred())
        PyErr_SetString(PyExc_RuntimeError, "invalid vtable found for imported type");
    Py_DECREF(ob);
    return ptr;
bad:
    Py_XDECREF(ob);
    return NULL;
}

static int __Pyx_SetVtable(PyObject *dict, void *vtable) {
#if PY_VERSION_HEX >= 0x02070000 && !(PY_MAJOR_VERSION==3&&PY_MINOR_VERSION==0)
    PyObject *ob = PyCapsule_New(vtable, 0, 0);
#else
    PyObject *ob = PyCObject_FromVoidPtr(vtable, 0);
#endif
    if (!ob)
        goto bad;
    if (PyDict_SetItem(dict, __pyx_n_s_pyx_vtable, ob) < 0)
        goto bad;
    Py_DECREF(ob);
    return 0;
bad:
    Py_XDECREF(ob);
    return -1;
}

#define __PYX_VERIFY_RETURN_INT(target_type, func_type, func)             \
    {                                                                     \
        func_type value = func(x);                                        \
        if (sizeof(target_type) < sizeof(func_type)) {                    \
            if (unlikely(value != (func_type) (target_type) value)) {     \
                func_type zero = 0;                                       \
                PyErr_SetString(PyExc_OverflowError,                      \
                    (is_unsigned && unlikely(value < zero)) ?             \
                    "can't convert negative value to " #target_type :     \
                    "value too large to convert to " #target_type);       \
                return (target_type) -1;                                  \
            }                                                             \
        }                                                                 \
        return (target_type) value;                                       \
    }

#if CYTHON_COMPILING_IN_CPYTHON && PY_MAJOR_VERSION >= 3
 #if CYTHON_USE_PYLONG_INTERNALS
  #include "longintrepr.h"
 #endif
#endif
static CYTHON_INLINE int __Pyx_PyInt_As_int(PyObject *x) {
    const int neg_one = (int) -1, const_zero = 0;
    const int is_unsigned = neg_one > const_zero;
#if PY_MAJOR_VERSION < 3
    if (likely(PyInt_Check(x))) {
        if (sizeof(int) < sizeof(long)) {
            __PYX_VERIFY_RETURN_INT(int, long, PyInt_AS_LONG)
        } else {
            long val = PyInt_AS_LONG(x);
            if (is_unsigned && unlikely(val < 0)) {
                PyErr_SetString(PyExc_OverflowError,
                                "can't convert negative value to int");
                return (int) -1;
            }
            return (int) val;
        }
    } else
#endif
    if (likely(PyLong_Check(x))) {
        if (is_unsigned) {
#if CYTHON_COMPILING_IN_CPYTHON && PY_MAJOR_VERSION >= 3
 #if CYTHON_USE_PYLONG_INTERNALS
            if (sizeof(digit) <= sizeof(int)) {
                switch (Py_SIZE(x)) {
                    case  0: return 0;
                    case  1: return (int) ((PyLongObject*)x)->ob_digit[0];
                }
            }
 #endif
#endif
            if (unlikely(Py_SIZE(x) < 0)) {
                PyErr_SetString(PyExc_OverflowError,
                                "can't convert negative value to int");
                return (int) -1;
            }
            if (sizeof(int) <= sizeof(unsigned long)) {
                __PYX_VERIFY_RETURN_INT(int, unsigned long, PyLong_AsUnsignedLong)
            } else if (sizeof(int) <= sizeof(unsigned long long)) {
                __PYX_VERIFY_RETURN_INT(int, unsigned long long, PyLong_AsUnsignedLongLong)
            }
        } else {
#if CYTHON_COMPILING_IN_CPYTHON && PY_MAJOR_VERSION >= 3
 #if CYTHON_USE_PYLONG_INTERNALS
            if (sizeof(digit) <= sizeof(int)) {
                switch (Py_SIZE(x)) {
                    case  0: return 0;
                    case  1: return +(int) ((PyLongObject*)x)->ob_digit[0];
                    case -1: return -(int) ((PyLongObject*)x)->ob_digit[0];
                }
            }
 #endif
#endif
            if (sizeof(int) <= sizeof(long)) {
                __PYX_VERIFY_RETURN_INT(int, long, PyLong_AsLong)
            } else if (sizeof(int) <= sizeof(long long)) {
                __PYX_VERIFY_RETURN_INT(int, long long, PyLong_AsLongLong)
            }
        }
        {
#if CYTHON_COMPILING_IN_PYPY && !defined(_PyLong_AsByteArray)
            PyErr_SetString(PyExc_RuntimeError,
                            "_PyLong_AsByteArray() not available in PyPy, cannot convert large numbers");
#else
            int val;
            PyObject *v = __Pyx_PyNumber_Int(x);
 #if PY_MAJOR_VERSION < 3
            if (likely(v) && !PyLong_Check(v)) {
                PyObject *tmp = v;
                v = PyNumber_Long(tmp);
                Py_DECREF(tmp);
            }
 #endif
            if (likely(v)) {
                int one = 1; int is_little = (int)*(unsigned char *)&one;
                unsigned char *bytes = (unsigned char *)&val;
                int ret = _PyLong_AsByteArray((PyLongObject *)v,
                                              bytes, sizeof(val),
                                              is_little, !is_unsigned);
                Py_DECREF(v);
                if (likely(!ret))
                    return val;
            }
#endif
            return (int) -1;
        }
    } else {
        int val;
        PyObject *tmp = __Pyx_PyNumber_Int(x);
        if (!tmp) return (int) -1;
        val = __Pyx_PyInt_As_int(tmp);
        Py_DECREF(tmp);
        return val;
    }
}

static CYTHON_INLINE PyObject* __Pyx_PyInt_From_int(int value) {
    const int neg_one = (int) -1, const_zero = 0;
    const int is_unsigned = neg_one > const_zero;
    if (is_unsigned) {
        if (sizeof(int) < sizeof(long)) {
            return PyInt_FromLong((long) value);
        } else if (sizeof(int) <= sizeof(unsigned long)) {
            return PyLong_FromUnsignedLong((unsigned long) value);
        } else if (sizeof(int) <= sizeof(unsigned long long)) {
            return PyLong_FromUnsignedLongLong((unsigned long long) value);
        }
    } else {
        if (sizeof(int) <= sizeof(long)) {
            return PyInt_FromLong((long) value);
        } else if (sizeof(int) <= sizeof(long long)) {
            return PyLong_FromLongLong((long long) value);
        }
    }
    {
        int one = 1; int little = (int)*(unsigned char *)&one;
        unsigned char *bytes = (unsigned char *)&value;
        return _PyLong_FromByteArray(bytes, sizeof(int),
                                     little, !is_unsigned);
    }
}

static CYTHON_INLINE PyObject* __Pyx_PyInt_From_unsigned_int(unsigned int value) {
    const unsigned int neg_one = (unsigned int) -1, const_zero = 0;
    const int is_unsigned = neg_one > const_zero;
    if (is_unsigned) {
        if (sizeof(unsigned int) < sizeof(long)) {
            return PyInt_FromLong((long) value);
        } else if (sizeof(unsigned int) <= sizeof(unsigned long)) {
            return PyLong_FromUnsignedLong((unsigned long) value);
        } else if (sizeof(unsigned int) <= sizeof(unsigned long long)) {
            return PyLong_FromUnsignedLongLong((unsigned long long) value);
        }
    } else {
        if (sizeof(unsigned int) <= sizeof(long)) {
            return PyInt_FromLong((long) value);
        } else if (sizeof(unsigned int) <= sizeof(long long)) {
            return PyLong_FromLongLong((long long) value);
        }
    }
    {
        int one = 1; int little = (int)*(unsigned char *)&one;
        unsigned char *bytes = (unsigned char *)&value;
        return _PyLong_FromByteArray(bytes, sizeof(unsigned int),
                                     little, !is_unsigned);
    }
}

static CYTHON_INLINE PyObject* __Pyx_PyInt_From_long(long value) {
    const long neg_one = (long) -1, const_zero = 0;
    const int is_unsigned = neg_one > const_zero;
    if (is_unsigned) {
        if (sizeof(long) < sizeof(long)) {
            return PyInt_FromLong((long) value);
        } else if (sizeof(long) <= sizeof(unsigned long)) {
            return PyLong_FromUnsignedLong((unsigned long) value);
        } else if (sizeof(long) <= sizeof(unsigned long long)) {
            return PyLong_FromUnsignedLongLong((unsigned long long) value);
        }
    } else {
        if (sizeof(long) <= sizeof(long)) {
            return PyInt_FromLong((long) value);
        } else if (sizeof(long) <= sizeof(long long)) {
            return PyLong_FromLongLong((long long) value);
        }
    }
    {
        int one = 1; int little = (int)*(unsigned char *)&one;
        unsigned char *bytes = (unsigned char *)&value;
        return _PyLong_FromByteArray(bytes, sizeof(long),
                                     little, !is_unsigned);
    }
}

#if CYTHON_COMPILING_IN_CPYTHON && PY_MAJOR_VERSION >= 3
 #if CYTHON_USE_PYLONG_INTERNALS
  #include "longintrepr.h"
 #endif
#endif
static CYTHON_INLINE long __Pyx_PyInt_As_long(PyObject *x) {
    const long neg_one = (long) -1, const_zero = 0;
    const int is_unsigned = neg_one > const_zero;
#if PY_MAJOR_VERSION < 3
    if (likely(PyInt_Check(x))) {
        if (sizeof(long) < sizeof(long)) {
            __PYX_VERIFY_RETURN_INT(long, long, PyInt_AS_LONG)
        } else {
            long val = PyInt_AS_LONG(x);
            if (is_unsigned && unlikely(val < 0)) {
                PyErr_SetString(PyExc_OverflowError,
                                "can't convert negative value to long");
                return (long) -1;
            }
            return (long) val;
        }
    } else
#endif
    if (likely(PyLong_Check(x))) {
        if (is_unsigned) {
#if CYTHON_COMPILING_IN_CPYTHON && PY_MAJOR_VERSION >= 3
 #if CYTHON_USE_PYLONG_INTERNALS
            if (sizeof(digit) <= sizeof(long)) {
                switch (Py_SIZE(x)) {
                    case  0: return 0;
                    case  1: return (long) ((PyLongObject*)x)->ob_digit[0];
                }
            }
 #endif
#endif
            if (unlikely(Py_SIZE(x) < 0)) {
                PyErr_SetString(PyExc_OverflowError,
                                "can't convert negative value to long");
                return (long) -1;
            }
            if (sizeof(long) <= sizeof(unsigned long)) {
                __PYX_VERIFY_RETURN_INT(long, unsigned long, PyLong_AsUnsignedLong)
            } else if (sizeof(long) <= sizeof(unsigned long long)) {
                __PYX_VERIFY_RETURN_INT(long, unsigned long long, PyLong_AsUnsignedLongLong)
            }
        } else {
#if CYTHON_COMPILING_IN_CPYTHON && PY_MAJOR_VERSION >= 3
 #if CYTHON_USE_PYLONG_INTERNALS
            if (sizeof(digit) <= sizeof(long)) {
                switch (Py_SIZE(x)) {
                    case  0: return 0;
                    case  1: return +(long) ((PyLongObject*)x)->ob_digit[0];
                    case -1: return -(long) ((PyLongObject*)x)->ob_digit[0];
                }
            }
 #endif
#endif
            if (sizeof(long) <= sizeof(long)) {
                __PYX_VERIFY_RETURN_INT(long, long, PyLong_AsLong)
            } else if (sizeof(long) <= sizeof(long long)) {
                __PYX_VERIFY_RETURN_INT(long, long long, PyLong_AsLongLong)
            }
        }
        {
#if CYTHON_COMPILING_IN_PYPY && !defined(_PyLong_AsByteArray)
            PyErr_SetString(PyExc_RuntimeError,
                            "_PyLong_AsByteArray() not available in PyPy, cannot convert large numbers");
#else
            long val;
            PyObject *v = __Pyx_PyNumber_Int(x);
 #if PY_MAJOR_VERSION < 3
            if (likely(v) && !PyLong_Check(v)) {
                PyObject *tmp = v;
                v = PyNumber_Long(tmp);
                Py_DECREF(tmp);
            }
 #endif
            if (likely(v)) {
                int one = 1; int is_little = (int)*(unsigned char *)&one;
                unsigned char *bytes = (unsigned char *)&val;
                int ret = _PyLong_AsByteArray((PyLongObject *)v,
                                              bytes, sizeof(val),
                                              is_little, !is_unsigned);
                Py_DECREF(v);
                if (likely(!ret))
                    return val;
            }
#endif
            return (long) -1;
        }
    } else {
        long val;
        PyObject *tmp = __Pyx_PyNumber_Int(x);
        if (!tmp) return (long) -1;
        val = __Pyx_PyInt_As_long(tmp);
        Py_DECREF(tmp);
        return val;
    }
}

static int __Pyx_check_binary_version(void) {
    char ctversion[4], rtversion[4];
    PyOS_snprintf(ctversion, 4, "%d.%d", PY_MAJOR_VERSION, PY_MINOR_VERSION);
    PyOS_snprintf(rtversion, 4, "%s", Py_GetVersion());
    if (ctversion[0] != rtversion[0] || ctversion[2] != rtversion[2]) {
        char message[200];
        PyOS_snprintf(message, sizeof(message),
                      "compiletime version %s of module '%.100s' "
                      "does not match runtime version %s",
                      ctversion, __Pyx_MODULE_NAME, rtversion);
        #if PY_VERSION_HEX < 0x02050000
        return PyErr_Warn(NULL, message);
        #else
        return PyErr_WarnEx(NULL, message, 1);
        #endif
    }
    return 0;
}

#ifndef __PYX_HAVE_RT_ImportModule
#define __PYX_HAVE_RT_ImportModule
static PyObject *__Pyx_ImportModule(const char *name) {
    PyObject *py_name = 0;
    PyObject *py_module = 0;
    py_name = __Pyx_PyIdentifier_FromString(name);
    if (!py_name)
        goto bad;
    py_module = PyImport_Import(py_name);
    Py_DECREF(py_name);
    return py_module;
bad:
    Py_XDECREF(py_name);
    return 0;
}
#endif

#ifndef __PYX_HAVE_RT_ImportType
#define __PYX_HAVE_RT_ImportType
static PyTypeObject *__Pyx_ImportType(const char *module_name, const char *class_name,
    size_t size, int strict)
{
    PyObject *py_module = 0;
    PyObject *result = 0;
    PyObject *py_name = 0;
    char warning[200];
    Py_ssize_t basicsize;
#ifdef Py_LIMITED_API
    PyObject *py_basicsize;
#endif
    py_module = __Pyx_ImportModule(module_name);
    if (!py_module)
        goto bad;
    py_name = __Pyx_PyIdentifier_FromString(class_name);
    if (!py_name)
        goto bad;
    result = PyObject_GetAttr(py_module, py_name);
    Py_DECREF(py_name);
    py_name = 0;
    Py_DECREF(py_module);
    py_module = 0;
    if (!result)
        goto bad;
    if (!PyType_Check(result)) {
        PyErr_Format(PyExc_TypeError,
            "%.200s.%.200s is not a type object",
            module_name, class_name);
        goto bad;
    }
#ifndef Py_LIMITED_API
    basicsize = ((PyTypeObject *)result)->tp_basicsize;
#else
    py_basicsize = PyObject_GetAttrString(result, "__basicsize__");
    if (!py_basicsize)
        goto bad;
    basicsize = PyLong_AsSsize_t(py_basicsize);
    Py_DECREF(py_basicsize);
    py_basicsize = 0;
    if (basicsize == (Py_ssize_t)-1 && PyErr_Occurred())
        goto bad;
#endif
    if (!strict && (size_t)basicsize > size) {
        PyOS_snprintf(warning, sizeof(warning),
            "%s.%s size changed, may indicate binary incompatibility",
            module_name, class_name);
        #if PY_VERSION_HEX < 0x02050000
        if (PyErr_Warn(NULL, warning) < 0) goto bad;
        #else
        if (PyErr_WarnEx(NULL, warning, 0) < 0) goto bad;
        #endif
    }
    else if ((size_t)basicsize != size) {
        PyErr_Format(PyExc_ValueError,
            "%.200s.%.200s has the wrong size, try recompiling",
            module_name, class_name);
        goto bad;
    }
    return (PyTypeObject *)result;
bad:
    Py_XDECREF(py_module);
    Py_XDECREF(result);
    return NULL;
}
#endif

#ifndef __PYX_HAVE_RT_ImportFunction
#define __PYX_HAVE_RT_ImportFunction
static int __Pyx_ImportFunction(PyObject *module, const char *funcname, void (**f)(void), const char *sig) {
    PyObject *d = 0;
    PyObject *cobj = 0;
    union {
        void (*fp)(void);
        void *p;
    } tmp;
    d = PyObject_GetAttrString(module, (char *)"__pyx_capi__");
    if (!d)
        goto bad;
    cobj = PyDict_GetItemString(d, funcname);
    if (!cobj) {
        PyErr_Format(PyExc_ImportError,
            "%.200s does not export expected C function %.200s",
                PyModule_GetName(module), funcname);
        goto bad;
    }
#if PY_VERSION_HEX >= 0x02070000 && !(PY_MAJOR_VERSION==3 && PY_MINOR_VERSION==0)
    if (!PyCapsule_IsValid(cobj, sig)) {
        PyErr_Format(PyExc_TypeError,
            "C function %.200s.%.200s has wrong signature (expected %.500s, got %.500s)",
             PyModule_GetName(module), funcname, sig, PyCapsule_GetName(cobj));
        goto bad;
    }
    tmp.p = PyCapsule_GetPointer(cobj, sig);
#else
    {const char *desc, *s1, *s2;
    desc = (const char *)PyCObject_GetDesc(cobj);
    if (!desc)
        goto bad;
    s1 = desc; s2 = sig;
    while (*s1 != '\0' && *s1 == *s2) { s1++; s2++; }
    if (*s1 != *s2) {
        PyErr_Format(PyExc_TypeError,
            "C function %.200s.%.200s has wrong signature (expected %.500s, got %.500s)",
             PyModule_GetName(module), funcname, sig, desc);
        goto bad;
    }
    tmp.p = PyCObject_AsVoidPtr(cobj);}
#endif
    *f = tmp.fp;
    if (!(*f))
        goto bad;
    Py_DECREF(d);
    return 0;
bad:
    Py_XDECREF(d);
    return -1;
}
#endif

static int __pyx_bisect_code_objects(__Pyx_CodeObjectCacheEntry* entries, int count, int code_line) {
    int start = 0, mid = 0, end = count - 1;
    if (end >= 0 && code_line > entries[end].code_line) {
        return count;
    }
    while (start < end) {
        mid = (start + end) / 2;
        if (code_line < entries[mid].code_line) {
            end = mid;
        } else if (code_line > entries[mid].code_line) {
             start = mid + 1;
        } else {
            return mid;
        }
    }
    if (code_line <= entries[mid].code_line) {
        return mid;
    } else {
        return mid + 1;
    }
}
static PyCodeObject *__pyx_find_code_object(int code_line) {
    PyCodeObject* code_object;
    int pos;
    if (unlikely(!code_line) || unlikely(!__pyx_code_cache.entries)) {
        return NULL;
    }
    pos = __pyx_bisect_code_objects(__pyx_code_cache.entries, __pyx_code_cache.count, code_line);
    if (unlikely(pos >= __pyx_code_cache.count) || unlikely(__pyx_code_cache.entries[pos].code_line != code_line)) {
        return NULL;
    }
    code_object = __pyx_code_cache.entries[pos].code_object;
    Py_INCREF(code_object);
    return code_object;
}
static void __pyx_insert_code_object(int code_line, PyCodeObject* code_object) {
    int pos, i;
    __Pyx_CodeObjectCacheEntry* entries = __pyx_code_cache.entries;
    if (unlikely(!code_line)) {
        return;
    }
    if (unlikely(!entries)) {
        entries = (__Pyx_CodeObjectCacheEntry*)PyMem_Malloc(64*sizeof(__Pyx_CodeObjectCacheEntry));
        if (likely(entries)) {
            __pyx_code_cache.entries = entries;
            __pyx_code_cache.max_count = 64;
            __pyx_code_cache.count = 1;
            entries[0].code_line = code_line;
            entries[0].code_object = code_object;
            Py_INCREF(code_object);
        }
        return;
    }
    pos = __pyx_bisect_code_objects(__pyx_code_cache.entries, __pyx_code_cache.count, code_line);
    if ((pos < __pyx_code_cache.count) && unlikely(__pyx_code_cache.entries[pos].code_line == code_line)) {
        PyCodeObject* tmp = entries[pos].code_object;
        entries[pos].code_object = code_object;
        Py_DECREF(tmp);
        return;
    }
    if (__pyx_code_cache.count == __pyx_code_cache.max_count) {
        int new_max = __pyx_code_cache.max_count + 64;
        entries = (__Pyx_CodeObjectCacheEntry*)PyMem_Realloc(
            __pyx_code_cache.entries, (size_t)new_max*sizeof(__Pyx_CodeObjectCacheEntry));
        if (unlikely(!entries)) {
            return;
        }
        __pyx_code_cache.entries = entries;
        __pyx_code_cache.max_count = new_max;
    }
    for (i=__pyx_code_cache.count; i>pos; i--) {
        entries[i] = entries[i-1];
    }
    entries[pos].code_line = code_line;
    entries[pos].code_object = code_object;
    __pyx_code_cache.count++;
    Py_INCREF(code_object);
}

#include "compile.h"
#include "frameobject.h"
#include "traceback.h"
static PyCodeObject* __Pyx_CreateCodeObjectForTraceback(
            const char *funcname, int c_line,
            int py_line, const char *filename) {
    PyCodeObject *py_code = 0;
    PyObject *py_srcfile = 0;
    PyObject *py_funcname = 0;
    #if PY_MAJOR_VERSION < 3
    py_srcfile = PyString_FromString(filename);
    #else
    py_srcfile = PyUnicode_FromString(filename);
    #endif
    if (!py_srcfile) goto bad;
    if (c_line) {
        #if PY_MAJOR_VERSION < 3
        py_funcname = PyString_FromFormat( "%s (%s:%d)", funcname, __pyx_cfilenm, c_line);
        #else
        py_funcname = PyUnicode_FromFormat( "%s (%s:%d)", funcname, __pyx_cfilenm, c_line);
        #endif
    }
    else {
        #if PY_MAJOR_VERSION < 3
        py_funcname = PyString_FromString(funcname);
        #else
        py_funcname = PyUnicode_FromString(funcname);
        #endif
    }
    if (!py_funcname) goto bad;
    py_code = __Pyx_PyCode_New(
        0,            /*int argcount,*/
        0,            /*int kwonlyargcount,*/
        0,            /*int nlocals,*/
        0,            /*int stacksize,*/
        0,            /*int flags,*/
        __pyx_empty_bytes, /*PyObject *code,*/
        __pyx_empty_tuple, /*PyObject *consts,*/
        __pyx_empty_tuple, /*PyObject *names,*/
        __pyx_empty_tuple, /*PyObject *varnames,*/
        __pyx_empty_tuple, /*PyObject *freevars,*/
        __pyx_empty_tuple, /*PyObject *cellvars,*/
        py_srcfile,   /*PyObject *filename,*/
        py_funcname,  /*PyObject *name,*/
        py_line,      /*int firstlineno,*/
        __pyx_empty_bytes  /*PyObject *lnotab*/
    );
    Py_DECREF(py_srcfile);
    Py_DECREF(py_funcname);
    return py_code;
bad:
    Py_XDECREF(py_srcfile);
    Py_XDECREF(py_funcname);
    return NULL;
}
static void __Pyx_AddTraceback(const char *funcname, int c_line,
                               int py_line, const char *filename) {
    PyCodeObject *py_code = 0;
    PyObject *py_globals = 0;
    PyFrameObject *py_frame = 0;
    py_code = __pyx_find_code_object(c_line ? c_line : py_line);
    if (!py_code) {
        py_code = __Pyx_CreateCodeObjectForTraceback(
            funcname, c_line, py_line, filename);
        if (!py_code) goto bad;
        __pyx_insert_code_object(c_line ? c_line : py_line, py_code);
    }
    py_globals = PyModule_GetDict(__pyx_m);
    if (!py_globals) goto bad;
    py_frame = PyFrame_New(
        PyThreadState_GET(), /*PyThreadState *tstate,*/
        py_code,             /*PyCodeObject *code,*/
        py_globals,          /*PyObject *globals,*/
        0                    /*PyObject *locals*/
    );
    if (!py_frame) goto bad;
    py_frame->f_lineno = py_line;
    PyTraceBack_Here(py_frame);
bad:
    Py_XDECREF(py_code);
    Py_XDECREF(py_frame);
}

static int __Pyx_InitStrings(__Pyx_StringTabEntry *t) {
    while (t->p) {
        #if PY_MAJOR_VERSION < 3
        if (t->is_unicode) {
            *t->p = PyUnicode_DecodeUTF8(t->s, t->n - 1, NULL);
        } else if (t->intern) {
            *t->p = PyString_InternFromString(t->s);
        } else {
            *t->p = PyString_FromStringAndSize(t->s, t->n - 1);
        }
        #else  /* Python 3+ has unicode identifiers */
        if (t->is_unicode | t->is_str) {
            if (t->intern) {
                *t->p = PyUnicode_InternFromString(t->s);
            } else if (t->encoding) {
                *t->p = PyUnicode_Decode(t->s, t->n - 1, t->encoding, NULL);
            } else {
                *t->p = PyUnicode_FromStringAndSize(t->s, t->n - 1);
            }
        } else {
            *t->p = PyBytes_FromStringAndSize(t->s, t->n - 1);
        }
        #endif
        if (!*t->p)
            return -1;
        ++t;
    }
    return 0;
}

static CYTHON_INLINE PyObject* __Pyx_PyUnicode_FromString(const char* c_str) {
    return __Pyx_PyUnicode_FromStringAndSize(c_str, (Py_ssize_t)strlen(c_str));
}
static CYTHON_INLINE char* __Pyx_PyObject_AsString(PyObject* o) {
    Py_ssize_t ignore;
    return __Pyx_PyObject_AsStringAndSize(o, &ignore);
}
static CYTHON_INLINE char* __Pyx_PyObject_AsStringAndSize(PyObject* o, Py_ssize_t *length) {
#if __PYX_DEFAULT_STRING_ENCODING_IS_ASCII || __PYX_DEFAULT_STRING_ENCODING_IS_DEFAULT
    if (
#if PY_MAJOR_VERSION < 3 && __PYX_DEFAULT_STRING_ENCODING_IS_ASCII
            __Pyx_sys_getdefaultencoding_not_ascii &&
#endif
            PyUnicode_Check(o)) {
#if PY_VERSION_HEX < 0x03030000
        char* defenc_c;
        PyObject* defenc = _PyUnicode_AsDefaultEncodedString(o, NULL);
        if (!defenc) return NULL;
        defenc_c = PyBytes_AS_STRING(defenc);
#if __PYX_DEFAULT_STRING_ENCODING_IS_ASCII
        {
            char* end = defenc_c + PyBytes_GET_SIZE(defenc);
            char* c;
            for (c = defenc_c; c < end; c++) {
                if ((unsigned char) (*c) >= 128) {
                    PyUnicode_AsASCIIString(o);
                    return NULL;
                }
            }
        }
#endif /*__PYX_DEFAULT_STRING_ENCODING_IS_ASCII*/
        *length = PyBytes_GET_SIZE(defenc);
        return defenc_c;
#else /* PY_VERSION_HEX < 0x03030000 */
        if (PyUnicode_READY(o) == -1) return NULL;
#if __PYX_DEFAULT_STRING_ENCODING_IS_ASCII
        if (PyUnicode_IS_ASCII(o)) {
            *length = PyUnicode_GET_LENGTH(o);
            return PyUnicode_AsUTF8(o);
        } else {
            PyUnicode_AsASCIIString(o);
            return NULL;
        }
#else /* __PYX_DEFAULT_STRING_ENCODING_IS_ASCII */
        return PyUnicode_AsUTF8AndSize(o, length);
#endif /* __PYX_DEFAULT_STRING_ENCODING_IS_ASCII */
#endif /* PY_VERSION_HEX < 0x03030000 */
    } else
#endif /* __PYX_DEFAULT_STRING_ENCODING_IS_ASCII  || __PYX_DEFAULT_STRING_ENCODING_IS_DEFAULT */
#if !CYTHON_COMPILING_IN_PYPY
#if PY_VERSION_HEX >= 0x02060000
    if (PyByteArray_Check(o)) {
        *length = PyByteArray_GET_SIZE(o);
        return PyByteArray_AS_STRING(o);
    } else
#endif
#endif
    {
        char* result;
        int r = PyBytes_AsStringAndSize(o, &result, length);
        if (unlikely(r < 0)) {
            return NULL;
        } else {
            return result;
        }
    }
}
static CYTHON_INLINE int __Pyx_PyObject_IsTrue(PyObject* x) {
   int is_true = x == Py_True;
   if (is_true | (x == Py_False) | (x == Py_None)) return is_true;
   else return PyObject_IsTrue(x);
}
static CYTHON_INLINE PyObject* __Pyx_PyNumber_Int(PyObject* x) {
  PyNumberMethods *m;
  const char *name = NULL;
  PyObject *res = NULL;
#if PY_MAJOR_VERSION < 3
  if (PyInt_Check(x) || PyLong_Check(x))
#else
  if (PyLong_Check(x))
#endif
    return Py_INCREF(x), x;
  m = Py_TYPE(x)->tp_as_number;
#if PY_MAJOR_VERSION < 3
  if (m && m->nb_int) {
    name = "int";
    res = PyNumber_Int(x);
  }
  else if (m && m->nb_long) {
    name = "long";
    res = PyNumber_Long(x);
  }
#else
  if (m && m->nb_int) {
    name = "int";
    res = PyNumber_Long(x);
  }
#endif
  if (res) {
#if PY_MAJOR_VERSION < 3
    if (!PyInt_Check(res) && !PyLong_Check(res)) {
#else
    if (!PyLong_Check(res)) {
#endif
      PyErr_Format(PyExc_TypeError,
                   "__%.4s__ returned non-%.4s (type %.200s)",
                   name, name, Py_TYPE(res)->tp_name);
      Py_DECREF(res);
      return NULL;
    }
  }
  else if (!PyErr_Occurred()) {
    PyErr_SetString(PyExc_TypeError,
                    "an integer is required");
  }
  return res;
}
#if CYTHON_COMPILING_IN_CPYTHON && PY_MAJOR_VERSION >= 3
 #if CYTHON_USE_PYLONG_INTERNALS
  #include "longintrepr.h"
 #endif
#endif
static CYTHON_INLINE Py_ssize_t __Pyx_PyIndex_AsSsize_t(PyObject* b) {
  Py_ssize_t ival;
  PyObject *x;
#if PY_MAJOR_VERSION < 3
  if (likely(PyInt_CheckExact(b)))
      return PyInt_AS_LONG(b);
#endif
  if (likely(PyLong_CheckExact(b))) {
    #if CYTHON_COMPILING_IN_CPYTHON && PY_MAJOR_VERSION >= 3
     #if CYTHON_USE_PYLONG_INTERNALS
       switch (Py_SIZE(b)) {
       case -1: return -(sdigit)((PyLongObject*)b)->ob_digit[0];
       case  0: return 0;
       case  1: return ((PyLongObject*)b)->ob_digit[0];
       }
     #endif
    #endif
  #if PY_VERSION_HEX < 0x02060000
    return PyInt_AsSsize_t(b);
  #else
    return PyLong_AsSsize_t(b);
  #endif
  }
  x = PyNumber_Index(b);
  if (!x) return -1;
  ival = PyInt_AsSsize_t(x);
  Py_DECREF(x);
  return ival;
}
static CYTHON_INLINE PyObject * __Pyx_PyInt_FromSize_t(size_t ival) {
#if PY_VERSION_HEX < 0x02050000
   if (ival <= LONG_MAX)
       return PyInt_FromLong((long)ival);
   else {
       unsigned char *bytes = (unsigned char *) &ival;
       int one = 1; int little = (int)*(unsigned char*)&one;
       return _PyLong_FromByteArray(bytes, sizeof(size_t), little, 0);
   }
#else
   return PyInt_FromSize_t(ival);
#endif
}


#endif /* Py_PYTHON_H */
