#include <Adafruit_NeoPixel.h>
#include <PCM.h>

const unsigned char broken[] PROGMEM = {
  126, 126, 128, 128, 127, 128, 127, 126, 128, 129, 128, 128,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 128
};
  
const unsigned char fixed[] PROGMEM = {
 129, 129, 129, 128, 127, 127, 126, 126, 127, 127, 127, 127,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 128
};

#define PIN 6



Adafruit_NeoPixel strip =  Adafruit_NeoPixel(14, PIN, NEO_GRB + NEO_KHZ800);
boolean handshaken = false;

#define MAXWIDTH 50
char row[MAXWIDTH];
char ack;
int num;

void set_led(uint8_t index, uint8_t r, uint8_t g, uint8_t b) {
  uint32_t color = strip.Color(r, g, b);
  strip.setPixelColor(index, color);
}


void setup() {
  strip.begin();
  strip.show(); // Initialize all pixels to 'off'
  Serial.begin(57600);
  while (!handshaken) {
    delay(1000);
    heartbeat();
    while (Serial.available()) {
      int num = Serial.parseInt();
      handshaken = true;
      Serial.println("READY");
    }
  }
}

void heartbeat() {
  Serial.println("PING");
}


void loop() {
}


void parse_command() {
  String strrow = String(row);
  if (strrow.startsWith("LED", 0)) {
    handle_led_command(strrow.substring(3));
  }
  if (strrow.startsWith("SND", 0)) {
    handle_snd_command(strrow.substring(3));
  }
  if (strrow.startsWith("FLU",0)) {
    strip.show();
  }
}


int pos = 0;
void serialEvent() {
    Serial.readBytesUntil('\n', row, MAXWIDTH);
    parse_command();
    for (int i = 0; i < MAXWIDTH; i++)
    {
      row[i] = 0;
    }
}


void handle_led_command(String param) {
  uint8_t index = param.substring(0,2).toInt();

  uint8_t r = param.substring(2,5).toInt();
  uint8_t g = param.substring(5,8).toInt();
  uint8_t b = param.substring(8,11).toInt();
  set_led(index, r, g, b);
}

void handle_snd_command(String param) {
  if (param.startsWith("broken")) {
    startPlayback(broken, sizeof(broken));
  }
  if (param.startsWith("fixed")) {
    startPlayback(fixed, sizeof(fixed));
  }
}

